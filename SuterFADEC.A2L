/* generated by ASAP2 Studio 2.6.30.12408 */ ASAP2_VERSION 1 71
/begin PROJECT SuterFADEC ""
/begin MODULE ModuleName ""
/begin MOD_PAR ""
 /begin MEMORY_SEGMENT CAL_DATA "" DATA FLASH INTERN 0x77000 0x4000 -1 -1 -1 -1 -1
  /begin IF_DATA XCP
   /begin SEGMENT 0x00 0x01 0x00 0x00 0x00
    /begin PAGE 0x00 ECU_ACCESS_ALLOWED_DONT_CARE XCP_READ_ACCESS_ALLOWED_DONT_CARE XCP_WRITE_ACCESS_NOT_ALLOWED /end PAGE
   /end SEGMENT
  /end IF_DATA
 /end MEMORY_SEGMENT
 /begin MEMORY_SEGMENT PoolRAM "" SERAM RAM INTERN 0x1FFFDC00 0x2000 -1 -1 -1 -1 -1
  /begin IF_DATA XCP
   /begin SEGMENT 0x01 0x00 0x00 0x00 0x00
    /begin CHECKSUM XCP_ADD_12 MAX_BLOCK_SIZE 0xFFFFFFFF EXTERNAL_FUNCTION "chksum.dll" /end CHECKSUM
   /end SEGMENT
  /end IF_DATA
 /end MEMORY_SEGMENT
 /begin CALIBRATION_METHOD "AUTOSAR_SINGLE_POINTERED" 0x1 /begin CALIBRATION_HANDLE 0x1FFFB400 0x3B0 0x4 /end CALIBRATION_HANDLE /end CALIBRATION_METHOD
/end MOD_PAR
/begin MOD_COMMON "" ALIGNMENT_BYTE 1 ALIGNMENT_WORD 2 ALIGNMENT_LONG 4 ALIGNMENT_FLOAT16_IEEE 2 ALIGNMENT_FLOAT32_IEEE 4 ALIGNMENT_FLOAT64_IEEE 8 ALIGNMENT_INT64 8 /end MOD_COMMON
/begin IF_DATA XCP
 /begin PROTOCOL_LAYER 0x0100 0x07D0 0x2710 0x00 0x00 0x00 0x00 0x00 0x08 0x08 BYTE_ORDER_MSB_LAST ADDRESS_GRANULARITY_BYTE OPTIONAL_CMD ALLOC_ODT_ENTRY OPTIONAL_CMD ALLOC_ODT OPTIONAL_CMD ALLOC_DAQ OPTIONAL_CMD FREE_DAQ OPTIONAL_CMD GET_DAQ_RESOLUTION_INFO OPTIONAL_CMD START_STOP_SYNCH OPTIONAL_CMD START_STOP_DAQ_LIST OPTIONAL_CMD GET_DAQ_LIST_MODE OPTIONAL_CMD SET_DAQ_LIST_MODE OPTIONAL_CMD WRITE_DAQ OPTIONAL_CMD SET_DAQ_PTR OPTIONAL_CMD CLEAR_DAQ_LIST OPTIONAL_CMD DOWNLOAD OPTIONAL_CMD BUILD_CHECKSUM OPTIONAL_CMD SHORT_UPLOAD OPTIONAL_CMD UPLOAD OPTIONAL_CMD SET_MTA /end PROTOCOL_LAYER
 /begin DAQ DYNAMIC 0x00 0x03 0x00 OPTIMISATION_TYPE_DEFAULT ADDRESS_EXTENSION_FREE IDENTIFICATION_FIELD_TYPE_ABSOLUTE GRANULARITY_ODT_ENTRY_SIZE_DAQ_BYTE 0x07 NO_OVERLOAD_INDICATION PRESCALER_SUPPORTED RESUME_SUPPORTED /begin EVENT "10ms" "10ms" 0x00 DAQ 0xFF 0x0A 0x06 0x00 /end EVENT /begin EVENT "100ms" "100ms" 0x01 DAQ 0xFF 0x64 0x06 0x00 /end EVENT /begin EVENT "1000ms" "1000ms" 0x02 DAQ 0xFF 0x64 0x07 0x00 /end EVENT /end DAQ
 /begin PAG 0x02 /end PAG
 /begin PGM PGM_MODE_ABSOLUTE 0x01 0x00 /begin SECTOR "FLASH" 0x00 0x07C000 0x1000 0x00 0x00 0x00 /end SECTOR /end PGM
 /begin XCP_ON_CAN 0x0100 CAN_ID_MASTER 0x92750001 CAN_ID_SLAVE 0x92750C00 BAUDRATE 0x07A120 SAMPLE_POINT 0x4B SAMPLE_RATE SINGLE BTL_CYCLES 0x08 SJW 0x02 SYNC_EDGE SINGLE /end XCP_ON_CAN
/end IF_DATA
/begin AXIS_PTS AdCompBarometerScale "" 0x797A0 NO_INPUT_QUANTITY __SLong_Axis 0 NO_COMPU_METHOD 1 0 4000 PHYS_UNIT "mbar" /end AXIS_PTS
/begin CHARACTERISTIC AdCompMap "" MAP 0x797DC __SLong_Value 0 FP_Tenth.Conversion -2147483648 2147483647
 /begin AXIS_DESCR FIX_AXIS NO_INPUT_QUANTITY NO_COMPU_METHOD 1 0 0 FIX_AXIS_PAR_DIST 0 1 1 /end AXIS_DESCR
 /begin AXIS_DESCR FIX_AXIS NO_INPUT_QUANTITY NO_COMPU_METHOD 1 0 0 FIX_AXIS_PAR_DIST 0 1 1 /end AXIS_DESCR
 PHYS_UNIT "%" /end CHARACTERISTIC
/begin AXIS_PTS AdCompTempScale "" 0x79750 NO_INPUT_QUANTITY __SLong_Axis 0 FP_Tenth.Conversion 1 -2147483648 2147483647 PHYS_UNIT "deg C" /end AXIS_PTS
/begin MEASUREMENT AnaIn0 "" SLONG FP_Tenth.Conversion 0 0 -2147483648 2147483647 ECU_ADDRESS 0x1FFFD864 PHYS_UNIT "V"
 /begin IF_DATA XCP
  /begin DAQ_EVENT VARIABLE /begin AVAILABLE_EVENT_LIST EVENT 0x00 EVENT 0x01 EVENT 0x02 /end AVAILABLE_EVENT_LIST /begin DEFAULT_EVENT_LIST EVENT 0x01 /end DEFAULT_EVENT_LIST /end DAQ_EVENT
 /end IF_DATA
/end MEASUREMENT
/begin AXIS_PTS AnaIn0Input "" 0x776C0 NO_INPUT_QUANTITY AnaIn0Input.RecordLayout 0 FP_Thousandth.Conversion 2 0 5 PHYS_UNIT "V" /end AXIS_PTS
/begin CHARACTERISTIC AnaIn0LowPassFilter "" VALUE 0x776D0 __SLong_Value 0 NO_COMPU_METHOD 0 2147483647 /end CHARACTERISTIC
/begin CHARACTERISTIC AnaIn0Output "" CURVE 0x776C8 __SLong_Value 0 NO_COMPU_METHOD 0 2147483647 /begin AXIS_DESCR COM_AXIS NO_INPUT_QUANTITY NO_COMPU_METHOD 1 0 0 /end AXIS_DESCR /end CHARACTERISTIC
/begin MEASUREMENT AnaIn0Raw "" UWORD FP_Thousandth.Conversion 0 0 0 65535 ECU_ADDRESS 0x1FFFD868 PHYS_UNIT "V"
 /begin IF_DATA XCP
  /begin DAQ_EVENT VARIABLE /begin AVAILABLE_EVENT_LIST EVENT 0x00 EVENT 0x01 EVENT 0x02 /end AVAILABLE_EVENT_LIST /begin DEFAULT_EVENT_LIST EVENT 0x01 /end DEFAULT_EVENT_LIST /end DAQ_EVENT
 /end IF_DATA
/end MEASUREMENT
/begin MEASUREMENT AnaIn1 "" SLONG FP_Thousandth.Conversion 0 0 -2147483648 2147483647 ECU_ADDRESS 0x1FFFD86C PHYS_UNIT "V"
 /begin IF_DATA XCP
  /begin DAQ_EVENT VARIABLE /begin AVAILABLE_EVENT_LIST EVENT 0x00 EVENT 0x01 EVENT 0x02 /end AVAILABLE_EVENT_LIST /begin DEFAULT_EVENT_LIST EVENT 0x01 /end DEFAULT_EVENT_LIST /end DAQ_EVENT
 /end IF_DATA
/end MEASUREMENT
/begin AXIS_PTS AnaIn1Input "" 0x776D4 NO_INPUT_QUANTITY AnaIn1Input.RecordLayout 0 FP_Thousandth.Conversion 2 0 5 PHYS_UNIT "V" /end AXIS_PTS
/begin CHARACTERISTIC AnaIn1LowPassFilter "" VALUE 0x776E4 __SLong_Value 0 NO_COMPU_METHOD 0 2147483647 /end CHARACTERISTIC
/begin CHARACTERISTIC AnaIn1Output "" CURVE 0x776DC __SLong_Value 0 NO_COMPU_METHOD -2147483648 2147483647
 /begin AXIS_DESCR COM_AXIS NO_INPUT_QUANTITY NO_COMPU_METHOD 2 0 0 AXIS_PTS_REF AnaIn1Input /end AXIS_DESCR
/end CHARACTERISTIC
/begin MEASUREMENT AnaIn1Raw "" UWORD FP_Thousandth.Conversion 0 0 0 65535 ECU_ADDRESS 0x1FFFD870 PHYS_UNIT "V"
 /begin IF_DATA XCP
  /begin DAQ_EVENT VARIABLE /begin AVAILABLE_EVENT_LIST EVENT 0x00 EVENT 0x01 EVENT 0x02 /end AVAILABLE_EVENT_LIST /begin DEFAULT_EVENT_LIST EVENT 0x01 /end DEFAULT_EVENT_LIST /end DAQ_EVENT
 /end IF_DATA
/end MEASUREMENT
/begin MEASUREMENT AnaIn2 "" SLONG FP_Thousandth.Conversion 0 0 -2147483648 2147483647 ECU_ADDRESS 0x1FFFD90C PHYS_UNIT "V"
 /begin IF_DATA XCP
  /begin DAQ_EVENT VARIABLE /begin AVAILABLE_EVENT_LIST EVENT 0x00 EVENT 0x01 EVENT 0x02 /end AVAILABLE_EVENT_LIST /begin DEFAULT_EVENT_LIST EVENT 0x01 /end DEFAULT_EVENT_LIST /end DAQ_EVENT
 /end IF_DATA
/end MEASUREMENT
/begin AXIS_PTS AnaIn2Input "" 0x78F84 NO_INPUT_QUANTITY __SLong_Axis 0 NO_COMPU_METHOD 1 -2147483648 2147483647 /end AXIS_PTS
/begin CHARACTERISTIC AnaIn2LowPassFilter "" VALUE 0x78F94 __SLong_Value 0 NO_COMPU_METHOD -2147483648 2147483647 /end CHARACTERISTIC
/begin CHARACTERISTIC AnaIn2Output "" CURVE 0x78F8C __SLong_Value 0 NO_COMPU_METHOD -2147483648 2147483647
 /begin AXIS_DESCR FIX_AXIS NO_INPUT_QUANTITY NO_COMPU_METHOD 1 0 0 FIX_AXIS_PAR_DIST 0 1 1 /end AXIS_DESCR
/end CHARACTERISTIC
/begin MEASUREMENT AnaIn2Raw "" UWORD FP_Thousandth.Conversion 0 0 0 65535 ECU_ADDRESS 0x1FFFD910 PHYS_UNIT "V"
 /begin IF_DATA XCP
  /begin DAQ_EVENT VARIABLE /begin AVAILABLE_EVENT_LIST EVENT 0x00 EVENT 0x01 EVENT 0x02 /end AVAILABLE_EVENT_LIST /begin DEFAULT_EVENT_LIST EVENT 0x01 /end DEFAULT_EVENT_LIST /end DAQ_EVENT
 /end IF_DATA
/end MEASUREMENT
/begin MEASUREMENT AnaIn3 "" SLONG FP_Thousandth.Conversion 0 0 -2147483648 2147483647 ECU_ADDRESS 0x1FFFD914 PHYS_UNIT "V"
 /begin IF_DATA XCP
  /begin DAQ_EVENT VARIABLE /begin AVAILABLE_EVENT_LIST EVENT 0x00 EVENT 0x01 EVENT 0x02 /end AVAILABLE_EVENT_LIST /begin DEFAULT_EVENT_LIST EVENT 0x01 /end DEFAULT_EVENT_LIST /end DAQ_EVENT
 /end IF_DATA
/end MEASUREMENT
/begin AXIS_PTS AnaIn3Input "" 0x78F98 NO_INPUT_QUANTITY __SLong_Axis 0 NO_COMPU_METHOD 1 -2147483648 2147483647 /end AXIS_PTS
/begin CHARACTERISTIC AnaIn3LowPassFilter "" VALUE 0x78FA8 __SLong_Value 0 NO_COMPU_METHOD -2147483648 2147483647 /end CHARACTERISTIC
/begin CHARACTERISTIC AnaIn3Output "" CURVE 0x78FA0 __SLong_Value 0 NO_COMPU_METHOD -2147483648 2147483647
 /begin AXIS_DESCR FIX_AXIS NO_INPUT_QUANTITY NO_COMPU_METHOD 1 0 0 FIX_AXIS_PAR_DIST 0 1 1 /end AXIS_DESCR
/end CHARACTERISTIC
/begin MEASUREMENT AnaIn3Raw "" UWORD FP_Thousandth.Conversion 0 0 0 65535 ECU_ADDRESS 0x1FFFD918 PHYS_UNIT "V"
 /begin IF_DATA XCP
  /begin DAQ_EVENT VARIABLE /begin AVAILABLE_EVENT_LIST EVENT 0x00 EVENT 0x01 EVENT 0x02 /end AVAILABLE_EVENT_LIST /begin DEFAULT_EVENT_LIST EVENT 0x01 /end DEFAULT_EVENT_LIST /end DAQ_EVENT
 /end IF_DATA
/end MEASUREMENT
/begin CHARACTERISTIC AutoPrimeCurve "" CURVE 0x78DB0 __UWord_Value 0 NO_COMPU_METHOD 0 65535
 /begin AXIS_DESCR FIX_AXIS NO_INPUT_QUANTITY NO_COMPU_METHOD 1 0 0 FIX_AXIS_PAR_DIST 0 1 1 /end AXIS_DESCR
/end CHARACTERISTIC
/begin MEASUREMENT Barometer "" SLONG NO_COMPU_METHOD 0 0 -2147483648 2147483647 ECU_ADDRESS 0x1FFFD84C PHYS_UNIT "mbar"
 /begin IF_DATA XCP
  /begin DAQ_EVENT VARIABLE /begin AVAILABLE_EVENT_LIST EVENT 0x00 EVENT 0x01 EVENT 0x02 /end AVAILABLE_EVENT_LIST /begin DEFAULT_EVENT_LIST EVENT 0x01 /end DEFAULT_EVENT_LIST /end DAQ_EVENT
 /end IF_DATA
/end MEASUREMENT
/begin AXIS_PTS BarometerInput "" 0x77684 NO_INPUT_QUANTITY __SLong_Axis 0 FP_Thousandth.Conversion 2 0 5 PHYS_UNIT "V" /end AXIS_PTS
/begin CHARACTERISTIC BarometerLowPassFilter "" VALUE 0x77694 __SLong_Value 0 NO_COMPU_METHOD -2147483648 2147483647 /end CHARACTERISTIC
/begin CHARACTERISTIC BarometerOutput "" CURVE 0x7768C BarometerOutput.RecordLayout 0 NO_COMPU_METHOD -2147483648 2147483647
 /begin AXIS_DESCR COM_AXIS NO_INPUT_QUANTITY NO_COMPU_METHOD 2 0 0 AXIS_PTS_REF BarometerInput /end AXIS_DESCR
 PHYS_UNIT "mbar" /end CHARACTERISTIC
/begin MEASUREMENT BarometerRaw "" UWORD NO_COMPU_METHOD 0 0 0 65535 ECU_ADDRESS 0x1FFFD850 PHYS_UNIT "mbar"
 /begin IF_DATA XCP
  /begin DAQ_EVENT VARIABLE /begin AVAILABLE_EVENT_LIST EVENT 0x00 EVENT 0x01 EVENT 0x02 /end AVAILABLE_EVENT_LIST /begin DEFAULT_EVENT_LIST EVENT 0x01 /end DEFAULT_EVENT_LIST /end DAQ_EVENT
 /end IF_DATA
/end MEASUREMENT
/begin CHARACTERISTIC BetaCurve "" CURVE 0x78FAC __ULong_Value 0 NO_COMPU_METHOD 0 4294967295
 /begin AXIS_DESCR COM_AXIS EngineTemperature NO_COMPU_METHOD 15 0 0 AXIS_PTS_REF TempScale /end AXIS_DESCR
/end CHARACTERISTIC
/begin CHARACTERISTIC BreakIn_Dur "" VALUE 0x78F32 __UWord_Value 0 FP_Hundredth.Conversion 0 100 PHYS_UNIT "hr" /end CHARACTERISTIC
/begin CHARACTERISTIC BreakIn_OilEnrich "" VALUE 0x78F34 __UWord_Value 0 FP_Tenth.Conversion 0 65535 PHYS_UNIT "%" /end CHARACTERISTIC
/begin MEASUREMENT CHT1 "" SLONG FP_Tenth.Conversion 0 0 -2147483648 2147483647 ECU_ADDRESS 0x1FFFD88C PHYS_UNIT "deg C"
 /begin IF_DATA XCP
  /begin DAQ_EVENT VARIABLE /begin AVAILABLE_EVENT_LIST EVENT 0x00 EVENT 0x01 EVENT 0x02 /end AVAILABLE_EVENT_LIST /begin DEFAULT_EVENT_LIST EVENT 0x01 /end DEFAULT_EVENT_LIST /end DAQ_EVENT
 /end IF_DATA
/end MEASUREMENT
/begin CHARACTERISTIC CHT1LowPassFilter "" VALUE 0x77838 __SLong_Value 0 NO_COMPU_METHOD 0 2147483647 /end CHARACTERISTIC
/begin MEASUREMENT CHT1Raw "" SWORD FP_Tenth.Conversion 0 0 -32768 32767 ECU_ADDRESS 0x1FFFD8A0 PHYS_UNIT "deg C"
 /begin IF_DATA XCP
  /begin DAQ_EVENT VARIABLE /begin AVAILABLE_EVENT_LIST EVENT 0x00 EVENT 0x01 EVENT 0x02 /end AVAILABLE_EVENT_LIST /begin DEFAULT_EVENT_LIST EVENT 0x01 /end DEFAULT_EVENT_LIST /end DAQ_EVENT
 /end IF_DATA
/end MEASUREMENT
/begin MEASUREMENT CHT2 "" SLONG FP_Tenth.Conversion 0 0 -2147483648 2147483647 ECU_ADDRESS 0x1FFFD890 PHYS_UNIT "deg C"
 /begin IF_DATA XCP
  /begin DAQ_EVENT VARIABLE /begin AVAILABLE_EVENT_LIST EVENT 0x00 EVENT 0x01 EVENT 0x02 /end AVAILABLE_EVENT_LIST /begin DEFAULT_EVENT_LIST EVENT 0x01 /end DEFAULT_EVENT_LIST /end DAQ_EVENT
 /end IF_DATA
/end MEASUREMENT
/begin CHARACTERISTIC CHT2LowPassFilter "" VALUE 0x7783C __SLong_Value 0 NO_COMPU_METHOD 0 2147483647 /end CHARACTERISTIC
/begin MEASUREMENT CHT2Raw "" SWORD FP_Tenth.Conversion 0 0 -32768 32767 ECU_ADDRESS 0x1FFFD8A2 PHYS_UNIT "deg C"
 /begin IF_DATA XCP
  /begin DAQ_EVENT VARIABLE /begin AVAILABLE_EVENT_LIST EVENT 0x00 EVENT 0x01 EVENT 0x02 /end AVAILABLE_EVENT_LIST /begin DEFAULT_EVENT_LIST EVENT 0x01 /end DEFAULT_EVENT_LIST /end DAQ_EVENT
 /end IF_DATA
/end MEASUREMENT
/begin CHARACTERISTIC CalComments "" ASCII 0x77000 __UByte_Value 0 NO_COMPU_METHOD 0 255 NUMBER 100 /end CHARACTERISTIC
/begin CHARACTERISTIC ChtTempFallback "" VALUE 0x79702 __SWord_Value 0 NO_COMPU_METHOD -32768 32767 CALIBRATION_ACCESS CALIBRATION /end CHARACTERISTIC
/begin CHARACTERISTIC CrankDisconnect "" VALUE 0x78F40 __ULong_Value 0 SAERPM.Conversion 0 8000 PHYS_UNIT "RPM" /end CHARACTERISTIC
/begin MEASUREMENT CrankFailCtr "" ULONG NO_COMPU_METHOD 0 0 0 4294967295 ECU_ADDRESS 0x1FFFD924
 /begin IF_DATA XCP
  /begin DAQ_EVENT VARIABLE /begin AVAILABLE_EVENT_LIST EVENT 0x00 EVENT 0x01 EVENT 0x02 /end AVAILABLE_EVENT_LIST /begin DEFAULT_EVENT_LIST EVENT 0x01 /end DEFAULT_EVENT_LIST /end DAQ_EVENT
 /end IF_DATA
/end MEASUREMENT
/begin CHARACTERISTIC CrankMode "" VALUE 0x78F3E __UByte_Value 0 crankMode_t 0 255 /end CHARACTERISTIC
/begin MEASUREMENT CrankState "" UBYTE crankState_t 0 0 0 255 ECU_ADDRESS 0x1FFFD8E6
 /begin IF_DATA XCP
  /begin DAQ_EVENT VARIABLE /begin AVAILABLE_EVENT_LIST EVENT 0x00 EVENT 0x01 EVENT 0x02 /end AVAILABLE_EVENT_LIST /begin DEFAULT_EVENT_LIST EVENT 0x01 /end DEFAULT_EVENT_LIST /end DAQ_EVENT
 /end IF_DATA
/end MEASUREMENT
/begin CHARACTERISTIC CrankingPauseTime "" VALUE 0x78F4A __UWord_Value 0 NO_COMPU_METHOD 0 65535 /end CHARACTERISTIC
/begin CHARACTERISTIC CrankingRetries "" VALUE 0x78F4C __UWord_Value 0 NO_COMPU_METHOD 0 65535 /end CHARACTERISTIC
/begin CHARACTERISTIC CrankingTime "" VALUE 0x78F48 __UWord_Value 0 NO_COMPU_METHOD 0 65535 /end CHARACTERISTIC
/begin CHARACTERISTIC CylDeactivationEngTempThreshold "" VALUE 0x7970C __UWord_Value 0 NO_COMPU_METHOD 0 65535 CALIBRATION_ACCESS CALIBRATION /end CHARACTERISTIC
/begin CHARACTERISTIC CylDeactivationInhibitTime "" VALUE 0x79708 __ULong_Value 0 NO_COMPU_METHOD 0 4294967295 CALIBRATION_ACCESS CALIBRATION /end CHARACTERISTIC
/begin CHARACTERISTIC CylDeactivationTorqueIn "" VALUE 0x7970E __SWord_Value 0 NO_COMPU_METHOD -32768 32767 CALIBRATION_ACCESS CALIBRATION /end CHARACTERISTIC
/begin CHARACTERISTIC CylDeactivationTorqueOut "" VALUE 0x79710 __SWord_Value 0 NO_COMPU_METHOD -32768 32767 CALIBRATION_ACCESS CALIBRATION /end CHARACTERISTIC
/begin CHARACTERISTIC CylDeactiveFunctional "" VALUE 0x79066 __UByte_Value 0 binaryState_t 0 255 /end CHARACTERISTIC
/begin CHARACTERISTIC CylDeactiveMaxCylRunTime "" VALUE 0x7905C __SLong_Value 0 CylDeactiveMaxCylRunTime.Conversion -2147483648 2147483647 PHYS_UNIT "min" /end CHARACTERISTIC
/begin CHARACTERISTIC CylDeactiveParasiticTorque "" VALUE 0x79064 __SWord_Value 0 FP_Tenth.Conversion -32768 32767 PHYS_UNIT "X" /end CHARACTERISTIC
/begin AXIS_PTS CylDeactiveRPMCurve "" 0x79040 EngineSpeed __ULong_Axis 0 SAERPM.Conversion 6 0 4294967295 PHYS_UNIT "RPM" /end AXIS_PTS
/begin CHARACTERISTIC CylDeactiveTorqHysteresis "" VALUE 0x79058 __SWord_Value 0 FP_TenThousandth 0 100 PHYS_UNIT "%" /end CHARACTERISTIC
/begin CHARACTERISTIC CylDeactiveTorqueCurve "" CURVE 0x79034 __SWord_Value 0 FP_Tenth.Conversion -32768 32767
 /begin AXIS_DESCR COM_AXIS EngineSpeed FP_Tenth.Conversion 6 0 0 AXIS_PTS_REF CylDeactiveRPMCurve PHYS_UNIT "%" /end AXIS_DESCR
 PHYS_UNIT "%" /end CHARACTERISTIC
/begin CHARACTERISTIC CylDeactiveTransitionTime "" VALUE 0x79060 __ULong_Value 0 FP_Hundredth.Conversion 0 1000 PHYS_UNIT "sec" /end CHARACTERISTIC
/begin CHARACTERISTIC CylinderCount "" VALUE 0x78F36 __UWord_Value 0 NO_COMPU_METHOD 0 65535 /end CHARACTERISTIC
/begin MEASUREMENT CylinderDeactivation "" UBYTE cylinderDeactivation_t_Copy1 0 0 0 255 ECU_ADDRESS 0x1FFFD91C READ_WRITE
 /begin IF_DATA XCP
  /begin DAQ_EVENT VARIABLE /begin AVAILABLE_EVENT_LIST EVENT 0x00 EVENT 0x01 EVENT 0x02 /end AVAILABLE_EVENT_LIST /begin DEFAULT_EVENT_LIST EVENT 0x01 /end DEFAULT_EVENT_LIST /end DAQ_EVENT
 /end IF_DATA
/end MEASUREMENT
/begin MEASUREMENT DeltaT "" UWORD NO_COMPU_METHOD 0 0 0 65535 ECU_ADDRESS 0x200006C8 MATRIX_DIM 24 READ_WRITE
 /begin IF_DATA XCP
  /begin DAQ_EVENT VARIABLE /begin AVAILABLE_EVENT_LIST EVENT 0x00 EVENT 0x01 EVENT 0x02 /end AVAILABLE_EVENT_LIST /begin DEFAULT_EVENT_LIST EVENT 0x01 /end DEFAULT_EVENT_LIST /end DAQ_EVENT
 /end IF_DATA
/end MEASUREMENT
/begin CHARACTERISTIC DiffMap "" MAP 0x772F8 __UWord_Value 0 NO_COMPU_METHOD 0 65535
 /begin AXIS_DESCR FIX_AXIS NO_INPUT_QUANTITY NO_COMPU_METHOD 1 0 0 FIX_AXIS_PAR_DIST 0 1 1 /end AXIS_DESCR
 /begin AXIS_DESCR FIX_AXIS NO_INPUT_QUANTITY NO_COMPU_METHOD 1 0 0 FIX_AXIS_PAR_DIST 0 1 1 /end AXIS_DESCR
/end CHARACTERISTIC
/begin CHARACTERISTIC DiffTimeConstant "" VALUE 0x78DCE __UWord_Value 0 NO_COMPU_METHOD 0 65535 /end CHARACTERISTIC
/begin MEASUREMENT Digital_In_0 "" UBYTE binaryState_t 0 0 0 255 ECU_ADDRESS 0x1FFFD906
 /begin IF_DATA XCP
  /begin DAQ_EVENT VARIABLE /begin AVAILABLE_EVENT_LIST EVENT 0x00 EVENT 0x01 EVENT 0x02 /end AVAILABLE_EVENT_LIST /begin DEFAULT_EVENT_LIST EVENT 0x01 /end DEFAULT_EVENT_LIST /end DAQ_EVENT
 /end IF_DATA
/end MEASUREMENT
/begin MEASUREMENT Digital_In_1 "" UBYTE binaryState_t 0 0 0 255 ECU_ADDRESS 0x1FFFD907
 /begin IF_DATA XCP
  /begin DAQ_EVENT VARIABLE /begin AVAILABLE_EVENT_LIST EVENT 0x00 EVENT 0x01 EVENT 0x02 /end AVAILABLE_EVENT_LIST /begin DEFAULT_EVENT_LIST EVENT 0x01 /end DEFAULT_EVENT_LIST /end DAQ_EVENT
 /end IF_DATA
/end MEASUREMENT
/begin MEASUREMENT Digital_In_2 "" UBYTE binaryState_t 0 0 0 255 ECU_ADDRESS 0x1FFFD908
 /begin IF_DATA XCP
  /begin DAQ_EVENT VARIABLE /begin AVAILABLE_EVENT_LIST EVENT 0x00 EVENT 0x01 EVENT 0x02 /end AVAILABLE_EVENT_LIST /begin DEFAULT_EVENT_LIST EVENT 0x01 /end DEFAULT_EVENT_LIST /end DAQ_EVENT
 /end IF_DATA
/end MEASUREMENT
/begin MEASUREMENT Digital_In_3 "" UBYTE binaryState_t 0 0 0 255 ECU_ADDRESS 0x1FFFD909
 /begin IF_DATA XCP
  /begin DAQ_EVENT VARIABLE /begin AVAILABLE_EVENT_LIST EVENT 0x00 EVENT 0x01 EVENT 0x02 /end AVAILABLE_EVENT_LIST /begin DEFAULT_EVENT_LIST EVENT 0x01 /end DEFAULT_EVENT_LIST /end DAQ_EVENT
 /end IF_DATA
/end MEASUREMENT
/begin CHARACTERISTIC DoubleSparkCHT1 "" VALUE 0x79658 __SWord_Value 0 FP_Tenth.Conversion -32768 32767 PHYS_UNIT "deg C" /end CHARACTERISTIC
/begin CHARACTERISTIC DoubleSparkCHT2 "" VALUE 0x7965A __SWord_Value 0 FP_Tenth.Conversion -32768 32767 PHYS_UNIT "deg C" /end CHARACTERISTIC
/begin CHARACTERISTIC DoubleSparkEnable "" VALUE 0x7965C __UByte_Value 0 binaryState_t 0 255 /end CHARACTERISTIC
/begin CHARACTERISTIC DoubleSparkStartUpInhibit "" VALUE 0x7965E __UWord_Value 0 FP_Hundredth.Conversion 0 65535 PHYS_UNIT "sec" /end CHARACTERISTIC
/begin MEASUREMENT EGT1 "" SLONG FP_Tenth.Conversion 0 0 -2147483648 2147483647 ECU_ADDRESS 0x1FFFD884 PHYS_UNIT "deg C"
 /begin IF_DATA XCP
  /begin DAQ_EVENT VARIABLE /begin AVAILABLE_EVENT_LIST EVENT 0x00 EVENT 0x01 EVENT 0x02 /end AVAILABLE_EVENT_LIST /begin DEFAULT_EVENT_LIST EVENT 0x01 /end DEFAULT_EVENT_LIST /end DAQ_EVENT
 /end IF_DATA
/end MEASUREMENT
/begin CHARACTERISTIC EGT1LowPassFilter "" VALUE 0x77830 __SLong_Value 0 NO_COMPU_METHOD 0 2147483647 /end CHARACTERISTIC
/begin MEASUREMENT EGT1Raw "" SWORD FP_Tenth.Conversion 0 0 -32768 32767 ECU_ADDRESS 0x1FFFD89C PHYS_UNIT "deg C"
 /begin IF_DATA XCP
  /begin DAQ_EVENT VARIABLE /begin AVAILABLE_EVENT_LIST EVENT 0x00 EVENT 0x01 EVENT 0x02 /end AVAILABLE_EVENT_LIST /begin DEFAULT_EVENT_LIST EVENT 0x01 /end DEFAULT_EVENT_LIST /end DAQ_EVENT
 /end IF_DATA
/end MEASUREMENT
/begin MEASUREMENT EGT2 "" SLONG FP_Tenth.Conversion 0 0 -2147483648 2147483647 ECU_ADDRESS 0x1FFFD888 PHYS_UNIT "deg C"
 /begin IF_DATA XCPplus 0x0101
  /begin DAQ_EVENT FIXED_EVENT_LIST /end DAQ_EVENT
 /end IF_DATA
 /begin IF_DATA XCP
  /begin DAQ_EVENT VARIABLE /begin AVAILABLE_EVENT_LIST EVENT 0x00 EVENT 0x01 EVENT 0x02 /end AVAILABLE_EVENT_LIST /begin DEFAULT_EVENT_LIST EVENT 0x01 /end DEFAULT_EVENT_LIST /end DAQ_EVENT
 /end IF_DATA
/end MEASUREMENT
/begin CHARACTERISTIC EGT2LowPassFilter "" VALUE 0x77834 __SLong_Value 0 NO_COMPU_METHOD 0 2147483647 /end CHARACTERISTIC
/begin MEASUREMENT EGT2Raw "" SWORD FP_Tenth.Conversion 0 0 -32768 32767 ECU_ADDRESS 0x1FFFD89E PHYS_UNIT "deg C"
 /begin IF_DATA XCP
  /begin DAQ_EVENT VARIABLE /begin AVAILABLE_EVENT_LIST EVENT 0x00 EVENT 0x01 EVENT 0x02 /end AVAILABLE_EVENT_LIST /begin DEFAULT_EVENT_LIST EVENT 0x01 /end DEFAULT_EVENT_LIST /end DAQ_EVENT
 /end IF_DATA
/end MEASUREMENT
/begin CHARACTERISTIC EGTTemperatureFallback "" VALUE 0x796FC __SWord_Value 0 NO_COMPU_METHOD -32768 32767 CALIBRATION_ACCESS CALIBRATION /end CHARACTERISTIC
/begin MEASUREMENT EngineCmd "" UBYTE engineCmd_t 0 0 0 255 ECU_ADDRESS 0x1FFFD8E4
 /begin IF_DATA XCP
  /begin DAQ_EVENT VARIABLE /begin AVAILABLE_EVENT_LIST EVENT 0x00 EVENT 0x01 EVENT 0x02 /end AVAILABLE_EVENT_LIST /begin DEFAULT_EVENT_LIST EVENT 0x01 /end DEFAULT_EVENT_LIST /end DAQ_EVENT
 /end IF_DATA
/end MEASUREMENT
/begin MEASUREMENT EngineCmdCan "" UBYTE engineCmd_t 0 0 0 255 ECU_ADDRESS 0x1FFFD921 READ_WRITE
 /begin IF_DATA XCP
  /begin DAQ_EVENT VARIABLE /begin AVAILABLE_EVENT_LIST EVENT 0x00 EVENT 0x01 EVENT 0x02 /end AVAILABLE_EVENT_LIST /begin DEFAULT_EVENT_LIST EVENT 0x01 /end DEFAULT_EVENT_LIST /end DAQ_EVENT
 /end IF_DATA
/end MEASUREMENT
/begin CHARACTERISTIC EngineCmdXcp "" VALUE 0x1FFFD920 __UByte_Value 0 engineCmd_t 0 255
 /begin IF_DATA XCP
  /begin DAQ_EVENT VARIABLE /begin AVAILABLE_EVENT_LIST EVENT 0x00 EVENT 0x01 EVENT 0x02 /end AVAILABLE_EVENT_LIST /begin DEFAULT_EVENT_LIST EVENT 0x01 /end DEFAULT_EVENT_LIST /end DAQ_EVENT
 /end IF_DATA
/end CHARACTERISTIC
/begin MEASUREMENT EngineSpeed "" ULONG SAERPM.Conversion 0 0 0 4294967295 ECU_ADDRESS 0x1FFFD804 PHYS_UNIT "RPM"
 /begin IF_DATA XCP
  /begin DAQ_EVENT VARIABLE /begin AVAILABLE_EVENT_LIST EVENT 0x00 EVENT 0x01 EVENT 0x02 /end AVAILABLE_EVENT_LIST /begin DEFAULT_EVENT_LIST EVENT 0x01 /end DEFAULT_EVENT_LIST /end DAQ_EVENT
 /end IF_DATA
/end MEASUREMENT
/begin CHARACTERISTIC EngineSpeedCmdCanMax "" VALUE 0x7974C __ULong_Value 0 SAERPM.Conversion 0 10000 PHYS_UNIT "RPM" /end CHARACTERISTIC
/begin CHARACTERISTIC EngineSpeedCmdCanMin "" VALUE 0x79748 __ULong_Value 0 SAERPM.Conversion 0 10000 PHYS_UNIT "RPM" /end CHARACTERISTIC
/begin MEASUREMENT EngineSpeedTarget "" ULONG SAERPM.Conversion 0 0 0 4294967295 ECU_ADDRESS 0x1FFFD964 PHYS_UNIT "RPM"
 /begin IF_DATA XCP
  /begin DAQ_EVENT VARIABLE /begin AVAILABLE_EVENT_LIST EVENT 0x00 EVENT 0x01 EVENT 0x02 /end AVAILABLE_EVENT_LIST /begin DEFAULT_EVENT_LIST EVENT 0x01 /end DEFAULT_EVENT_LIST /end DAQ_EVENT
 /end IF_DATA
/end MEASUREMENT
/begin MEASUREMENT EngineSpeedTargetCmd "" ULONG SAERPM.Conversion 0 0 0 4294967295 ECU_ADDRESS 0x1FFFD968 PHYS_UNIT "RPM"
 /begin IF_DATA XCP
  /begin DAQ_EVENT VARIABLE /begin AVAILABLE_EVENT_LIST EVENT 0x00 EVENT 0x01 EVENT 0x02 /end AVAILABLE_EVENT_LIST /begin DEFAULT_EVENT_LIST EVENT 0x01 /end DEFAULT_EVENT_LIST /end DAQ_EVENT
 /end IF_DATA
/end MEASUREMENT
/begin MEASUREMENT EngineSpeedTargetOverride "" UBYTE binaryState_t 0 0 0 255 ECU_ADDRESS 0x1FFFD96C READ_WRITE
 /begin IF_DATA XCP
  /begin DAQ_EVENT VARIABLE /begin AVAILABLE_EVENT_LIST EVENT 0x00 EVENT 0x01 EVENT 0x02 /end AVAILABLE_EVENT_LIST /begin DEFAULT_EVENT_LIST EVENT 0x01 /end DEFAULT_EVENT_LIST /end DAQ_EVENT
 /end IF_DATA
/end MEASUREMENT
/begin MEASUREMENT EngineSpeedTargetOverrideCmd "" ULONG SAERPM.Conversion 0 0 0 4294967295 ECU_ADDRESS 0x1FFFD970 PHYS_UNIT "RPM" READ_WRITE
 /begin IF_DATA XCP
  /begin DAQ_EVENT VARIABLE /begin AVAILABLE_EVENT_LIST EVENT 0x00 EVENT 0x01 EVENT 0x02 /end AVAILABLE_EVENT_LIST /begin DEFAULT_EVENT_LIST EVENT 0x01 /end DEFAULT_EVENT_LIST /end DAQ_EVENT
 /end IF_DATA
/end MEASUREMENT
/begin CHARACTERISTIC EngineTempCompCurve "" CURVE 0x78DD0 __UWord_Value 0 NO_COMPU_METHOD 0 65535
 /begin AXIS_DESCR FIX_AXIS NO_INPUT_QUANTITY NO_COMPU_METHOD 1 0 0 FIX_AXIS_PAR_DIST 0 1 1 /end AXIS_DESCR
/end CHARACTERISTIC
/begin MEASUREMENT EngineTemperature "" SWORD FP_Tenth.Conversion 0 0 -32768 32767 ECU_ADDRESS 0x1FFFD8C2 PHYS_UNIT "deg C"
 /begin IF_DATA XCP
  /begin DAQ_EVENT VARIABLE /begin AVAILABLE_EVENT_LIST EVENT 0x00 EVENT 0x01 EVENT 0x02 /end AVAILABLE_EVENT_LIST /begin DEFAULT_EVENT_LIST EVENT 0x01 /end DEFAULT_EVENT_LIST /end DAQ_EVENT
 /end IF_DATA
/end MEASUREMENT
/begin CHARACTERISTIC ExternalCmdMax "" VALUE 0x7971C __UWord_Value 0 FP_Tenth.Conversion 0 65535 PHYS_UNIT "%" /end CHARACTERISTIC
/begin CHARACTERISTIC ExternalCmdMin "" VALUE 0x7971A __UWord_Value 0 FP_Tenth.Conversion 0 65535 PHYS_UNIT "%" /end CHARACTERISTIC
/begin MEASUREMENT ExternalCommand "" SLONG FP_Tenth.Conversion 0 0 -2147483648 2147483647 ECU_ADDRESS 0x1FFFD834 PHYS_UNIT "%"
 /begin IF_DATA XCP
  /begin DAQ_EVENT VARIABLE /begin AVAILABLE_EVENT_LIST EVENT 0x00 EVENT 0x01 EVENT 0x02 /end AVAILABLE_EVENT_LIST /begin DEFAULT_EVENT_LIST EVENT 0x01 /end DEFAULT_EVENT_LIST /end DAQ_EVENT
 /end IF_DATA
/end MEASUREMENT
/begin CHARACTERISTIC ExternalCommandInput "" CURVE 0x77634 __SLong_Value 0 FP_Thousandth.Conversion 0 5
 /begin AXIS_DESCR FIX_AXIS NO_INPUT_QUANTITY FP_Thousandth.Conversion 2 0 5000 FIX_AXIS_PAR_DIST 0 1 1 PHYS_UNIT "V" /end AXIS_DESCR
 PHYS_UNIT "V" /end CHARACTERISTIC
/begin CHARACTERISTIC ExternalCommandLowPassFilter "" VALUE 0x77644 __SLong_Value 0 NO_COMPU_METHOD -2147483648 2147483647 /end CHARACTERISTIC
/begin CHARACTERISTIC ExternalCommandOutput "" CURVE 0x7763C __SLong_Value 0 FP_Tenth.Conversion 0 100
 /begin AXIS_DESCR CURVE_AXIS ExternalCommand FP_Tenth.Conversion 2 0 100 CURVE_AXIS_REF ExternalCommandInput PHYS_UNIT "%" /end AXIS_DESCR
 PHYS_UNIT "%" /end CHARACTERISTIC
/begin MEASUREMENT ExternalCommandRaw "" UWORD FP_Tenth.Conversion 0 0 0 65535 ECU_ADDRESS 0x1FFFD838 PHYS_UNIT "%"
 /begin IF_DATA XCP
  /begin DAQ_EVENT VARIABLE /begin AVAILABLE_EVENT_LIST EVENT 0x00 EVENT 0x01 EVENT 0x02 /end AVAILABLE_EVENT_LIST /begin DEFAULT_EVENT_LIST EVENT 0x01 /end DEFAULT_EVENT_LIST /end DAQ_EVENT
 /end IF_DATA
/end MEASUREMENT
/begin CHARACTERISTIC ExternalCommandSource "" VALUE 0x79718 __UByte_Value 0 engCmdSource_t 0 255 /end CHARACTERISTIC
/begin CHARACTERISTIC ExternalControlMethod "" VALUE 0x79717 __UByte_Value 0 engCmdMethod_t 0 255 /end CHARACTERISTIC
/begin CHARACTERISTIC Flt_CrankTriggerCntRed "" VALUE 0x79664 __UWord_Value 0 NO_COMPU_METHOD 0 65535 /end CHARACTERISTIC
/begin CHARACTERISTIC Flt_CrankTriggerCntYel "" VALUE 0x79662 __UWord_Value 0 NO_COMPU_METHOD 0 65535 /end CHARACTERISTIC
/begin CHARACTERISTIC Flt_EGTBiasMaxRed "" VALUE 0x796BA __SWord_Value 0 NO_COMPU_METHOD -32768 32767 /end CHARACTERISTIC
/begin CHARACTERISTIC Flt_EGTBiasMaxYel "" VALUE 0x796B8 __SWord_Value 0 NO_COMPU_METHOD -32768 32767 /end CHARACTERISTIC
/begin AXIS_PTS Flt_EGTLimit_CHTInput_Red "" 0x796AC NO_INPUT_QUANTITY __SWord_Axis 0 NO_COMPU_METHOD 1 -32768 32767 /end AXIS_PTS
/begin AXIS_PTS Flt_EGTLimit_CHTInput_Yel "" 0x79694 NO_INPUT_QUANTITY __SWord_Axis 0 NO_COMPU_METHOD 1 -32768 32767 /end AXIS_PTS
/begin CHARACTERISTIC Flt_EGTLimit_Temp_Red "" CURVE 0x796A0 __SWord_Value 0 NO_COMPU_METHOD -32768 32767
 /begin AXIS_DESCR FIX_AXIS NO_INPUT_QUANTITY NO_COMPU_METHOD 1 0 0 FIX_AXIS_PAR_DIST 0 1 1 /end AXIS_DESCR
/end CHARACTERISTIC
/begin CHARACTERISTIC Flt_EGTLimit_Temp_Yel "" CURVE 0x79688 __SWord_Value 0 NO_COMPU_METHOD -32768 32767
 /begin AXIS_DESCR FIX_AXIS NO_INPUT_QUANTITY NO_COMPU_METHOD 1 0 0 FIX_AXIS_PAR_DIST 0 1 1 /end AXIS_DESCR
/end CHARACTERISTIC
/begin CHARACTERISTIC Flt_EngineTempBiasMaxRed "" VALUE 0x79684 __SWord_Value 0 NO_COMPU_METHOD -32768 32767 /end CHARACTERISTIC
/begin CHARACTERISTIC Flt_EngineTempBiasMaxYel "" VALUE 0x79682 __SWord_Value 0 NO_COMPU_METHOD -32768 32767 /end CHARACTERISTIC
/begin CHARACTERISTIC Flt_EngineTempMaxRed "" VALUE 0x79680 __SWord_Value 0 NO_COMPU_METHOD -32768 32767 /end CHARACTERISTIC
/begin CHARACTERISTIC Flt_EngineTempMaxYel "" VALUE 0x7967E __SWord_Value 0 NO_COMPU_METHOD -32768 32767 /end CHARACTERISTIC
/begin CHARACTERISTIC Flt_FuelPressureMaxRed "" VALUE 0x7967C __UWord_Value 0 NO_COMPU_METHOD 0 65535 /end CHARACTERISTIC
/begin CHARACTERISTIC Flt_FuelPressureMaxYel "" VALUE 0x79678 __UWord_Value 0 NO_COMPU_METHOD 0 65535 /end CHARACTERISTIC
/begin CHARACTERISTIC Flt_FuelPressureMinRed "" VALUE 0x7967A __UWord_Value 0 NO_COMPU_METHOD 0 65535 /end CHARACTERISTIC
/begin CHARACTERISTIC Flt_FuelPressureMinYel "" VALUE 0x79676 __UWord_Value 0 NO_COMPU_METHOD 0 65535 /end CHARACTERISTIC
/begin CHARACTERISTIC Flt_OilInjCurrentMaxRed "" VALUE 0x79674 __UWord_Value 0 NO_COMPU_METHOD 0 65535 /end CHARACTERISTIC
/begin CHARACTERISTIC Flt_OilInjCurrentMaxYel "" VALUE 0x79670 __UWord_Value 0 NO_COMPU_METHOD 0 65535 /end CHARACTERISTIC
/begin CHARACTERISTIC Flt_OilInjCurrentMinRed "" VALUE 0x79672 __UWord_Value 0 NO_COMPU_METHOD 0 65535 /end CHARACTERISTIC
/begin CHARACTERISTIC Flt_OilInjCurrentMinYel "" VALUE 0x7966E __UWord_Value 0 NO_COMPU_METHOD 0 65535 /end CHARACTERISTIC
/begin CHARACTERISTIC Flt_OilPressureMaxRed "" VALUE 0x7966C __UWord_Value 0 NO_COMPU_METHOD 0 65535 /end CHARACTERISTIC
/begin CHARACTERISTIC Flt_OilPressureMaxYel "" VALUE 0x79668 __UWord_Value 0 NO_COMPU_METHOD 0 65535 /end CHARACTERISTIC
/begin CHARACTERISTIC Flt_OilPressureMinRed "" VALUE 0x7966A __UWord_Value 0 NO_COMPU_METHOD 0 65535 /end CHARACTERISTIC
/begin CHARACTERISTIC Flt_OilPressureMinYel "" VALUE 0x79666 __UWord_Value 0 NO_COMPU_METHOD 0 65535 /end CHARACTERISTIC
/begin CHARACTERISTIC Flt_TpsCmdError "" VALUE 0x79660 __SWord_Value 0 NO_COMPU_METHOD -32768 32767 /end CHARACTERISTIC
/begin CHARACTERISTIC Flt_TpsFallbackCurve "" CURVE 0x796E0 __SWord_Value 0 NO_COMPU_METHOD -32768 32767
 /begin AXIS_DESCR FIX_AXIS NO_INPUT_QUANTITY NO_COMPU_METHOD 1 0 0 FIX_AXIS_PAR_DIST 0 1 1 /end AXIS_DESCR
/end CHARACTERISTIC
/begin CHARACTERISTIC Flt_TpsLimitPropCurveActive "" VALUE 0x796F8 __UByte_Value 0 binaryState_t 0 255 CALIBRATION_ACCESS CALIBRATION /end CHARACTERISTIC
/begin CHARACTERISTIC Flt_TpsMaxValCurve "" CURVE 0x796EC __SWord_Value 0 NO_COMPU_METHOD -32768 32767
 /begin AXIS_DESCR FIX_AXIS NO_INPUT_QUANTITY NO_COMPU_METHOD 1 0 0 FIX_AXIS_PAR_DIST 0 1 1 /end AXIS_DESCR
/end CHARACTERISTIC
/begin CHARACTERISTIC Flt_TpsMinValCurve "" CURVE 0x796D4 __SWord_Value 0 NO_COMPU_METHOD -32768 32767
 /begin AXIS_DESCR FIX_AXIS NO_INPUT_QUANTITY NO_COMPU_METHOD 1 0 0 FIX_AXIS_PAR_DIST 0 1 1 /end AXIS_DESCR
/end CHARACTERISTIC
/begin AXIS_PTS Flt_TpsRpmScale "" 0x796BC NO_INPUT_QUANTITY __ULong_Axis 0 NO_COMPU_METHOD 1 0 4294967295 /end AXIS_PTS
/begin CHARACTERISTIC FlywheelMissingTeeth "" VALUE 0x7706C __ULong_Value 0 NO_COMPU_METHOD 1 2 /end CHARACTERISTIC
/begin CHARACTERISTIC FlywheelTeeth "" VALUE 0x77068 __ULong_Value 0 NO_COMPU_METHOD 16 60 /end CHARACTERISTIC
/begin MEASUREMENT FuelAirDensityComp "" SWORD FP_Tenth.Conversion 0 0 -32768 32767 ECU_ADDRESS 0x1FFFD8B2 PHYS_UNIT "%"
 /begin IF_DATA XCP
  /begin DAQ_EVENT VARIABLE /begin AVAILABLE_EVENT_LIST EVENT 0x00 EVENT 0x01 EVENT 0x02 /end AVAILABLE_EVENT_LIST /begin DEFAULT_EVENT_LIST EVENT 0x01 /end DEFAULT_EVENT_LIST /end DAQ_EVENT
 /end IF_DATA
/end MEASUREMENT
/begin MEASUREMENT FuelBias_Inj2 "" SWORD FP_Tenth.Conversion 0 0 -32768 32767 ECU_ADDRESS 0x1FFFD8B0 PHYS_UNIT "%"
 /begin IF_DATA XCP
  /begin DAQ_EVENT VARIABLE /begin AVAILABLE_EVENT_LIST EVENT 0x00 EVENT 0x01 EVENT 0x02 /end AVAILABLE_EVENT_LIST /begin DEFAULT_EVENT_LIST EVENT 0x01 /end DEFAULT_EVENT_LIST /end DAQ_EVENT
 /end IF_DATA
/end MEASUREMENT
/begin MEASUREMENT FuelConsumption "" ULONG FP_Thousandth.Conversion 0 0 0 4294967295 ECU_ADDRESS 0x1FFFD950 PHYS_UNIT "L"
 /begin IF_DATA XCP
  /begin DAQ_EVENT VARIABLE /begin AVAILABLE_EVENT_LIST EVENT 0x00 EVENT 0x01 EVENT 0x02 /end AVAILABLE_EVENT_LIST /begin DEFAULT_EVENT_LIST EVENT 0x01 /end DEFAULT_EVENT_LIST /end DAQ_EVENT
 /end IF_DATA
/end MEASUREMENT
/begin MEASUREMENT FuelDensity "" UWORD NO_COMPU_METHOD 0 0 0 65535 ECU_ADDRESS 0x1FFFD93C PHYS_UNIT "g/L"
 /begin IF_DATA XCP
  /begin DAQ_EVENT VARIABLE /begin AVAILABLE_EVENT_LIST EVENT 0x00 EVENT 0x01 EVENT 0x02 /end AVAILABLE_EVENT_LIST /begin DEFAULT_EVENT_LIST EVENT 0x01 /end DEFAULT_EVENT_LIST /end DAQ_EVENT
 /end IF_DATA
/end MEASUREMENT
/begin CHARACTERISTIC FuelDensityTable "" CURVE 0x79578 __UWord_Value 0 NO_COMPU_METHOD 0 65535
 /begin AXIS_DESCR COM_AXIS FuelTemperature FP_Tenth.Conversion 6 0 0 AXIS_PTS_REF InjFuelTempScale PHYS_UNIT "deg C" /end AXIS_DESCR
 PHYS_UNIT "g/L" /end CHARACTERISTIC
/begin MEASUREMENT FuelEngTempComp "" SWORD FP_Tenth.Conversion 0 0 -32768 32767 ECU_ADDRESS 0x1FFFD8C4 PHYS_UNIT "%"
 /begin IF_DATA XCP
  /begin DAQ_EVENT VARIABLE /begin AVAILABLE_EVENT_LIST EVENT 0x00 EVENT 0x01 EVENT 0x02 /end AVAILABLE_EVENT_LIST /begin DEFAULT_EVENT_LIST EVENT 0x01 /end DEFAULT_EVENT_LIST /end DAQ_EVENT
 /end IF_DATA
/end MEASUREMENT
/begin CHARACTERISTIC FuelMap1_InjectionTiming "" MAP 0x77D18 __SWord_Value 0 FP_Tenth.Conversion -180 180
 /begin AXIS_DESCR COM_AXIS EngineSpeed SAERPM.Conversion 20 0 0 AXIS_PTS_REF RpmScale PHYS_UNIT "RPM" /end AXIS_DESCR
 /begin AXIS_DESCR COM_AXIS ThrottlePositionSetPoint FP_Tenth.Conversion 15 0 0 AXIS_PTS_REF ThrottleScale PHYS_UNIT "%" /end AXIS_DESCR
 PHYS_UNIT "deg" /end CHARACTERISTIC
/begin CHARACTERISTIC FuelMap1_Throt "" MAP 0x77868 __UWord_Value 0 FP_Hundredth.Conversion 0 600
 /begin AXIS_DESCR COM_AXIS EngineSpeed SAERPM.Conversion 20 0 13000 AXIS_PTS_REF RpmScale PHYS_UNIT "RPM" /end AXIS_DESCR
 /begin AXIS_DESCR COM_AXIS ThrottlePositionSetPoint FP_Tenth.Conversion 15 0 0 AXIS_PTS_REF ThrottleScale PHYS_UNIT "%" /end AXIS_DESCR
 PHYS_UNIT "mm3/str" /end CHARACTERISTIC
/begin CHARACTERISTIC FuelMap2_InjectionTiming_Offset "" MAP 0x77F70 __SWord_Value 0 FP_Tenth.Conversion -180 180
 /begin AXIS_DESCR COM_AXIS EngineSpeed SAERPM.Conversion 20 0 0 AXIS_PTS_REF RpmScale PHYS_UNIT "RPM" /end AXIS_DESCR
 /begin AXIS_DESCR COM_AXIS ThrottlePositionSetPoint FP_Tenth.Conversion 15 0 0 AXIS_PTS_REF ThrottleScale PHYS_UNIT "%" /end AXIS_DESCR
 PHYS_UNIT "deg" /end CHARACTERISTIC
/begin CHARACTERISTIC FuelMap2_ThrotOffset "" MAP 0x77AC0 __UWord_Value 0 FP_Hundredth.Conversion 0 600
 /begin AXIS_DESCR COM_AXIS EngineSpeed SAERPM.Conversion 20 0 0 AXIS_PTS_REF RpmScale PHYS_UNIT "RPM" /end AXIS_DESCR
 /begin AXIS_DESCR COM_AXIS ThrottlePositionSetPoint FP_Tenth.Conversion 15 0 0 AXIS_PTS_REF ThrottleScale PHYS_UNIT "%" /end AXIS_DESCR
 PHYS_UNIT "mm3/str" /end CHARACTERISTIC
/begin CHARACTERISTIC FuelMap3_InjectionTiming_Offset "" MAP 0x781C8 __SWord_Value 0 FP_Tenth.Conversion -180 180
 /begin AXIS_DESCR COM_AXIS EngineSpeed SAERPM.Conversion 20 0 0 AXIS_PTS_REF RpmScale PHYS_UNIT "RPM" /end AXIS_DESCR
 /begin AXIS_DESCR COM_AXIS ThrottlePositionSetPoint FP_Tenth.Conversion 15 0 0 AXIS_PTS_REF ThrottleScale PHYS_UNIT "%" /end AXIS_DESCR
 PHYS_UNIT "deg" /end CHARACTERISTIC
/begin MEASUREMENT FuelMapValue "" UWORD FP_Hundredth.Conversion 0 0 0 65535 ECU_ADDRESS 0x1FFFD8AE PHYS_UNIT "mm3/str"
 /begin IF_DATA XCP
  /begin DAQ_EVENT VARIABLE /begin AVAILABLE_EVENT_LIST EVENT 0x00 EVENT 0x01 EVENT 0x02 /end AVAILABLE_EVENT_LIST /begin DEFAULT_EVENT_LIST EVENT 0x01 /end DEFAULT_EVENT_LIST /end DAQ_EVENT
 /end IF_DATA
/end MEASUREMENT
/begin MEASUREMENT FuelMassFlowRate "" ULONG FP_Tenth.Conversion 0 0 0 4294967295 ECU_ADDRESS 0x1FFFD958 PHYS_UNIT "g/min"
 /begin IF_DATA XCP
  /begin DAQ_EVENT VARIABLE /begin AVAILABLE_EVENT_LIST EVENT 0x00 EVENT 0x01 EVENT 0x02 /end AVAILABLE_EVENT_LIST /begin DEFAULT_EVENT_LIST EVENT 0x01 /end DEFAULT_EVENT_LIST /end DAQ_EVENT
 /end IF_DATA
/end MEASUREMENT
/begin MEASUREMENT FuelNosEnrichment "" UWORD FP_Hundredth.Conversion 0 0 0 600 ECU_ADDRESS 0x1FFFD930 PHYS_UNIT "mm3/str"
 /begin IF_DATA XCP
  /begin DAQ_EVENT VARIABLE /begin AVAILABLE_EVENT_LIST EVENT 0x00 EVENT 0x01 EVENT 0x02 /end AVAILABLE_EVENT_LIST /begin DEFAULT_EVENT_LIST EVENT 0x01 /end DEFAULT_EVENT_LIST /end DAQ_EVENT
 /end IF_DATA
/end MEASUREMENT
/begin MEASUREMENT FuelOffset "" SWORD FP_Tenth.Conversion 0 0 -32768 32767 ECU_ADDRESS 0x1FFFD97A PHYS_UNIT "%" READ_WRITE
 /begin IF_DATA XCP
  /begin DAQ_EVENT VARIABLE /begin AVAILABLE_EVENT_LIST EVENT 0x00 EVENT 0x01 EVENT 0x02 /end AVAILABLE_EVENT_LIST /begin DEFAULT_EVENT_LIST EVENT 0x01 /end DEFAULT_EVENT_LIST /end DAQ_EVENT
 /end IF_DATA
/end MEASUREMENT
/begin MEASUREMENT FuelOnTimeComp "" SWORD FP_Tenth.Conversion 0 0 -32768 32767 ECU_ADDRESS 0x1FFFD8B4 PHYS_UNIT "%"
 /begin IF_DATA XCP
  /begin DAQ_EVENT VARIABLE /begin AVAILABLE_EVENT_LIST EVENT 0x00 EVENT 0x01 EVENT 0x02 /end AVAILABLE_EVENT_LIST /begin DEFAULT_EVENT_LIST EVENT 0x01 /end DEFAULT_EVENT_LIST /end DAQ_EVENT
 /end IF_DATA
/end MEASUREMENT
/begin MEASUREMENT FuelPressure "" SLONG FP_Thousandth.Conversion 0 0 -2147483648 2147483647 ECU_ADDRESS 0x1FFFD85C PHYS_UNIT "bar"
 /begin IF_DATA XCP
  /begin DAQ_EVENT VARIABLE /begin AVAILABLE_EVENT_LIST EVENT 0x00 EVENT 0x01 EVENT 0x02 /end AVAILABLE_EVENT_LIST /begin DEFAULT_EVENT_LIST EVENT 0x01 /end DEFAULT_EVENT_LIST /end DAQ_EVENT
 /end IF_DATA
/end MEASUREMENT
/begin AXIS_PTS FuelPressureInput "" 0x776AC NO_INPUT_QUANTITY FuelPressureInput.RecordLayout 0 FP_Thousandth.Conversion 2 0 5 PHYS_UNIT "V" /end AXIS_PTS
/begin CHARACTERISTIC FuelPressureLowPassFilter "" VALUE 0x776BC __SLong_Value 0 NO_COMPU_METHOD -2147483648 2147483647 /end CHARACTERISTIC
/begin CHARACTERISTIC FuelPressureOutput "" CURVE 0x776B4 __SLong_Value 0 NO_COMPU_METHOD -2147483648 2147483647
 /begin AXIS_DESCR COM_AXIS NO_INPUT_QUANTITY NO_COMPU_METHOD 2 0 0 AXIS_PTS_REF FuelPressureInput /end AXIS_DESCR
 PHYS_UNIT "mbar" /end CHARACTERISTIC
/begin MEASUREMENT FuelPressureRaw "" UWORD FP_Thousandth.Conversion 0 0 0 65535 ECU_ADDRESS 0x1FFFD860 PHYS_UNIT "bar"
 /begin IF_DATA XCP
  /begin DAQ_EVENT VARIABLE /begin AVAILABLE_EVENT_LIST EVENT 0x00 EVENT 0x01 EVENT 0x02 /end AVAILABLE_EVENT_LIST /begin DEFAULT_EVENT_LIST EVENT 0x01 /end DEFAULT_EVENT_LIST /end DAQ_EVENT
 /end IF_DATA
/end MEASUREMENT
/begin CHARACTERISTIC FuelPressureTarget "" VALUE 0x7709C __UWord_Value 0 NO_COMPU_METHOD 0 10000 PHYS_UNIT "mbar" /end CHARACTERISTIC
/begin CHARACTERISTIC FuelPumpControlMethod "" VALUE 0x79716 __UByte_Value 0 pumpControlMethod_t 0 255 /end CHARACTERISTIC
/begin CHARACTERISTIC FuelPumpFallback "" VALUE 0x79704 __UWord_Value 0 NO_COMPU_METHOD 0 65535 CALIBRATION_ACCESS CALIBRATION /end CHARACTERISTIC
/begin CHARACTERISTIC FuelPumpInteg "" VALUE 0x77240 __SLong_Value 0 NO_COMPU_METHOD 0 2147483647 /end CHARACTERISTIC
/begin MEASUREMENT FuelPumpNPSH "" SWORD NO_COMPU_METHOD 0 0 0 65535 ECU_ADDRESS 0x1FFFD940 PHYS_UNIT "mbar"
 /begin IF_DATA XCP
  /begin DAQ_EVENT VARIABLE /begin AVAILABLE_EVENT_LIST EVENT 0x00 EVENT 0x01 EVENT 0x02 /end AVAILABLE_EVENT_LIST /begin DEFAULT_EVENT_LIST EVENT 0x01 /end DEFAULT_EVENT_LIST /end DAQ_EVENT
 /end IF_DATA
/end MEASUREMENT
/begin CHARACTERISTIC FuelPumpPrimeTime "" VALUE 0x79586 __UWord_Value 0 FP_Thousandth.Conversion 0 65535 PHYS_UNIT "s" /end CHARACTERISTIC
/begin CHARACTERISTIC FuelPumpProp "" VALUE 0x7723C __SLong_Value 0 NO_COMPU_METHOD 0 2147483647 /end CHARACTERISTIC
/begin AXIS_PTS FuelQtyScale "" 0x7721C NO_INPUT_QUANTITY __UWord_Axis 0 FP_Hundredth.Conversion 15 0 500 PHYS_UNIT "mm3/str" /end AXIS_PTS
/begin MEASUREMENT FuelQty_Inj1 "" UWORD FP_Hundredth.Conversion 0 0 0 65535 ECU_ADDRESS 0x1FFFD8B6 PHYS_UNIT "mm3/str"
 /begin IF_DATA XCP
  /begin DAQ_EVENT VARIABLE /begin AVAILABLE_EVENT_LIST EVENT 0x00 EVENT 0x01 EVENT 0x02 /end AVAILABLE_EVENT_LIST /begin DEFAULT_EVENT_LIST EVENT 0x01 /end DEFAULT_EVENT_LIST /end DAQ_EVENT
 /end IF_DATA
/end MEASUREMENT
/begin MEASUREMENT FuelQty_Inj2 "" UWORD FP_Hundredth.Conversion 0 0 0 65535 ECU_ADDRESS 0x1FFFD8B8 PHYS_UNIT "mm3/str"
 /begin IF_DATA XCP
  /begin DAQ_EVENT VARIABLE /begin AVAILABLE_EVENT_LIST EVENT 0x00 EVENT 0x01 EVENT 0x02 /end AVAILABLE_EVENT_LIST /begin DEFAULT_EVENT_LIST EVENT 0x01 /end DEFAULT_EVENT_LIST /end DAQ_EVENT
 /end IF_DATA
/end MEASUREMENT
/begin MEASUREMENT FuelQty_Inj3 "" UWORD FP_Hundredth.Conversion 0 0 0 65535 ECU_ADDRESS 0x1FFFD8BA PHYS_UNIT "mm3/str"
 /begin IF_DATA XCP
  /begin DAQ_EVENT VARIABLE /begin AVAILABLE_EVENT_LIST EVENT 0x00 EVENT 0x01 EVENT 0x02 /end AVAILABLE_EVENT_LIST /begin DEFAULT_EVENT_LIST EVENT 0x01 /end DEFAULT_EVENT_LIST /end DAQ_EVENT
 /end IF_DATA
/end MEASUREMENT
/begin MEASUREMENT FuelQty_Total "" UWORD FP_Hundredth.Conversion 0 0 0 65535 ECU_ADDRESS 0x1FFFD8FC PHYS_UNIT "mm3/cycle"
 /begin IF_DATA XCP
  /begin DAQ_EVENT VARIABLE /begin AVAILABLE_EVENT_LIST EVENT 0x00 EVENT 0x01 EVENT 0x02 /end AVAILABLE_EVENT_LIST /begin DEFAULT_EVENT_LIST EVENT 0x01 /end DEFAULT_EVENT_LIST /end DAQ_EVENT
 /end IF_DATA
/end MEASUREMENT
/begin CHARACTERISTIC FuelTempFallback "" VALUE 0x79700 __SWord_Value 0 NO_COMPU_METHOD -32768 32767 CALIBRATION_ACCESS CALIBRATION /end CHARACTERISTIC
/begin CHARACTERISTIC FuelTempLowPassFilter "" VALUE 0x7782C __SLong_Value 0 NO_COMPU_METHOD 0 2147483647 /end CHARACTERISTIC
/begin CHARACTERISTIC FuelTempResistance "" CURVE 0x7778C __SLong_Value 0 NO_COMPU_METHOD 1 200000
 /begin AXIS_DESCR FIX_AXIS NO_INPUT_QUANTITY NO_COMPU_METHOD 1 0 0 FIX_AXIS_PAR_DIST 0 1 1 /end AXIS_DESCR
 PHYS_UNIT "Ohm" /end CHARACTERISTIC
/begin CHARACTERISTIC FuelTempScale "" CURVE 0x777DC __SLong_Value 0 NO_COMPU_METHOD -70 1000
 /begin AXIS_DESCR FIX_AXIS NO_INPUT_QUANTITY NO_COMPU_METHOD 1 0 0 FIX_AXIS_PAR_DIST 0 1 1 /end AXIS_DESCR
 PHYS_UNIT "deg C" /end CHARACTERISTIC
/begin MEASUREMENT FuelTemperature "" SLONG FP_Tenth.Conversion 0 0 -2147483648 2147483647 ECU_ADDRESS 0x1FFFD87C PHYS_UNIT "deg C"
 /begin IF_DATA XCP
  /begin DAQ_EVENT VARIABLE /begin AVAILABLE_EVENT_LIST EVENT 0x00 EVENT 0x01 EVENT 0x02 /end AVAILABLE_EVENT_LIST /begin DEFAULT_EVENT_LIST EVENT 0x01 /end DEFAULT_EVENT_LIST /end DAQ_EVENT
 /end IF_DATA
/end MEASUREMENT
/begin MEASUREMENT FuelTemperatureRaw "" SWORD FP_Tenth.Conversion 0 0 -32768 32767 ECU_ADDRESS 0x1FFFD880 PHYS_UNIT "deg C"
 /begin IF_DATA XCP
  /begin DAQ_EVENT VARIABLE /begin AVAILABLE_EVENT_LIST EVENT 0x00 EVENT 0x01 EVENT 0x02 /end AVAILABLE_EVENT_LIST /begin DEFAULT_EVENT_LIST EVENT 0x01 /end DEFAULT_EVENT_LIST /end DAQ_EVENT
 /end IF_DATA
/end MEASUREMENT
/begin MEASUREMENT FuelTiming_Inj1 "" SWORD FP_Tenth.Conversion 0 0 -32768 32767 ECU_ADDRESS 0x1FFFD8BC PHYS_UNIT "deg"
 /begin IF_DATA XCP
  /begin DAQ_EVENT VARIABLE /begin AVAILABLE_EVENT_LIST EVENT 0x00 EVENT 0x01 EVENT 0x02 /end AVAILABLE_EVENT_LIST /begin DEFAULT_EVENT_LIST EVENT 0x01 /end DEFAULT_EVENT_LIST /end DAQ_EVENT
 /end IF_DATA
/end MEASUREMENT
/begin MEASUREMENT FuelTiming_Inj2 "" SWORD FP_Tenth.Conversion 0 0 -32768 32767 ECU_ADDRESS 0x1FFFD8BE PHYS_UNIT "deg"
 /begin IF_DATA XCP
  /begin DAQ_EVENT VARIABLE /begin AVAILABLE_EVENT_LIST EVENT 0x00 EVENT 0x01 EVENT 0x02 /end AVAILABLE_EVENT_LIST /begin DEFAULT_EVENT_LIST EVENT 0x01 /end DEFAULT_EVENT_LIST /end DAQ_EVENT
 /end IF_DATA
/end MEASUREMENT
/begin MEASUREMENT FuelTiming_Inj3 "" SWORD FP_Tenth.Conversion 0 0 -32768 32767 ECU_ADDRESS 0x1FFFD8C0 PHYS_UNIT "deg"
 /begin IF_DATA XCP
  /begin DAQ_EVENT VARIABLE /begin AVAILABLE_EVENT_LIST EVENT 0x00 EVENT 0x01 EVENT 0x02 /end AVAILABLE_EVENT_LIST /begin DEFAULT_EVENT_LIST EVENT 0x01 /end DEFAULT_EVENT_LIST /end DAQ_EVENT
 /end IF_DATA
/end MEASUREMENT
/begin MEASUREMENT FuelVaporPressure "" UWORD NO_COMPU_METHOD 0 0 0 65535 ECU_ADDRESS 0x1FFFD94A
 /begin IF_DATA XCP
  /begin DAQ_EVENT VARIABLE /begin AVAILABLE_EVENT_LIST EVENT 0x00 EVENT 0x01 EVENT 0x02 /end AVAILABLE_EVENT_LIST /begin DEFAULT_EVENT_LIST EVENT 0x01 /end DEFAULT_EVENT_LIST /end DAQ_EVENT
 /end IF_DATA
/end MEASUREMENT
/begin CHARACTERISTIC FuelVaporPressureCurve "" CURVE 0x79588 __UWord_Value 0 NO_COMPU_METHOD 0 65535
 /begin AXIS_DESCR COM_AXIS FuelTemperature NO_COMPU_METHOD 6 0 0 AXIS_PTS_REF FuelVaporTempCurve /end AXIS_DESCR
/end CHARACTERISTIC
/begin AXIS_PTS FuelVaporTempCurve "" 0x7964C FuelTemperature __UWord_Axis 0 FP_Tenth.Conversion 6 0 65535 PHYS_UNIT "deg C" /end AXIS_PTS
/begin MEASUREMENT FuelVolumeFlowRate "" ULONG NO_COMPU_METHOD 0 0 0 4294967295 ECU_ADDRESS 0x1FFFD954 PHYS_UNIT "cc/min"
 /begin IF_DATA XCP
  /begin DAQ_EVENT VARIABLE /begin AVAILABLE_EVENT_LIST EVENT 0x00 EVENT 0x01 EVENT 0x02 /end AVAILABLE_EVENT_LIST /begin DEFAULT_EVENT_LIST EVENT 0x01 /end DEFAULT_EVENT_LIST /end DAQ_EVENT
 /end IF_DATA
/end MEASUREMENT
/begin MEASUREMENT Heater1_State "" UBYTE binaryState_t 0 0 0 255 ECU_ADDRESS 0x1FFFD938
 /begin IF_DATA XCP
  /begin DAQ_EVENT VARIABLE /begin AVAILABLE_EVENT_LIST EVENT 0x00 EVENT 0x01 EVENT 0x02 /end AVAILABLE_EVENT_LIST /begin DEFAULT_EVENT_LIST EVENT 0x01 /end DEFAULT_EVENT_LIST /end DAQ_EVENT
 /end IF_DATA
/end MEASUREMENT
/begin MEASUREMENT Heater2_State "" UBYTE binaryState_t 0 0 0 255 ECU_ADDRESS 0x1FFFD939
 /begin IF_DATA XCP
  /begin DAQ_EVENT VARIABLE /begin AVAILABLE_EVENT_LIST EVENT 0x00 EVENT 0x01 EVENT 0x02 /end AVAILABLE_EVENT_LIST /begin DEFAULT_EVENT_LIST EVENT 0x01 /end DEFAULT_EVENT_LIST /end DAQ_EVENT
 /end IF_DATA
/end MEASUREMENT
/begin MEASUREMENT Heater3_State "" UBYTE binaryState_t 0 0 0 255 ECU_ADDRESS 0x1FFFD93A
 /begin IF_DATA XCP
  /begin DAQ_EVENT VARIABLE /begin AVAILABLE_EVENT_LIST EVENT 0x00 EVENT 0x01 EVENT 0x02 /end AVAILABLE_EVENT_LIST /begin DEFAULT_EVENT_LIST EVENT 0x01 /end DEFAULT_EVENT_LIST /end DAQ_EVENT
 /end IF_DATA
/end MEASUREMENT
/begin CHARACTERISTIC IBoost "" VALUE 0x79028 __UWord_Value 0 NO_COMPU_METHOD 0 65535 /end CHARACTERISTIC
/begin CHARACTERISTIC IHold_FPRV "" VALUE 0x79030 __UWord_Value 0 NO_COMPU_METHOD 0 65535 /end CHARACTERISTIC
/begin CHARACTERISTIC IHold_Injector "" VALUE 0x7902C __UWord_Value 0 NO_COMPU_METHOD 0 65535 /end CHARACTERISTIC
/begin CHARACTERISTIC IPeak "" VALUE 0x7902A __UWord_Value 0 NO_COMPU_METHOD 0 65535 /end CHARACTERISTIC
/begin MEASUREMENT Inj1_Duration "" UWORD FP_Thousandth.Conversion 0 0 0 65535 ECU_ADDRESS 0x1FFFD8C6 PHYS_UNIT "ms"
 /begin IF_DATA XCP
  /begin DAQ_EVENT VARIABLE /begin AVAILABLE_EVENT_LIST EVENT 0x00 EVENT 0x01 EVENT 0x02 /end AVAILABLE_EVENT_LIST /begin DEFAULT_EVENT_LIST EVENT 0x01 /end DEFAULT_EVENT_LIST /end DAQ_EVENT
 /end IF_DATA
/end MEASUREMENT
/begin MEASUREMENT Inj2_Duration "" UWORD FP_Thousandth.Conversion 0 0 0 65535 ECU_ADDRESS 0x1FFFD8C8 PHYS_UNIT "ms"
 /begin IF_DATA XCP
  /begin DAQ_EVENT VARIABLE /begin AVAILABLE_EVENT_LIST EVENT 0x00 EVENT 0x01 EVENT 0x02 /end AVAILABLE_EVENT_LIST /begin DEFAULT_EVENT_LIST EVENT 0x01 /end DEFAULT_EVENT_LIST /end DAQ_EVENT
 /end IF_DATA
/end MEASUREMENT
/begin MEASUREMENT Inj3_Duration "" UWORD FP_Thousandth.Conversion 0 0 0 65535 ECU_ADDRESS 0x1FFFD8CA PHYS_UNIT "ms"
 /begin IF_DATA XCP
  /begin DAQ_EVENT VARIABLE /begin AVAILABLE_EVENT_LIST EVENT 0x00 EVENT 0x01 EVENT 0x02 /end AVAILABLE_EVENT_LIST /begin DEFAULT_EVENT_LIST EVENT 0x01 /end DEFAULT_EVENT_LIST /end DAQ_EVENT
 /end IF_DATA
/end MEASUREMENT
/begin CHARACTERISTIC InjDurVoltCorr "" CURVE 0x78EAC __SWord_Value 0 FP_Thousandth.Conversion -32768 32767
 /begin AXIS_DESCR COM_AXIS SystemVoltage FP_Thousandth.Conversion 15 0 0 AXIS_PTS_REF VoltageScale PHYS_UNIT "ms" /end AXIS_DESCR
 PHYS_UNIT "ms" /end CHARACTERISTIC
/begin AXIS_PTS InjFuelPressureScale "" 0x79540 NO_INPUT_QUANTITY __SLong_Axis 0 NO_COMPU_METHOD 5 0 2147483647 PHYS_UNIT "mbar" /end AXIS_PTS
/begin CHARACTERISTIC InjFuelTempCompActive "" VALUE 0x79585 __UByte_Value 0 binaryState_t 0 255 /end CHARACTERISTIC
/begin CHARACTERISTIC InjFuelTempCorrection "" CURVE 0x79554 __SLong_Value 0 FP_Tenth.Conversion -2147483648 2147483647
 /begin AXIS_DESCR COM_AXIS FuelTemperature FP_Tenth.Conversion 6 0 0 AXIS_PTS_REF InjFuelTempScale PHYS_UNIT "deg C" /end AXIS_DESCR
 PHYS_UNIT "%" /end CHARACTERISTIC
/begin AXIS_PTS InjFuelTempScale "" 0x7956C NO_INPUT_QUANTITY __SWord_Axis 0 FP_Tenth.Conversion 6 -32768 32767 PHYS_UNIT "deg C" /end AXIS_PTS
/begin MEASUREMENT InjVoltComp "" SWORD FP_Thousandth.Conversion 0 0 -32768 32767 ECU_ADDRESS 0x1FFFD93E PHYS_UNIT "ms"
 /begin IF_DATA XCP
  /begin DAQ_EVENT VARIABLE /begin AVAILABLE_EVENT_LIST EVENT 0x00 EVENT 0x01 EVENT 0x02 /end AVAILABLE_EVENT_LIST /begin DEFAULT_EVENT_LIST EVENT 0x01 /end DEFAULT_EVENT_LIST /end DAQ_EVENT
 /end IF_DATA
/end MEASUREMENT
/begin CHARACTERISTIC InjVoltCompActive "" VALUE 0x79584 __UByte_Value 0 binaryState_t 0 255 /end CHARACTERISTIC
/begin CHARACTERISTIC Inj_Ihold "" VALUE 0x78EA8 __UWord_Value 0 FP_Hundredth.Conversion 0 65535 PHYS_UNIT "A" /end CHARACTERISTIC
/begin CHARACTERISTIC Inj_Ipeak "" VALUE 0x78EA6 __UWord_Value 0 FP_Thousandth.Conversion 0 65535 PHYS_UNIT "A" /end CHARACTERISTIC
/begin CHARACTERISTIC InjectionTriggering "" VALUE 0x77864 __UByte_Value 0 injTrigger_t 0 255 /end CHARACTERISTIC
/begin CHARACTERISTIC InjectorCalMap "" MAP 0x78DF0 __UWord_Value 0 FP_Thousandth.Conversion 0 65535
 /begin AXIS_DESCR COM_AXIS NO_INPUT_QUANTITY FP_Hundredth.Conversion 15 0 0 AXIS_PTS_REF InjectorQtyScale PHYS_UNIT "mm3/str" /end AXIS_DESCR
 /begin AXIS_DESCR COM_AXIS NO_INPUT_QUANTITY NO_COMPU_METHOD 5 0 0 AXIS_PTS_REF InjFuelPressureScale PHYS_UNIT "mbar" /end AXIS_DESCR
 PHYS_UNIT "ms" /end CHARACTERISTIC
/begin CHARACTERISTIC InjectorCount "" VALUE 0x78F5C __UWord_Value 0 NO_COMPU_METHOD 0 65535 /end CHARACTERISTIC
/begin MEASUREMENT InjectorLockout "" UBYTE binaryState_t 0 0 0 255 ECU_ADDRESS 0x1FFFD91A READ_WRITE
 /begin IF_DATA XCP
  /begin DAQ_EVENT VARIABLE /begin AVAILABLE_EVENT_LIST EVENT 0x00 EVENT 0x01 EVENT 0x02 /end AVAILABLE_EVENT_LIST /begin DEFAULT_EVENT_LIST EVENT 0x01 /end DEFAULT_EVENT_LIST /end DAQ_EVENT
 /end IF_DATA
/end MEASUREMENT
/begin AXIS_PTS InjectorQtyScale "" 0x78E88 NO_INPUT_QUANTITY __UWord_Axis 0 FP_Hundredth.Conversion 15 0 65535 PHYS_UNIT "mm3/str" /end AXIS_PTS
/begin MEASUREMENT InjectorTmrOffset "" ULONG NO_COMPU_METHOD 0 0 0 4294967295 ECU_ADDRESS 0x200007DC MATRIX_DIM 1
 /begin IF_DATA XCP
  /begin DAQ_EVENT VARIABLE /begin AVAILABLE_EVENT_LIST EVENT 0x00 EVENT 0x01 EVENT 0x02 /end AVAILABLE_EVENT_LIST /begin DEFAULT_EVENT_LIST EVENT 0x01 /end DEFAULT_EVENT_LIST /end DAQ_EVENT
 /end IF_DATA
/end MEASUREMENT
/begin MEASUREMENT InjectorTooth "" ULONG NO_COMPU_METHOD 0 0 0 4294967295 ECU_ADDRESS 0x20000828 MATRIX_DIM 1
 /begin IF_DATA XCP
  /begin DAQ_EVENT VARIABLE /begin AVAILABLE_EVENT_LIST EVENT 0x00 EVENT 0x01 EVENT 0x02 /end AVAILABLE_EVENT_LIST /begin DEFAULT_EVENT_LIST EVENT 0x01 /end DEFAULT_EVENT_LIST /end DAQ_EVENT
 /end IF_DATA
/end MEASUREMENT
/begin MEASUREMENT InstanceRunTime "" ULONG InstanceRunTime.Conversion 0 0 0 4294967295 ECU_ADDRESS 0x1FFFD8E0
 /begin IF_DATA XCP
  /begin DAQ_EVENT VARIABLE /begin AVAILABLE_EVENT_LIST EVENT 0x00 EVENT 0x01 EVENT 0x02 /end AVAILABLE_EVENT_LIST /begin DEFAULT_EVENT_LIST EVENT 0x01 /end DEFAULT_EVENT_LIST /end DAQ_EVENT
 /end IF_DATA
/end MEASUREMENT
/begin CHARACTERISTIC IntegMap "" MAP 0x772B0 __UWord_Value 0 NO_COMPU_METHOD 0 65535
 /begin AXIS_DESCR FIX_AXIS NO_INPUT_QUANTITY NO_COMPU_METHOD 1 0 0 FIX_AXIS_PAR_DIST 0 1 1 /end AXIS_DESCR
 /begin AXIS_DESCR FIX_AXIS NO_INPUT_QUANTITY NO_COMPU_METHOD 1 0 0 FIX_AXIS_PAR_DIST 0 1 1 /end AXIS_DESCR
/end CHARACTERISTIC
/begin MEASUREMENT Kd "" SLONG NO_COMPU_METHOD 0 0 -2147483648 2147483647 ECU_ADDRESS 0x1FFFD814
 /begin IF_DATA XCP
  /begin DAQ_EVENT VARIABLE /begin AVAILABLE_EVENT_LIST EVENT 0x00 EVENT 0x01 EVENT 0x02 /end AVAILABLE_EVENT_LIST /begin DEFAULT_EVENT_LIST EVENT 0x01 /end DEFAULT_EVENT_LIST /end DAQ_EVENT
 /end IF_DATA
/end MEASUREMENT
/begin MEASUREMENT Ki "" SLONG NO_COMPU_METHOD 0 0 -2147483648 2147483647 ECU_ADDRESS 0x1FFFD810
 /begin IF_DATA XCP
  /begin DAQ_EVENT VARIABLE /begin AVAILABLE_EVENT_LIST EVENT 0x00 EVENT 0x01 EVENT 0x02 /end AVAILABLE_EVENT_LIST /begin DEFAULT_EVENT_LIST EVENT 0x01 /end DEFAULT_EVENT_LIST /end DAQ_EVENT
 /end IF_DATA
/end MEASUREMENT
/begin MEASUREMENT Kp "" SLONG NO_COMPU_METHOD 0 0 -2147483648 2147483647 ECU_ADDRESS 0x1FFFD80C
 /begin IF_DATA XCP
  /begin DAQ_EVENT VARIABLE /begin AVAILABLE_EVENT_LIST EVENT 0x00 EVENT 0x01 EVENT 0x02 /end AVAILABLE_EVENT_LIST /begin DEFAULT_EVENT_LIST EVENT 0x01 /end DEFAULT_EVENT_LIST /end DAQ_EVENT
 /end IF_DATA
/end MEASUREMENT
/begin CHARACTERISTIC MATempMap "" CURVE 0x770A0 __SWord_Value 0 FP_Tenth.Conversion -70 1000
 /begin AXIS_DESCR COM_AXIS NO_INPUT_QUANTITY NO_COMPU_METHOD 20 0 0 AXIS_PTS_REF MATempScale /end AXIS_DESCR
 PHYS_UNIT "deg C" /end CHARACTERISTIC
/begin AXIS_PTS MATempScale "" 0x770C8 NO_INPUT_QUANTITY __UWord_Axis 0 NO_COMPU_METHOD 20 1 200000 PHYS_UNIT "Ohm" /end AXIS_PTS
/begin MEASUREMENT MaintenanceHours "" ULONG MaintenanceHours.Conversion 0 0 0 4294967295 ECU_ADDRESS 0x1FFFD960
 /begin IF_DATA XCP
  /begin DAQ_EVENT VARIABLE /begin AVAILABLE_EVENT_LIST EVENT 0x00 EVENT 0x01 EVENT 0x02 /end AVAILABLE_EVENT_LIST /begin DEFAULT_EVENT_LIST EVENT 0x01 /end DEFAULT_EVENT_LIST /end DAQ_EVENT
 /end IF_DATA
/end MEASUREMENT
/begin MEASUREMENT ManifoldPressure "" SLONG NO_COMPU_METHOD 0 0 -2147483648 2147483647 ECU_ADDRESS 0x1FFFD844 PHYS_UNIT "mbar"
 /begin IF_DATA XCP
  /begin DAQ_EVENT VARIABLE /begin AVAILABLE_EVENT_LIST EVENT 0x00 EVENT 0x01 EVENT 0x02 /end AVAILABLE_EVENT_LIST /begin DEFAULT_EVENT_LIST EVENT 0x01 /end DEFAULT_EVENT_LIST /end DAQ_EVENT
 /end IF_DATA
/end MEASUREMENT
/begin CHARACTERISTIC ManifoldPressureFallback "" VALUE 0x796FE __UWord_Value 0 NO_COMPU_METHOD 0 65535 CALIBRATION_ACCESS CALIBRATION /end CHARACTERISTIC
/begin MEASUREMENT ManifoldPressureRaw "" UWORD NO_COMPU_METHOD 0 0 0 65535 ECU_ADDRESS 0x1FFFD848 PHYS_UNIT "mbar"
 /begin IF_DATA XCP
  /begin DAQ_EVENT VARIABLE /begin AVAILABLE_EVENT_LIST EVENT 0x00 EVENT 0x01 EVENT 0x02 /end AVAILABLE_EVENT_LIST /begin DEFAULT_EVENT_LIST EVENT 0x01 /end DEFAULT_EVENT_LIST /end DAQ_EVENT
 /end IF_DATA
/end MEASUREMENT
/begin CHARACTERISTIC ManifoldTempLowPassFilter "" VALUE 0x77788 __SLong_Value 0 NO_COMPU_METHOD 0 2147483647 /end CHARACTERISTIC
/begin CHARACTERISTIC ManifoldTempResistance "" CURVE 0x776E8 __SLong_Value 0 NO_COMPU_METHOD 1 200000
 /begin AXIS_DESCR FIX_AXIS NO_INPUT_QUANTITY NO_COMPU_METHOD 1 0 0 FIX_AXIS_PAR_DIST 0 1 1 /end AXIS_DESCR
 PHYS_UNIT "Ohm" /end CHARACTERISTIC
/begin CHARACTERISTIC ManifoldTempScale "" CURVE 0x77738 __SLong_Value 0 NO_COMPU_METHOD -70 1000
 /begin AXIS_DESCR FIX_AXIS NO_INPUT_QUANTITY NO_COMPU_METHOD 1 0 0 FIX_AXIS_PAR_DIST 0 1 1 /end AXIS_DESCR
 PHYS_UNIT "deg C" /end CHARACTERISTIC
/begin MEASUREMENT ManifoldTemperature "" SLONG FP_Tenth.Conversion 0 0 -2147483648 2147483647 ECU_ADDRESS 0x1FFFD874 PHYS_UNIT "deg C"
 /begin IF_DATA XCP
  /begin DAQ_EVENT VARIABLE /begin AVAILABLE_EVENT_LIST EVENT 0x00 EVENT 0x01 EVENT 0x02 /end AVAILABLE_EVENT_LIST /begin DEFAULT_EVENT_LIST EVENT 0x01 /end DEFAULT_EVENT_LIST /end DAQ_EVENT
 /end IF_DATA
/end MEASUREMENT
/begin CHARACTERISTIC ManifoldTemperatureFallback "" VALUE 0x796FA __SWord_Value 0 NO_COMPU_METHOD -32768 32767 CALIBRATION_ACCESS CALIBRATION /end CHARACTERISTIC
/begin MEASUREMENT ManifoldTemperatureRaw "" SWORD FP_Tenth.Conversion 0 0 -32768 32767 ECU_ADDRESS 0x1FFFD878 PHYS_UNIT "deg C"
 /begin IF_DATA XCP
  /begin DAQ_EVENT VARIABLE /begin AVAILABLE_EVENT_LIST EVENT 0x00 EVENT 0x01 EVENT 0x02 /end AVAILABLE_EVENT_LIST /begin DEFAULT_EVENT_LIST EVENT 0x01 /end DEFAULT_EVENT_LIST /end DAQ_EVENT
 /end IF_DATA
/end MEASUREMENT
/begin AXIS_PTS MapInput "" 0x77670 NO_INPUT_QUANTITY __SLong_Axis 0 FP_Thousandth.Conversion 2 0 5 PHYS_UNIT "V" /end AXIS_PTS
/begin CHARACTERISTIC MapLowPassFilter "" VALUE 0x77680 __SLong_Value 0 NO_COMPU_METHOD -2147483648 2147483647 /end CHARACTERISTIC
/begin CHARACTERISTIC MapOutput "" CURVE 0x77678 MapOutput.RecordLayout 0 NO_COMPU_METHOD 0 5000
 /begin AXIS_DESCR COM_AXIS NO_INPUT_QUANTITY NO_COMPU_METHOD 2 0 0 AXIS_PTS_REF MapInput /end AXIS_DESCR
 PHYS_UNIT "mbar" /end CHARACTERISTIC
/begin CHARACTERISTIC MaxDwellTime "" VALUE 0x78F30 __UWord_Value 0 FP_Thousandth.Conversion 0 30 PHYS_UNIT "ms" /end CHARACTERISTIC
/begin CHARACTERISTIC MinDwellTime "" VALUE 0x78F2E __UWord_Value 0 FP_Thousandth.Conversion 0 30 PHYS_UNIT "ms" /end CHARACTERISTIC
/begin MEASUREMENT NOS_ActiveTimer "" ULONG FP_Hundredth.Conversion 0 0 0 4294967295 ECU_ADDRESS 0x1FFFD934 PHYS_UNIT "sec"
 /begin IF_DATA XCP
  /begin DAQ_EVENT VARIABLE /begin AVAILABLE_EVENT_LIST EVENT 0x00 EVENT 0x01 EVENT 0x02 /end AVAILABLE_EVENT_LIST /begin DEFAULT_EVENT_LIST EVENT 0x01 /end DEFAULT_EVENT_LIST /end DAQ_EVENT
 /end IF_DATA
/end MEASUREMENT
/begin MEASUREMENT NOS_PwmDuty "" ULONG NO_COMPU_METHOD 0 0 0 4294967295 ECU_ADDRESS 0x1FFFD92C PHYS_UNIT "100"
 /begin IF_DATA XCP
  /begin DAQ_EVENT VARIABLE /begin AVAILABLE_EVENT_LIST EVENT 0x00 EVENT 0x01 EVENT 0x02 /end AVAILABLE_EVENT_LIST /begin DEFAULT_EVENT_LIST EVENT 0x01 /end DEFAULT_EVENT_LIST /end DAQ_EVENT
 /end IF_DATA
/end MEASUREMENT
/begin MEASUREMENT NOS_Valve_State "" UBYTE binaryState_t 0 0 0 255 ECU_ADDRESS 0x1FFFD928
 /begin IF_DATA XCP
  /begin DAQ_EVENT VARIABLE /begin AVAILABLE_EVENT_LIST EVENT 0x00 EVENT 0x01 EVENT 0x02 /end AVAILABLE_EVENT_LIST /begin DEFAULT_EVENT_LIST EVENT 0x01 /end DEFAULT_EVENT_LIST /end DAQ_EVENT
 /end IF_DATA
/end MEASUREMENT
/begin CHARACTERISTIC Nos_Enable "" VALUE 0x79538 __UByte_Value 0 binaryState_t 0 1 /end CHARACTERISTIC
/begin CHARACTERISTIC Nos_EnrichmentDelay "" VALUE 0x79084 __ULong_Value 0 FP_Hundredth.Conversion 0 1000 PHYS_UNIT "sec" /end CHARACTERISTIC
/begin CHARACTERISTIC Nos_EnrichmentMethod "" VALUE 0x79539 __UByte_Value 0 nosEnrichMethod_t 0 255 /end CHARACTERISTIC
/begin CHARACTERISTIC Nos_FuelingMap "" MAP 0x79088 __UWord_Value 0 FP_Hundredth.Conversion 0 600
 /begin AXIS_DESCR COM_AXIS EngineSpeed SAERPM.Conversion 20 0 13000 AXIS_PTS_REF RpmScale PHYS_UNIT "RPM" /end AXIS_DESCR
 /begin AXIS_DESCR COM_AXIS ThrottlePositionSetPoint FP_Tenth.Conversion 15 0 100 AXIS_PTS_REF ThrottleScale PHYS_UNIT "%" /end AXIS_DESCR
 PHYS_UNIT "mm3/str" /end CHARACTERISTIC
/begin CHARACTERISTIC Nos_RpmHysteresis "" VALUE 0x79080 __ULong_Value 0 SAERPM.Conversion 0 13000 PHYS_UNIT "RPM" /end CHARACTERISTIC
/begin CHARACTERISTIC Nos_RpmThreshold "" VALUE 0x7907C __ULong_Value 0 SAERPM.Conversion 0 13000 PHYS_UNIT "RPM" /end CHARACTERISTIC
/begin CHARACTERISTIC Nos_SparkMap "" MAP 0x792E0 __SWord_Value 0 FP_Tenth.Conversion -180 180
 /begin AXIS_DESCR COM_AXIS EngineSpeed SAERPM.Conversion 20 0 0 AXIS_PTS_REF RpmScale PHYS_UNIT "RPM" /end AXIS_DESCR
 /begin AXIS_DESCR COM_AXIS ThrottlePositionSetPoint FP_Tenth.Conversion 15 0 0 AXIS_PTS_REF ThrottleScale PHYS_UNIT "%" /end AXIS_DESCR
 PHYS_UNIT "deg" /end CHARACTERISTIC
/begin CHARACTERISTIC NpshLimitRed "" CURVE 0x79640 __UWord_Value 0 NO_COMPU_METHOD 0 65535
 /begin AXIS_DESCR COM_AXIS FuelTemperature NO_COMPU_METHOD 6 0 0 AXIS_PTS_REF FuelVaporTempCurve /end AXIS_DESCR
 PHYS_UNIT "mbar" /end CHARACTERISTIC
/begin CHARACTERISTIC NpshLimitYellow "" CURVE 0x79634 __UWord_Value 0 NO_COMPU_METHOD 0 65535
 /begin AXIS_DESCR COM_AXIS FuelTemperature NO_COMPU_METHOD 6 0 0 AXIS_PTS_REF FuelVaporTempCurve /end AXIS_DESCR
 PHYS_UNIT "mbar" /end CHARACTERISTIC
/begin CHARACTERISTIC OilInj_HoldCurrent "" VALUE 0x78F60 __UWord_Value 0 NO_COMPU_METHOD 0 65535 /end CHARACTERISTIC
/begin CHARACTERISTIC OilInj_HoldDuty "" VALUE 0x79076 __UWord_Value 0 NO_COMPU_METHOD 0 100 PHYS_UNIT "%" /end CHARACTERISTIC
/begin CHARACTERISTIC OilInj_Map "Oil injection ratio map" MAP 0x78B50 __UWord_Value 0 FP_Tenth.Conversion 0 1000
 /begin AXIS_DESCR COM_AXIS EngineSpeed SAERPM.Conversion 20 0 0 AXIS_PTS_REF RpmScale PHYS_UNIT "RPM" /end AXIS_DESCR
 /begin AXIS_DESCR COM_AXIS ThrottlePositionSetPoint NO_COMPU_METHOD 15 0 0 AXIS_PTS_REF ThrottleScale /end AXIS_DESCR
/end CHARACTERISTIC
/begin CHARACTERISTIC OilInj_MaxFrequency "" VALUE 0x78F50 __UWord_Value 0 NO_COMPU_METHOD 0 65535 /end CHARACTERISTIC
/begin CHARACTERISTIC OilInj_MaxPeriod "Maximum injector pulse period (1/Hz)" VALUE 0x78DAA __UWord_Value 0 FP_Hundredth.Conversion 0 65535 PHYS_UNIT "sec" /end CHARACTERISTIC
/begin CHARACTERISTIC OilInj_PeakTime "" VALUE 0x78F4E __UWord_Value 0 NO_COMPU_METHOD 0 65535 /end CHARACTERISTIC
/begin MEASUREMENT OilInj_Period_1 "" UWORD NO_COMPU_METHOD 0 0 0 65535 ECU_ADDRESS 0x1FFFD8D4 PHYS_UNIT "ms"
 /begin IF_DATA XCP
  /begin DAQ_EVENT VARIABLE /begin AVAILABLE_EVENT_LIST EVENT 0x00 EVENT 0x01 EVENT 0x02 /end AVAILABLE_EVENT_LIST /begin DEFAULT_EVENT_LIST EVENT 0x01 /end DEFAULT_EVENT_LIST /end DAQ_EVENT
 /end IF_DATA
/end MEASUREMENT
/begin MEASUREMENT OilInj_Period_2 "" UWORD NO_COMPU_METHOD 0 0 0 65535 ECU_ADDRESS 0x1FFFD942 PHYS_UNIT "ms"
 /begin IF_DATA XCP
  /begin DAQ_EVENT VARIABLE /begin AVAILABLE_EVENT_LIST EVENT 0x00 EVENT 0x01 EVENT 0x02 /end AVAILABLE_EVENT_LIST /begin DEFAULT_EVENT_LIST EVENT 0x01 /end DEFAULT_EVENT_LIST /end DAQ_EVENT
 /end IF_DATA
/end MEASUREMENT
/begin MEASUREMENT OilInj_QtyAccu "" ULONG FP_HundredMillion.Conversion 0 0 0 4294967295 ECU_ADDRESS 0x1FFFD97C FORMAT "%4.3" PHYS_UNIT "L"
 /begin IF_DATA XCP
  /begin DAQ_EVENT VARIABLE /begin AVAILABLE_EVENT_LIST EVENT 0x00 EVENT 0x01 EVENT 0x02 /end AVAILABLE_EVENT_LIST /begin DEFAULT_EVENT_LIST EVENT 0x01 /end DEFAULT_EVENT_LIST /end DAQ_EVENT
 /end IF_DATA
/end MEASUREMENT
/begin MEASUREMENT OilInj_Qty_1 "" UWORD FP_TenThousandth 0 0 0 65535 ECU_ADDRESS 0x1FFFD8D8 PHYS_UNIT "mm3/min"
 /begin IF_DATA XCP
  /begin DAQ_EVENT VARIABLE /begin AVAILABLE_EVENT_LIST EVENT 0x00 EVENT 0x01 EVENT 0x02 /end AVAILABLE_EVENT_LIST /begin DEFAULT_EVENT_LIST EVENT 0x01 /end DEFAULT_EVENT_LIST /end DAQ_EVENT
 /end IF_DATA
/end MEASUREMENT
/begin MEASUREMENT OilInj_Qty_2 "" UWORD FP_Tenth.Conversion 0 0 0 65535 ECU_ADDRESS 0x1FFFD946 PHYS_UNIT "mm3/min"
 /begin IF_DATA XCP
  /begin DAQ_EVENT VARIABLE /begin AVAILABLE_EVENT_LIST EVENT 0x00 EVENT 0x01 EVENT 0x02 /end AVAILABLE_EVENT_LIST /begin DEFAULT_EVENT_LIST EVENT 0x01 /end DEFAULT_EVENT_LIST /end DAQ_EVENT
 /end IF_DATA
/end MEASUREMENT
/begin MEASUREMENT OilInj_Ratio_1 "" UWORD FP_TenThousandth 0 0 0 65535 ECU_ADDRESS 0x1FFFD8D6
 /begin IF_DATA XCP
  /begin DAQ_EVENT VARIABLE /begin AVAILABLE_EVENT_LIST EVENT 0x00 EVENT 0x01 EVENT 0x02 /end AVAILABLE_EVENT_LIST /begin DEFAULT_EVENT_LIST EVENT 0x01 /end DEFAULT_EVENT_LIST /end DAQ_EVENT
 /end IF_DATA
/end MEASUREMENT
/begin MEASUREMENT OilInj_Ratio_2 "" UWORD FP_Tenth.Conversion 0 0 0 65535 ECU_ADDRESS 0x1FFFD944
 /begin IF_DATA XCP
  /begin DAQ_EVENT VARIABLE /begin AVAILABLE_EVENT_LIST EVENT 0x00 EVENT 0x01 EVENT 0x02 /end AVAILABLE_EVENT_LIST /begin DEFAULT_EVENT_LIST EVENT 0x01 /end DEFAULT_EVENT_LIST /end DAQ_EVENT
 /end IF_DATA
/end MEASUREMENT
/begin CHARACTERISTIC OilInj_ShotFlow "" VALUE 0x78DAC __UWord_Value 0 FP_Hundredth.Conversion 0 65535 PHYS_UNIT "mm3/stroke" /end CHARACTERISTIC
/begin CHARACTERISTIC OilInj_ShotWidth "Pulse width to fire oil injector" VALUE 0x78DA8 __UWord_Value 0 FP_Thousandth.Conversion 0 60 PHYS_UNIT "sec" /end CHARACTERISTIC
/begin CHARACTERISTIC OilInjectorCount "" VALUE 0x79074 __UWord_Value 0 NO_COMPU_METHOD 1 2 /end CHARACTERISTIC
/begin MEASUREMENT OilPressure1 "" UWORD NO_COMPU_METHOD 0 0 0 65535 ECU_ADDRESS 0x1FFFD8FE
 /begin IF_DATA XCP
  /begin DAQ_EVENT VARIABLE /begin AVAILABLE_EVENT_LIST EVENT 0x00 EVENT 0x01 EVENT 0x02 /end AVAILABLE_EVENT_LIST /begin DEFAULT_EVENT_LIST EVENT 0x01 /end DEFAULT_EVENT_LIST /end DAQ_EVENT
 /end IF_DATA
/end MEASUREMENT
/begin CHARACTERISTIC OilPressure1Input "" CURVE 0x78F64 __SLong_Value 0 NO_COMPU_METHOD -2147483648 2147483647
 /begin AXIS_DESCR FIX_AXIS NO_INPUT_QUANTITY NO_COMPU_METHOD 2 0 0 FIX_AXIS_PAR_DIST 0 1 1 /end AXIS_DESCR
/end CHARACTERISTIC
/begin CHARACTERISTIC OilPressure1Output "" CURVE 0x78F6C __SLong_Value 0 NO_COMPU_METHOD -2147483648 2147483647
 /begin AXIS_DESCR FIX_AXIS NO_INPUT_QUANTITY NO_COMPU_METHOD 2 0 0 FIX_AXIS_PAR_DIST 0 1 1 /end AXIS_DESCR
/end CHARACTERISTIC
/begin MEASUREMENT OilPressure2 "" UWORD NO_COMPU_METHOD 0 0 0 65535 ECU_ADDRESS 0x1FFFD900
 /begin IF_DATA XCP
  /begin DAQ_EVENT VARIABLE /begin AVAILABLE_EVENT_LIST EVENT 0x00 EVENT 0x01 EVENT 0x02 /end AVAILABLE_EVENT_LIST /begin DEFAULT_EVENT_LIST EVENT 0x01 /end DEFAULT_EVENT_LIST /end DAQ_EVENT
 /end IF_DATA
/end MEASUREMENT
/begin CHARACTERISTIC OilPressure2Input "" CURVE 0x78F74 __SLong_Value 0 NO_COMPU_METHOD -2147483648 2147483647
 /begin AXIS_DESCR FIX_AXIS NO_INPUT_QUANTITY NO_COMPU_METHOD 2 0 0 FIX_AXIS_PAR_DIST 0 1 1 /end AXIS_DESCR
/end CHARACTERISTIC
/begin CHARACTERISTIC OilPressure2Output "" CURVE 0x78F7C __SLong_Value 0 NO_COMPU_METHOD -2147483648 2147483647
 /begin AXIS_DESCR FIX_AXIS NO_INPUT_QUANTITY NO_COMPU_METHOD 2 0 0 FIX_AXIS_PAR_DIST 0 1 1 /end AXIS_DESCR
/end CHARACTERISTIC
/begin MEASUREMENT OilPumpCurrent1 "" UWORD NO_COMPU_METHOD 0 0 0 65535 ECU_ADDRESS 0x1FFFD902
 /begin IF_DATA XCP
  /begin DAQ_EVENT VARIABLE /begin AVAILABLE_EVENT_LIST EVENT 0x00 EVENT 0x01 EVENT 0x02 /end AVAILABLE_EVENT_LIST /begin DEFAULT_EVENT_LIST EVENT 0x01 /end DEFAULT_EVENT_LIST /end DAQ_EVENT
 /end IF_DATA
/end MEASUREMENT
/begin MEASUREMENT OilPumpCurrent2 "" UWORD NO_COMPU_METHOD 0 0 0 65535 ECU_ADDRESS 0x1FFFD904
 /begin IF_DATA XCP
  /begin DAQ_EVENT VARIABLE /begin AVAILABLE_EVENT_LIST EVENT 0x00 EVENT 0x01 EVENT 0x02 /end AVAILABLE_EVENT_LIST /begin DEFAULT_EVENT_LIST EVENT 0x01 /end DEFAULT_EVENT_LIST /end DAQ_EVENT
 /end IF_DATA
/end MEASUREMENT
/begin CHARACTERISTIC OnTimeCompCurve "" CURVE 0x78ECC __SWord_Value 0 NO_COMPU_METHOD -32768 32767
 /begin AXIS_DESCR COM_AXIS NO_INPUT_QUANTITY NO_COMPU_METHOD 15 0 0 AXIS_PTS_REF TempScale /end AXIS_DESCR
/end CHARACTERISTIC
/begin CHARACTERISTIC OnTimeDecay "" VALUE 0x78EEC __ULong_Value 0 NO_COMPU_METHOD 0 4294967295 /end CHARACTERISTIC
/begin MEASUREMENT PcbTemp "" SWORD FP_Tenth.Conversion 0 0 -32768 32767 ECU_ADDRESS 0x1FFFD948 PHYS_UNIT "deg C"
 /begin IF_DATA XCP
  /begin DAQ_EVENT VARIABLE /begin AVAILABLE_EVENT_LIST EVENT 0x00 EVENT 0x01 EVENT 0x02 /end AVAILABLE_EVENT_LIST /begin DEFAULT_EVENT_LIST EVENT 0x01 /end DEFAULT_EVENT_LIST /end DAQ_EVENT
 /end IF_DATA
/end MEASUREMENT
/begin AXIS_PTS PcbTempResistance "" 0x79594 NO_INPUT_QUANTITY __SLong_Axis 0 NO_COMPU_METHOD 20 0 2147483647 PHYS_UNIT "Ohm" /end AXIS_PTS
/begin CHARACTERISTIC PcbTempScale "" CURVE 0x795E4 PcbTempScale.RecordLayout_Copy1 0 NO_COMPU_METHOD -2147483648 2147483647
 /begin AXIS_DESCR COM_AXIS NO_INPUT_QUANTITY FP_Tenth.Conversion 20 0 0 AXIS_PTS_REF PcbTempResistance PHYS_UNIT "deg C" /end AXIS_DESCR
/end CHARACTERISTIC
/begin MEASUREMENT PreHeatComplete "" UBYTE NO_COMPU_METHOD 0 0 0 255 ECU_ADDRESS 0x1FFFD8E5
 /begin IF_DATA XCP
  /begin DAQ_EVENT VARIABLE /begin AVAILABLE_EVENT_LIST EVENT 0x00 EVENT 0x01 EVENT 0x02 /end AVAILABLE_EVENT_LIST /begin DEFAULT_EVENT_LIST EVENT 0x01 /end DEFAULT_EVENT_LIST /end DAQ_EVENT
 /end IF_DATA
/end MEASUREMENT
/begin CHARACTERISTIC PreHeatEnable "" VALUE 0x7953E __UByte_Value 0 binaryState_t 0 255 /end CHARACTERISTIC
/begin CHARACTERISTIC PreheatHystersis "" VALUE 0x78F3C __SWord_Value 0 FP_Tenth.Conversion -32768 32767 PHYS_UNIT "deg C" /end CHARACTERISTIC
/begin CHARACTERISTIC PreheatHystersisFuel "" VALUE 0x7953C __SWord_Value 0 FP_Tenth.Conversion -60 300 PHYS_UNIT "deg C" /end CHARACTERISTIC
/begin CHARACTERISTIC PreheatTempThreshold "" VALUE 0x78F3A __SWord_Value 0 FP_Tenth.Conversion -32768 32767 PHYS_UNIT "deg C" /end CHARACTERISTIC
/begin CHARACTERISTIC PreheatTempThresholdFuel "" VALUE 0x7953A __SWord_Value 0 FP_Tenth.Conversion -60 300 PHYS_UNIT "deg C" /end CHARACTERISTIC
/begin CHARACTERISTIC PropMap "" MAP 0x77268 __UWord_Value 0 NO_COMPU_METHOD 0 65535
 /begin AXIS_DESCR FIX_AXIS NO_INPUT_QUANTITY NO_COMPU_METHOD 1 0 0 FIX_AXIS_PAR_DIST 0 1 1 /end AXIS_DESCR
 /begin AXIS_DESCR FIX_AXIS NO_INPUT_QUANTITY NO_COMPU_METHOD 1 0 0 FIX_AXIS_PAR_DIST 0 1 1 /end AXIS_DESCR
/end CHARACTERISTIC
/begin CHARACTERISTIC PuddleMaxSize "" VALUE 0x79024 __ULong_Value 0 NO_COMPU_METHOD 0 4294967295 /end CHARACTERISTIC
/begin CHARACTERISTIC PumpDriver "" VALUE 0x78F5E __UByte_Value 0 pumpDriver_t 0 255 /end CHARACTERISTIC
/begin MEASUREMENT PumpDuty "" UWORD FP_Tenth.Conversion 0 0 0 65535 ECU_ADDRESS 0x1FFFD8EC PHYS_UNIT "%"
 /begin IF_DATA XCP
  /begin DAQ_EVENT VARIABLE /begin AVAILABLE_EVENT_LIST EVENT 0x00 EVENT 0x01 EVENT 0x02 /end AVAILABLE_EVENT_LIST /begin DEFAULT_EVENT_LIST EVENT 0x01 /end DEFAULT_EVENT_LIST /end DAQ_EVENT
 /end IF_DATA
/end MEASUREMENT
/begin MEASUREMENT PumpDutyFeedForward "" SLONG FP_Tenth.Conversion 0 0 -2147483648 2147483647 ECU_ADDRESS 0x1FFFD8F8 PHYS_UNIT "%"
 /begin IF_DATA XCP
  /begin DAQ_EVENT VARIABLE /begin AVAILABLE_EVENT_LIST EVENT 0x00 EVENT 0x01 EVENT 0x02 /end AVAILABLE_EVENT_LIST /begin DEFAULT_EVENT_LIST EVENT 0x01 /end DEFAULT_EVENT_LIST /end DAQ_EVENT
 /end IF_DATA
/end MEASUREMENT
/begin MEASUREMENT PumpDutyInteg "" SLONG PumpDutyInteg.Conversion 0 0 -2147483648 2147483647 ECU_ADDRESS 0x1FFFD8F0 PHYS_UNIT "%"
 /begin IF_DATA XCP
  /begin DAQ_EVENT VARIABLE /begin AVAILABLE_EVENT_LIST EVENT 0x00 EVENT 0x01 EVENT 0x02 /end AVAILABLE_EVENT_LIST /begin DEFAULT_EVENT_LIST EVENT 0x01 /end DEFAULT_EVENT_LIST /end DAQ_EVENT
 /end IF_DATA
/end MEASUREMENT
/begin MEASUREMENT PumpDutyProp "" SLONG NO_COMPU_METHOD 0 0 -2147483648 2147483647 ECU_ADDRESS 0x1FFFD8F4
 /begin IF_DATA XCP
  /begin DAQ_EVENT VARIABLE /begin AVAILABLE_EVENT_LIST EVENT 0x00 EVENT 0x01 EVENT 0x02 /end AVAILABLE_EVENT_LIST /begin DEFAULT_EVENT_LIST EVENT 0x01 /end DEFAULT_EVENT_LIST /end DAQ_EVENT
 /end IF_DATA
/end MEASUREMENT
/begin CHARACTERISTIC PumpFeedForwardMap "" MAP 0x770F0 __UWord_Value 0 FP_Tenth.Conversion 0 100
 /begin AXIS_DESCR COM_AXIS EngineSpeed SAERPM.Conversion 10 0 10000 AXIS_PTS_REF PumpFeedFwdRpmScale PHYS_UNIT "RPM" /end AXIS_DESCR
 /begin AXIS_DESCR COM_AXIS FuelQty_Total FP_Hundredth.Conversion 15 0 0 AXIS_PTS_REF FuelQtyScale PHYS_UNIT "mm3/str" /end AXIS_DESCR
 PHYS_UNIT "%" /end CHARACTERISTIC
/begin AXIS_PTS PumpFeedFwdRpmScale "" 0x79720 EngineSpeed __ULong_Axis 0 SAERPM.Conversion 10 0 4294967295 PHYS_UNIT "RPM" /end AXIS_PTS
/begin MEASUREMENT PumpInletPress "" SLONG NO_COMPU_METHOD 0 0 -2147483648 2147483647 ECU_ADDRESS 0x1FFFD854 PHYS_UNIT "mbar"
 /begin IF_DATA XCP
  /begin DAQ_EVENT VARIABLE /begin AVAILABLE_EVENT_LIST EVENT 0x00 EVENT 0x01 EVENT 0x02 /end AVAILABLE_EVENT_LIST /begin DEFAULT_EVENT_LIST EVENT 0x01 /end DEFAULT_EVENT_LIST /end DAQ_EVENT
 /end IF_DATA
/end MEASUREMENT
/begin AXIS_PTS PumpInletPressInput "" 0x77698 NO_INPUT_QUANTITY __SLong_Axis 0 FP_Thousandth.Conversion 2 0 5 PHYS_UNIT "V" /end AXIS_PTS
/begin CHARACTERISTIC PumpInletPressLowPassFilter "" VALUE 0x776A8 __SLong_Value 0 NO_COMPU_METHOD -2147483648 2147483647 /end CHARACTERISTIC
/begin CHARACTERISTIC PumpInletPressOutput "" CURVE 0x776A0 PumpInletPressOutput.RecordLayout_Copy1 0 NO_COMPU_METHOD -2147483648 2147483647
 /begin AXIS_DESCR COM_AXIS NO_INPUT_QUANTITY NO_COMPU_METHOD 2 0 0 AXIS_PTS_REF PumpInletPressInput /end AXIS_DESCR
 PHYS_UNIT "mbar" /end CHARACTERISTIC
/begin MEASUREMENT PumpInletPressRaw "" UWORD NO_COMPU_METHOD 0 0 0 65535 ECU_ADDRESS 0x1FFFD858 PHYS_UNIT "mbar"
 /begin IF_DATA XCP
  /begin DAQ_EVENT VARIABLE /begin AVAILABLE_EVENT_LIST EVENT 0x00 EVENT 0x01 EVENT 0x02 /end AVAILABLE_EVENT_LIST /begin DEFAULT_EVENT_LIST EVENT 0x01 /end DEFAULT_EVENT_LIST /end DAQ_EVENT
 /end IF_DATA
/end MEASUREMENT
/begin MEASUREMENT PumpMode "" UBYTE pumpModes_t_Copy1 0 0 0 255 ECU_ADDRESS 0x1FFFD8EA
 /begin IF_DATA XCP
  /begin DAQ_EVENT VARIABLE /begin AVAILABLE_EVENT_LIST EVENT 0x00 EVENT 0x01 EVENT 0x02 /end AVAILABLE_EVENT_LIST /begin DEFAULT_EVENT_LIST EVENT 0x01 /end DEFAULT_EVENT_LIST /end DAQ_EVENT
 /end IF_DATA
/end MEASUREMENT
/begin CHARACTERISTIC PumpPrimeDuty "" VALUE 0x78F38 __UWord_Value 0 FP_Tenth.Conversion 0 100 PHYS_UNIT "%" /end CHARACTERISTIC
/begin CHARACTERISTIC RevLimitGovernor "" VALUE 0x79070 __ULong_Value 0 SAERPM.Conversion 0 13000 PHYS_UNIT "RPM" /end CHARACTERISTIC
/begin CHARACTERISTIC RevLimitHysteresis "" VALUE 0x7906C __ULong_Value 0 SAERPM.Conversion 0 13000 PHYS_UNIT "RPM" /end CHARACTERISTIC
/begin CHARACTERISTIC RevLimitRPM "" VALUE 0x79068 __ULong_Value 0 SAERPM.Conversion 0 13000 PHYS_UNIT "RPM" /end CHARACTERISTIC
/begin MEASUREMENT RevLimiter "" UBYTE binaryState_t 0 0 0 255 ECU_ADDRESS 0x1FFFD91B READ_WRITE
 /begin IF_DATA XCP
  /begin DAQ_EVENT VARIABLE /begin AVAILABLE_EVENT_LIST EVENT 0x00 EVENT 0x01 EVENT 0x02 /end AVAILABLE_EVENT_LIST /begin DEFAULT_EVENT_LIST EVENT 0x01 /end DEFAULT_EVENT_LIST /end DAQ_EVENT
 /end IF_DATA
/end MEASUREMENT
/begin CHARACTERISTIC RevPerCycle "" VALUE 0x7785C __UWord_Value 0 NO_COMPU_METHOD 1 2 /end CHARACTERISTIC
/begin MEASUREMENT RpmErrorRMS "" ULONG SAERPM.Conversion 0 0 0 4294967295 ECU_ADDRESS 0x1FFFD808
 /begin IF_DATA XCP
  /begin DAQ_EVENT VARIABLE /begin AVAILABLE_EVENT_LIST EVENT 0x00 EVENT 0x01 EVENT 0x02 /end AVAILABLE_EVENT_LIST /begin DEFAULT_EVENT_LIST EVENT 0x01 /end DEFAULT_EVENT_LIST /end DAQ_EVENT
 /end IF_DATA
/end MEASUREMENT
/begin CHARACTERISTIC RpmErrorRms_TC "" VALUE 0x77264 __ULong_Value 0 NO_COMPU_METHOD 0 4294967295 /end CHARACTERISTIC
/begin AXIS_PTS RpmRmsErrorGov "" 0x77358 NO_INPUT_QUANTITY __UWord_Axis 0 SAERPM.Conversion 1 0 65535 /end AXIS_PTS
/begin AXIS_PTS RpmScale "" 0x775E4 EngineSpeed __ULong_Axis 0 SAERPM.Conversion 20 0 16000 PHYS_UNIT "RPM" /end AXIS_PTS
/begin AXIS_PTS RpmScaleGovernor "" 0x77340 NO_INPUT_QUANTITY __ULong_Axis 0 SAERPM.Conversion 1 0 16000 PHYS_UNIT "RPM" /end AXIS_PTS
/begin CHARACTERISTIC RunControl_CAN "" VALUE 0x79078 __UByte_Value 0 binaryState_t 0 1 /end CHARACTERISTIC
/begin MEASUREMENT RunHours "" ULONG FP_Hundredth.Conversion 0 0 0 4294967295 ECU_ADDRESS 0x1FFFD8DC PHYS_UNIT "hr"
 /begin IF_DATA XCP
  /begin DAQ_EVENT VARIABLE /begin AVAILABLE_EVENT_LIST EVENT 0x00 EVENT 0x01 EVENT 0x02 /end AVAILABLE_EVENT_LIST /begin DEFAULT_EVENT_LIST EVENT 0x01 /end DEFAULT_EVENT_LIST /end DAQ_EVENT
 /end IF_DATA
/end MEASUREMENT
/begin MEASUREMENT Servo1PulseWidth "" UWORD FP_Thousandth.Conversion 0 0 0 65535 ECU_ADDRESS 0x1FFFD832 PHYS_UNIT "ms"
 /begin IF_DATA XCP
  /begin DAQ_EVENT VARIABLE /begin AVAILABLE_EVENT_LIST EVENT 0x00 EVENT 0x01 EVENT 0x02 /end AVAILABLE_EVENT_LIST /begin DEFAULT_EVENT_LIST EVENT 0x01 /end DEFAULT_EVENT_LIST /end DAQ_EVENT
 /end IF_DATA
/end MEASUREMENT
/begin MEASUREMENT Servo2Position "" SLONG FP_Tenth.Conversion 0 0 -2147483648 2147483647 ECU_ADDRESS 0x1FFFD8A8 PHYS_UNIT "%"
 /begin IF_DATA XCP
  /begin DAQ_EVENT VARIABLE /begin AVAILABLE_EVENT_LIST EVENT 0x00 EVENT 0x01 EVENT 0x02 /end AVAILABLE_EVENT_LIST /begin DEFAULT_EVENT_LIST EVENT 0x01 /end DEFAULT_EVENT_LIST /end DAQ_EVENT
 /end IF_DATA
/end MEASUREMENT
/begin CHARACTERISTIC Servo2PositionInput "" CURVE 0x77848 __SLong_Value 0 FP_Thousandth.Conversion 0 5
 /begin AXIS_DESCR FIX_AXIS NO_INPUT_QUANTITY NO_COMPU_METHOD 1 0 0 FIX_AXIS_PAR_DIST 0 1 1 /end AXIS_DESCR
 PHYS_UNIT "V" /end CHARACTERISTIC
/begin CHARACTERISTIC Servo2PositionLowPassFilter "" VALUE 0x77858 __SLong_Value 0 NO_COMPU_METHOD 0 2147483647 /end CHARACTERISTIC
/begin CHARACTERISTIC Servo2PositionOutput "" CURVE 0x77850 __SLong_Value 0 FP_Tenth.Conversion 0 100
 /begin AXIS_DESCR FIX_AXIS NO_INPUT_QUANTITY NO_COMPU_METHOD 1 0 0 FIX_AXIS_PAR_DIST 0 1 1 /end AXIS_DESCR
 PHYS_UNIT "%" /end CHARACTERISTIC
/begin MEASUREMENT Servo2PositionRaw "" SWORD FP_Tenth.Conversion 0 0 -32768 32767 ECU_ADDRESS 0x1FFFD8AC PHYS_UNIT "%"
 /begin IF_DATA XCP
  /begin DAQ_EVENT VARIABLE /begin AVAILABLE_EVENT_LIST EVENT 0x00 EVENT 0x01 EVENT 0x02 /end AVAILABLE_EVENT_LIST /begin DEFAULT_EVENT_LIST EVENT 0x01 /end DEFAULT_EVENT_LIST /end DAQ_EVENT
 /end IF_DATA
/end MEASUREMENT
/begin CHARACTERISTIC ServoClosed "" VALUE 0x77366 __SWord_Value 0 NO_COMPU_METHOD 100 3500 PHYS_UNIT "us" /end CHARACTERISTIC
/begin CHARACTERISTIC ServoSpan "" VALUE 0x77368 __SWord_Value 0 NO_COMPU_METHOD 100 3500 PHYS_UNIT "us" /end CHARACTERISTIC
/begin MEASUREMENT SparkCut "" UBYTE binaryState_t 0 0 0 255 ECU_ADDRESS 0x1FFFD8D2
 /begin IF_DATA XCP
  /begin DAQ_EVENT VARIABLE /begin AVAILABLE_EVENT_LIST EVENT 0x00 EVENT 0x01 EVENT 0x02 /end AVAILABLE_EVENT_LIST /begin DEFAULT_EVENT_LIST EVENT 0x01 /end DEFAULT_EVENT_LIST /end DAQ_EVENT
 /end IF_DATA
/end MEASUREMENT
/begin MEASUREMENT SparkDoubleActiveCyl1 "" UBYTE binaryState_t 0 0 0 255 ECU_ADDRESS 0x1FFFD94C
 /begin IF_DATA XCP
  /begin DAQ_EVENT VARIABLE /begin AVAILABLE_EVENT_LIST EVENT 0x00 EVENT 0x01 EVENT 0x02 /end AVAILABLE_EVENT_LIST /begin DEFAULT_EVENT_LIST EVENT 0x01 /end DEFAULT_EVENT_LIST /end DAQ_EVENT
 /end IF_DATA
/end MEASUREMENT
/begin MEASUREMENT SparkDoubleActiveCyl2 "" UBYTE binaryState_t 0 0 0 255 ECU_ADDRESS 0x1FFFD94D
 /begin IF_DATA XCP
  /begin DAQ_EVENT VARIABLE /begin AVAILABLE_EVENT_LIST EVENT 0x00 EVENT 0x01 EVENT 0x02 /end AVAILABLE_EVENT_LIST /begin DEFAULT_EVENT_LIST EVENT 0x01 /end DEFAULT_EVENT_LIST /end DAQ_EVENT
 /end IF_DATA
/end MEASUREMENT
/begin CHARACTERISTIC SparkDwellMap "" MAP 0x788D0 __UWord_Value 0 FP_Thousandth.Conversion 0 15000
 /begin AXIS_DESCR COM_AXIS SparkEnergy FP_Tenth.Conversion 20 0 0 AXIS_PTS_REF SparkEnergyScale PHYS_UNIT "mJ" /end AXIS_DESCR
 /begin AXIS_DESCR COM_AXIS SystemVoltage FP_Hundredth.Conversion 15 0 0 AXIS_PTS_REF VoltageScale PHYS_UNIT "V" /end AXIS_DESCR
 PHYS_UNIT "ms" /end CHARACTERISTIC
/begin MEASUREMENT SparkDwellTime "" UWORD FP_Thousandth.Conversion 0 0 0 65535 ECU_ADDRESS 0x1FFFD8D0 PHYS_UNIT "ms"
 /begin IF_DATA XCP
  /begin DAQ_EVENT VARIABLE /begin AVAILABLE_EVENT_LIST EVENT 0x00 EVENT 0x01 EVENT 0x02 /end AVAILABLE_EVENT_LIST /begin DEFAULT_EVENT_LIST EVENT 0x01 /end DEFAULT_EVENT_LIST /end DAQ_EVENT
 /end IF_DATA
/end MEASUREMENT
/begin CHARACTERISTIC SparkEdgeSelect "" VALUE 0x79712 __UByte_Value 0 sparkEdgeSelect_t 0 255 CALIBRATION_ACCESS CALIBRATION /end CHARACTERISTIC
/begin MEASUREMENT SparkEnergy "" UWORD FP_Tenth.Conversion 0 0 0 65535 ECU_ADDRESS 0x1FFFD8CE PHYS_UNIT "mJ"
 /begin IF_DATA XCP
  /begin DAQ_EVENT VARIABLE /begin AVAILABLE_EVENT_LIST EVENT 0x00 EVENT 0x01 EVENT 0x02 /end AVAILABLE_EVENT_LIST /begin DEFAULT_EVENT_LIST EVENT 0x01 /end DEFAULT_EVENT_LIST /end DAQ_EVENT
 /end IF_DATA
/end MEASUREMENT
/begin CHARACTERISTIC SparkEnergyMap "" MAP 0x78678 __UWord_Value 0 FP_Tenth.Conversion 0 200
 /begin AXIS_DESCR COM_AXIS EngineSpeed SAERPM.Conversion 20 0 0 AXIS_PTS_REF RpmScale PHYS_UNIT "RPM" /end AXIS_DESCR
 /begin AXIS_DESCR COM_AXIS ThrottlePositionSetPoint FP_Tenth.Conversion 15 0 0 AXIS_PTS_REF ThrottleScale PHYS_UNIT "%" /end AXIS_DESCR
 PHYS_UNIT "mJ" /end CHARACTERISTIC
/begin AXIS_PTS SparkEnergyScale "" 0x78B28 SparkEnergy __UWord_Axis 0 FP_Tenth.Conversion 20 0 200 PHYS_UNIT "mJ" /end AXIS_PTS
/begin MEASUREMENT SparkNosOffset "" SWORD FP_Tenth.Conversion 0 0 -32768 32767 ECU_ADDRESS 0x1FFFD932 PHYS_UNIT "deg Advance"
 /begin IF_DATA XCP
  /begin DAQ_EVENT VARIABLE /begin AVAILABLE_EVENT_LIST EVENT 0x00 EVENT 0x01 EVENT 0x02 /end AVAILABLE_EVENT_LIST /begin DEFAULT_EVENT_LIST EVENT 0x01 /end DEFAULT_EVENT_LIST /end DAQ_EVENT
 /end IF_DATA
/end MEASUREMENT
/begin MEASUREMENT SparkOffsetXCP "" SWORD FP_Tenth.Conversion 0 0 -32768 32767 ECU_ADDRESS 0x1FFFD978 PHYS_UNIT "deg" READ_WRITE
 /begin IF_DATA XCP
  /begin DAQ_EVENT VARIABLE /begin AVAILABLE_EVENT_LIST EVENT 0x00 EVENT 0x01 EVENT 0x02 /end AVAILABLE_EVENT_LIST /begin DEFAULT_EVENT_LIST EVENT 0x01 /end DEFAULT_EVENT_LIST /end DAQ_EVENT
 /end IF_DATA
/end MEASUREMENT
/begin MEASUREMENT SparkTiming "" SWORD FP_Tenth.Conversion 0 0 -32768 32767 ECU_ADDRESS 0x1FFFD8CC PHYS_UNIT "deg"
 /begin IF_DATA XCP
  /begin DAQ_EVENT VARIABLE /begin AVAILABLE_EVENT_LIST EVENT 0x00 EVENT 0x01 EVENT 0x02 /end AVAILABLE_EVENT_LIST /begin DEFAULT_EVENT_LIST EVENT 0x01 /end DEFAULT_EVENT_LIST /end DAQ_EVENT
 /end IF_DATA
/end MEASUREMENT
/begin CHARACTERISTIC SparkTimingMap "" MAP 0x78420 __SWord_Value 0 FP_Tenth.Conversion -180 180
 /begin AXIS_DESCR COM_AXIS EngineSpeed SAERPM.Conversion 20 0 0 AXIS_PTS_REF RpmScale PHYS_UNIT "RPM" /end AXIS_DESCR
 /begin AXIS_DESCR COM_AXIS ThrottlePositionSetPoint FP_Tenth.Conversion 15 0 0 AXIS_PTS_REF ThrottleScale PHYS_UNIT "%" /end AXIS_DESCR
 PHYS_UNIT "deg" /end CHARACTERISTIC
/begin CHARACTERISTIC SparkTriggerEdgeType "" VALUE 0x79713 __UByte_Value 0 sparkTtlEdgeType_t 0 255 CALIBRATION_ACCESS CALIBRATION /end CHARACTERISTIC
/begin CHARACTERISTIC SparkTtlPulseWidth "" VALUE 0x79714 __UWord_Value 0 NO_COMPU_METHOD 0 65535 CALIBRATION_ACCESS CALIBRATION /end CHARACTERISTIC
/begin CHARACTERISTIC StartingTorque "" VALUE 0x77364 __UWord_Value 0 FP_Tenth.Conversion 0 100 PHYS_UNIT "%" /end CHARACTERISTIC
/begin MEASUREMENT SystemVoltage "" UWORD FP_Hundredth.Conversion 0 0 0 65535 ECU_ADDRESS 0x1FFFD83A PHYS_UNIT "V"
 /begin IF_DATA XCP
  /begin DAQ_EVENT VARIABLE /begin AVAILABLE_EVENT_LIST EVENT 0x00 EVENT 0x01 EVENT 0x02 /end AVAILABLE_EVENT_LIST /begin DEFAULT_EVENT_LIST EVENT 0x01 /end DEFAULT_EVENT_LIST /end DAQ_EVENT
 /end IF_DATA
/end MEASUREMENT
/begin CHARACTERISTIC TBypass "" VALUE 0x78F56 __UWord_Value 0 NO_COMPU_METHOD 0 65535 /end CHARACTERISTIC
/begin CHARACTERISTIC THoldOff "" VALUE 0x78F58 __UWord_Value 0 NO_COMPU_METHOD 0 65535 /end CHARACTERISTIC
/begin CHARACTERISTIC THoldTot "" VALUE 0x78F5A __UWord_Value 0 NO_COMPU_METHOD 0 65535 /end CHARACTERISTIC
/begin CHARACTERISTIC TPeakOff "" VALUE 0x78F52 __UWord_Value 0 NO_COMPU_METHOD 0 65535 /end CHARACTERISTIC
/begin CHARACTERISTIC TPeakTot "" VALUE 0x78F54 __UWord_Value 0 NO_COMPU_METHOD 0 65535 /end CHARACTERISTIC
/begin CHARACTERISTIC TauCurve "" CURVE 0x78FE8 TauCurve.RecordLayout 0 NO_COMPU_METHOD 0 4294967295
 /begin AXIS_DESCR COM_AXIS EngineTemperature NO_COMPU_METHOD 15 0 0 AXIS_PTS_REF TempScale /end AXIS_DESCR
/end CHARACTERISTIC
/begin AXIS_PTS TempScale "" 0x78EF0 NO_INPUT_QUANTITY __SWord_Axis 0 FP_Tenth.Conversion 15 -100 800 PHYS_UNIT "deg C" /end AXIS_PTS
/begin MEASUREMENT ThrottleCurrent "" SLONG FP_Thousandth.Conversion 0 0 -2147483648 2147483647 ECU_ADDRESS 0x1FFFD83C PHYS_UNIT "A"
 /begin IF_DATA XCP
  /begin DAQ_EVENT VARIABLE /begin AVAILABLE_EVENT_LIST EVENT 0x00 EVENT 0x01 EVENT 0x02 /end AVAILABLE_EVENT_LIST /begin DEFAULT_EVENT_LIST EVENT 0x01 /end DEFAULT_EVENT_LIST /end DAQ_EVENT
 /end IF_DATA
/end MEASUREMENT
/begin AXIS_PTS ThrottleCurrentInput "" 0x7765C NO_INPUT_QUANTITY __SLong_Axis 0 FP_Thousandth.Conversion 2 0 5 PHYS_UNIT "V" /end AXIS_PTS
/begin CHARACTERISTIC ThrottleCurrentLowPassFilter "" VALUE 0x7766C __SLong_Value 0 NO_COMPU_METHOD -2147483648 2147483647 /end CHARACTERISTIC
/begin CHARACTERISTIC ThrottleCurrentOutput "" CURVE 0x77664 ThrottleCurrentOutput.RecordLayout 0 NO_COMPU_METHOD 0 5
 /begin AXIS_DESCR COM_AXIS NO_INPUT_QUANTITY NO_COMPU_METHOD 2 0 0 AXIS_PTS_REF ThrottleCurrentInput /end AXIS_DESCR
 PHYS_UNIT "A" /end CHARACTERISTIC
/begin MEASUREMENT ThrottleCurrentRaw "" UWORD FP_Thousandth.Conversion 0 0 0 65535 ECU_ADDRESS 0x1FFFD840 PHYS_UNIT "A"
 /begin IF_DATA XCP
  /begin DAQ_EVENT VARIABLE /begin AVAILABLE_EVENT_LIST EVENT 0x00 EVENT 0x01 EVENT 0x02 /end AVAILABLE_EVENT_LIST /begin DEFAULT_EVENT_LIST EVENT 0x01 /end DEFAULT_EVENT_LIST /end DAQ_EVENT
 /end IF_DATA
/end MEASUREMENT
/begin MEASUREMENT ThrottleOverride "" UBYTE binaryState_t 0 0 0 65535 ECU_ADDRESS 0x1FFFD976 READ_WRITE
 /begin IF_DATA XCP
  /begin DAQ_EVENT VARIABLE /begin AVAILABLE_EVENT_LIST EVENT 0x00 EVENT 0x01 EVENT 0x02 /end AVAILABLE_EVENT_LIST /begin DEFAULT_EVENT_LIST EVENT 0x01 /end DEFAULT_EVENT_LIST /end DAQ_EVENT
 /end IF_DATA
/end MEASUREMENT
/begin MEASUREMENT ThrottleOverrideCmd "" UWORD FP_Tenth.Conversion 0 0 0 100 ECU_ADDRESS 0x1FFFD974 PHYS_UNIT "%" READ_WRITE
 /begin IF_DATA XCP
  /begin DAQ_EVENT VARIABLE /begin AVAILABLE_EVENT_LIST EVENT 0x00 EVENT 0x01 EVENT 0x02 /end AVAILABLE_EVENT_LIST /begin DEFAULT_EVENT_LIST EVENT 0x01 /end DEFAULT_EVENT_LIST /end DAQ_EVENT
 /end IF_DATA
/end MEASUREMENT
/begin MEASUREMENT ThrottlePositionSensor "" SLONG FP_Tenth.Conversion 0 0 -2147483648 2147483647 ECU_ADDRESS 0x1FFFD82C PHYS_UNIT "%"
 /begin IF_DATA XCP
  /begin DAQ_EVENT VARIABLE /begin AVAILABLE_EVENT_LIST EVENT 0x00 EVENT 0x01 EVENT 0x02 /end AVAILABLE_EVENT_LIST /begin DEFAULT_EVENT_LIST EVENT 0x01 /end DEFAULT_EVENT_LIST /end DAQ_EVENT
 /end IF_DATA
/end MEASUREMENT
/begin MEASUREMENT ThrottlePositionSensorRaw "" UWORD FP_Tenth.Conversion 0 0 0 65535 ECU_ADDRESS 0x1FFFD830 PHYS_UNIT "%"
 /begin IF_DATA XCP
  /begin DAQ_EVENT VARIABLE /begin AVAILABLE_EVENT_LIST EVENT 0x00 EVENT 0x01 EVENT 0x02 /end AVAILABLE_EVENT_LIST /begin DEFAULT_EVENT_LIST EVENT 0x01 /end DEFAULT_EVENT_LIST /end DAQ_EVENT
 /end IF_DATA
/end MEASUREMENT
/begin MEASUREMENT ThrottlePositionSetPoint "" UWORD FP_Tenth.Conversion 0 0 0 65535 ECU_ADDRESS 0x1FFFD828 PHYS_UNIT "%"
 /begin IF_DATA XCP
  /begin DAQ_EVENT VARIABLE /begin AVAILABLE_EVENT_LIST EVENT 0x00 EVENT 0x01 EVENT 0x02 /end AVAILABLE_EVENT_LIST /begin DEFAULT_EVENT_LIST EVENT 0x01 /end DEFAULT_EVENT_LIST /end DAQ_EVENT
 /end IF_DATA
/end MEASUREMENT
/begin AXIS_PTS ThrottleScale "" 0x78F10 ThrottlePositionSetPoint __UWord_Axis 0 FP_Tenth.Conversion 15 0 65535 PHYS_UNIT "%" /end AXIS_PTS
/begin MEASUREMENT TorqDiff "" SLONG FP_Thousandth.Conversion 0 0 -2147483648 2147483647 ECU_ADDRESS 0x1FFFD820 PHYS_UNIT "%"
 /begin IF_DATA XCP
  /begin DAQ_EVENT VARIABLE /begin AVAILABLE_EVENT_LIST EVENT 0x00 EVENT 0x01 EVENT 0x02 /end AVAILABLE_EVENT_LIST /begin DEFAULT_EVENT_LIST EVENT 0x01 /end DEFAULT_EVENT_LIST /end DAQ_EVENT
 /end IF_DATA
/end MEASUREMENT
/begin MEASUREMENT TorqInteg "" SLONG FP_TenThousandth 0 0 -2147483648 2147483647 ECU_ADDRESS 0x1FFFD81C PHYS_UNIT "%"
 /begin IF_DATA XCP
  /begin DAQ_EVENT VARIABLE /begin AVAILABLE_EVENT_LIST EVENT 0x00 EVENT 0x01 EVENT 0x02 /end AVAILABLE_EVENT_LIST /begin DEFAULT_EVENT_LIST EVENT 0x01 /end DEFAULT_EVENT_LIST /end DAQ_EVENT
 /end IF_DATA
/end MEASUREMENT
/begin MEASUREMENT TorqProp "" SLONG FP_Thousandth.Conversion 0 0 -2147483648 2147483647 ECU_ADDRESS 0x1FFFD818 PHYS_UNIT "%"
 /begin IF_DATA XCP
  /begin DAQ_EVENT VARIABLE /begin AVAILABLE_EVENT_LIST EVENT 0x00 EVENT 0x01 EVENT 0x02 /end AVAILABLE_EVENT_LIST /begin DEFAULT_EVENT_LIST EVENT 0x01 /end DEFAULT_EVENT_LIST /end DAQ_EVENT
 /end IF_DATA
/end MEASUREMENT
/begin MEASUREMENT TorqueCmd "" SLONG FP_Tenth.Conversion 0 0 -2147483648 2147483647 ECU_ADDRESS 0x1FFFD824 PHYS_UNIT "%"
 /begin IF_DATA XCP
  /begin DAQ_EVENT VARIABLE /begin AVAILABLE_EVENT_LIST EVENT 0x00 EVENT 0x01 EVENT 0x02 /end AVAILABLE_EVENT_LIST /begin DEFAULT_EVENT_LIST EVENT 0x01 /end DEFAULT_EVENT_LIST /end DAQ_EVENT
 /end IF_DATA
/end MEASUREMENT
/begin CHARACTERISTIC TorqueMap "" MAP 0x7736C __UWord_Value 0 FP_Tenth.Conversion 0 65535
 /begin AXIS_DESCR COM_AXIS EngineSpeed SAERPM.Conversion 20 0 16000 AXIS_PTS_REF RpmScale PHYS_UNIT "RPM" /end AXIS_DESCR
 /begin AXIS_DESCR COM_AXIS TorqueCmd FP_Tenth.Conversion 15 -40 100 AXIS_PTS_REF TorqueScale PHYS_UNIT "%" /end AXIS_DESCR
 PHYS_UNIT "%" /end CHARACTERISTIC
/begin AXIS_PTS TorqueScale "" 0x775C4 TorqueCmd __SWord_Axis 0 FP_Tenth.Conversion 15 -40 100 PHYS_UNIT "%" /end AXIS_PTS
/begin AXIS_PTS TpsInput "" 0x77648 NO_INPUT_QUANTITY __SLong_Axis 0 FP_Thousandth.Conversion 2 0 5 PHYS_UNIT "V" /end AXIS_PTS
/begin CHARACTERISTIC TpsLowPassFilter "" VALUE 0x77658 __SLong_Value 0 NO_COMPU_METHOD -2147483648 2147483647 /end CHARACTERISTIC
/begin CHARACTERISTIC TpsOutput "" CURVE 0x77650 TpsOutput.RecordLayout_Copy2 0 FP_Tenth.Conversion 0 100
 /begin AXIS_DESCR COM_AXIS NO_INPUT_QUANTITY NO_COMPU_METHOD 2 0 0 AXIS_PTS_REF TpsInput /end AXIS_DESCR
 PHYS_UNIT "%" /end CHARACTERISTIC
/begin CHARACTERISTIC TriggerMaxRatio "" CURVE 0x7707C __UWord_Value 0 NO_COMPU_METHOD 100 500
 /begin AXIS_DESCR COM_AXIS EngineSpeed SAERPM.Conversion 5 0 500 AXIS_PTS_REF TriggerRpmScale PHYS_UNIT "RPM" /end AXIS_DESCR
/end CHARACTERISTIC
/begin CHARACTERISTIC TriggerMinRatio "" CURVE 0x77070 __UWord_Value 0 NO_COMPU_METHOD 1 100
 /begin AXIS_DESCR COM_AXIS EngineSpeed SAERPM.Conversion 5 0 500 AXIS_PTS_REF TriggerRpmScale PHYS_UNIT "RPM" /end AXIS_DESCR
 PHYS_UNIT "%" /end CHARACTERISTIC
/begin CHARACTERISTIC TriggerOffsetCyl2 "" VALUE 0x77860 __SWord_Value 0 FP_Tenth.Conversion 0 720 PHYS_UNIT "deg" /end CHARACTERISTIC
/begin CHARACTERISTIC TriggerOffsetCyl3 "" VALUE 0x77862 __SWord_Value 0 FP_Tenth.Conversion 0 720 PHYS_UNIT "deg" /end CHARACTERISTIC
/begin CHARACTERISTIC TriggerPosition "" VALUE 0x7785E __SWord_Value 0 FP_Tenth.Conversion 0 720 PHYS_UNIT "deg" /end CHARACTERISTIC
/begin AXIS_PTS TriggerRpmScale "" 0x77088 EngineSpeed __ULong_Axis 0 SAERPM.Conversion 5 0 13000 PHYS_UNIT "RPM" /end AXIS_PTS
/begin CHARACTERISTIC TriggerTimeoutPercentage "" VALUE 0x77064 __SLong_Value 0 NO_COMPU_METHOD 1 100 /end CHARACTERISTIC
/begin CHARACTERISTIC VBoost "" VALUE 0x7902E __UWord_Value 0 NO_COMPU_METHOD 0 65535 /end CHARACTERISTIC
/begin AXIS_PTS VoltageScale "" 0x77244 SystemVoltage __UWord_Axis 0 FP_Hundredth.Conversion 15 0 65535 PHYS_UNIT "V" /end AXIS_PTS
/begin MEASUREMENT WaterTemp1 "" SLONG FP_Tenth.Conversion 0 0 -2147483648 2147483647 ECU_ADDRESS 0x1FFFD894 PHYS_UNIT "deg C"
 /begin IF_DATA XCP
  /begin DAQ_EVENT VARIABLE /begin AVAILABLE_EVENT_LIST EVENT 0x00 EVENT 0x01 EVENT 0x02 /end AVAILABLE_EVENT_LIST /begin DEFAULT_EVENT_LIST EVENT 0x01 /end DEFAULT_EVENT_LIST /end DAQ_EVENT
 /end IF_DATA
/end MEASUREMENT
/begin CHARACTERISTIC WaterTemp1LowPassFilter "" VALUE 0x77840 __SLong_Value 0 NO_COMPU_METHOD 0 2147483647 /end CHARACTERISTIC
/begin MEASUREMENT WaterTemp1Raw "" SWORD FP_Tenth.Conversion 0 0 -32768 32767 ECU_ADDRESS 0x1FFFD8A4 PHYS_UNIT "deg C"
 /begin IF_DATA XCP
  /begin DAQ_EVENT VARIABLE /begin AVAILABLE_EVENT_LIST EVENT 0x00 EVENT 0x01 EVENT 0x02 /end AVAILABLE_EVENT_LIST /begin DEFAULT_EVENT_LIST EVENT 0x01 /end DEFAULT_EVENT_LIST /end DAQ_EVENT
 /end IF_DATA
/end MEASUREMENT
/begin MEASUREMENT WaterTemp2 "" SLONG FP_Tenth.Conversion 0 0 -2147483648 2147483647 ECU_ADDRESS 0x1FFFD898 PHYS_UNIT "deg C"
 /begin IF_DATA XCP
  /begin DAQ_EVENT VARIABLE /begin AVAILABLE_EVENT_LIST EVENT 0x00 EVENT 0x01 EVENT 0x02 /end AVAILABLE_EVENT_LIST /begin DEFAULT_EVENT_LIST EVENT 0x01 /end DEFAULT_EVENT_LIST /end DAQ_EVENT
 /end IF_DATA
/end MEASUREMENT
/begin CHARACTERISTIC WaterTemp2LowPassFilter "" VALUE 0x77844 __SLong_Value 0 NO_COMPU_METHOD 0 2147483647 /end CHARACTERISTIC
/begin MEASUREMENT WaterTemp2Raw "" SWORD FP_Tenth.Conversion 0 0 -32768 32767 ECU_ADDRESS 0x1FFFD8A6 PHYS_UNIT "deg C"
 /begin IF_DATA XCP
  /begin DAQ_EVENT VARIABLE /begin AVAILABLE_EVENT_LIST EVENT 0x00 EVENT 0x01 EVENT 0x02 /end AVAILABLE_EVENT_LIST /begin DEFAULT_EVENT_LIST EVENT 0x01 /end DEFAULT_EVENT_LIST /end DAQ_EVENT
 /end IF_DATA
/end MEASUREMENT
/begin MEASUREMENT XTau_enrichment "" SLONG FP_Tenth.Conversion 0 0 -2147483648 2147483647 ECU_ADDRESS 0x0 PHYS_UNIT "%" /end MEASUREMENT
/begin MEASUREMENT crankFailSrc "" UBYTE crankFailSrc_t_Copy1 0 0 0 255 ECU_ADDRESS 0x1FFFD95C
 /begin IF_DATA XCP
  /begin DAQ_EVENT VARIABLE /begin AVAILABLE_EVENT_LIST EVENT 0x00 EVENT 0x01 EVENT 0x02 /end AVAILABLE_EVENT_LIST /begin DEFAULT_EVENT_LIST EVENT 0x01 /end DEFAULT_EVENT_LIST /end DAQ_EVENT
 /end IF_DATA
/end MEASUREMENT
/begin MEASUREMENT cylDeactiveTorqueThreshold "" SWORD FP_Tenth.Conversion 0 0 -32768 32767 ECU_ADDRESS 0x1FFFD91E PHYS_UNIT "%"
 /begin IF_DATA XCP
  /begin DAQ_EVENT VARIABLE /begin AVAILABLE_EVENT_LIST EVENT 0x00 EVENT 0x01 EVENT 0x02 /end AVAILABLE_EVENT_LIST /begin DEFAULT_EVENT_LIST EVENT 0x01 /end DEFAULT_EVENT_LIST /end DAQ_EVENT
 /end IF_DATA
/end MEASUREMENT
/begin MEASUREMENT faultCount "" UWORD NO_COMPU_METHOD 0 0 0 65535 ECU_ADDRESS 0x1FFFD8E8
 /begin IF_DATA XCP
  /begin DAQ_EVENT VARIABLE /begin AVAILABLE_EVENT_LIST EVENT 0x00 EVENT 0x01 EVENT 0x02 /end AVAILABLE_EVENT_LIST /begin DEFAULT_EVENT_LIST EVENT 0x01 /end DEFAULT_EVENT_LIST /end DAQ_EVENT
 /end IF_DATA
/end MEASUREMENT
/begin MEASUREMENT operatingMode "" UBYTE opMode_t_Copy1 0 0 0 255 ECU_ADDRESS 0x1FFFD801
 /begin IF_DATA XCP
  /begin DAQ_EVENT VARIABLE /begin AVAILABLE_EVENT_LIST EVENT 0x00 EVENT 0x01 EVENT 0x02 /end AVAILABLE_EVENT_LIST /begin DEFAULT_EVENT_LIST EVENT 0x01 /end DEFAULT_EVENT_LIST /end DAQ_EVENT
 /end IF_DATA
/end MEASUREMENT
/begin MEASUREMENT s_vectors "" ULONG NO_COMPU_METHOD 0 0 0 4294967295 ECU_ADDRESS 0x0 MATRIX_DIM 1 /end MEASUREMENT
/begin CHARACTERISTIC s_vectors_Copy1 "" CURVE 0x0 __ULong_Value 0 NO_COMPU_METHOD 0 4294967295
 /begin AXIS_DESCR FIX_AXIS NO_INPUT_QUANTITY NO_COMPU_METHOD 1 0 0 FIX_AXIS_PAR_DIST 0 1 1 /end AXIS_DESCR
 SYMBOL_LINK "s_vectors" 0 /end CHARACTERISTIC
/begin MEASUREMENT serviceToolsState "" UBYTE serviceToolsState_t_Copy1 0 0 0 255 ECU_ADDRESS 0x1FFFD800
 /begin IF_DATA XCP
  /begin DAQ_EVENT VARIABLE /begin AVAILABLE_EVENT_LIST EVENT 0x00 EVENT 0x01 EVENT 0x02 /end AVAILABLE_EVENT_LIST /begin DEFAULT_EVENT_LIST EVENT 0x01 /end DEFAULT_EVENT_LIST /end DAQ_EVENT
 /end IF_DATA
/end MEASUREMENT
/begin CHARACTERISTIC stabilityViolationShutdown "" VALUE 0x78F46 __UByte_Value 0 binaryState_t 0 255 /end CHARACTERISTIC
/begin CHARACTERISTIC stabilizeTimeout "" VALUE 0x78F44 __UWord_Value 0 FP_Hundredth.Conversion 0 65535 PHYS_UNIT "sec" /end CHARACTERISTIC
/begin MEASUREMENT torqueLpFilterAccu "" SLONG FP_TenThousandth 0 0 -2147483648 2147483647 ECU_ADDRESS 0x20000068
 /begin IF_DATA XCP
  /begin DAQ_EVENT VARIABLE /begin AVAILABLE_EVENT_LIST EVENT 0x00 EVENT 0x01 EVENT 0x02 /end AVAILABLE_EVENT_LIST /begin DEFAULT_EVENT_LIST EVENT 0x01 /end DEFAULT_EVENT_LIST /end DAQ_EVENT
 /end IF_DATA
/end MEASUREMENT
/begin MEASUREMENT triggerRatioMax "" UWORD NO_COMPU_METHOD 0 0 0 65535 ECU_ADDRESS 0x200007D8 PHYS_UNIT "%"
 /begin IF_DATA XCP
  /begin DAQ_EVENT VARIABLE /begin AVAILABLE_EVENT_LIST EVENT 0x00 EVENT 0x01 EVENT 0x02 /end AVAILABLE_EVENT_LIST /begin DEFAULT_EVENT_LIST EVENT 0x01 /end DEFAULT_EVENT_LIST /end DAQ_EVENT
 /end IF_DATA
/end MEASUREMENT
/begin MEASUREMENT triggerRatioMin "" UWORD NO_COMPU_METHOD 0 0 0 65535 ECU_ADDRESS 0x20000826 PHYS_UNIT "%"
 /begin IF_DATA XCP
  /begin DAQ_EVENT VARIABLE /begin AVAILABLE_EVENT_LIST EVENT 0x00 EVENT 0x01 EVENT 0x02 /end AVAILABLE_EVENT_LIST /begin DEFAULT_EVENT_LIST EVENT 0x01 /end DEFAULT_EVENT_LIST /end DAQ_EVENT
 /end IF_DATA
/end MEASUREMENT
/begin MEASUREMENT xTau_InjMassCmd "" ULONG FP_Hundredth.Conversion 0 0 0 4294967295 ECU_ADDRESS 0x20000118 PHYS_UNIT "mm3/str"
 /begin IF_DATA XCP
  /begin DAQ_EVENT VARIABLE /begin AVAILABLE_EVENT_LIST EVENT 0x00 EVENT 0x01 EVENT 0x02 /end AVAILABLE_EVENT_LIST /begin DEFAULT_EVENT_LIST EVENT 0x01 /end DEFAULT_EVENT_LIST /end DAQ_EVENT
 /end IF_DATA
/end MEASUREMENT
/begin MEASUREMENT xTau_InjMassDes "" ULONG FP_Hundredth.Conversion 0 0 0 4294967295 ECU_ADDRESS 0x0 PHYS_UNIT "mm3/str" /end MEASUREMENT
/begin MEASUREMENT xTau_percentGained "" ULONG FP_Tenth.Conversion 0 0 0 4294967295 ECU_ADDRESS 0x20000110 PHYS_UNIT "X"
 /begin IF_DATA XCP
  /begin DAQ_EVENT VARIABLE /begin AVAILABLE_EVENT_LIST EVENT 0x00 EVENT 0x01 EVENT 0x02 /end AVAILABLE_EVENT_LIST /begin DEFAULT_EVENT_LIST EVENT 0x01 /end DEFAULT_EVENT_LIST /end DAQ_EVENT
 /end IF_DATA
/end MEASUREMENT
/begin MEASUREMENT xTau_percentRemain "" SLONG FP_Tenth.Conversion 0 0 -2147483648 2147483647 ECU_ADDRESS 0x2000010C PHYS_UNIT "%"
 /begin IF_DATA XCP
  /begin DAQ_EVENT VARIABLE /begin AVAILABLE_EVENT_LIST EVENT 0x00 EVENT 0x01 EVENT 0x02 /end AVAILABLE_EVENT_LIST /begin DEFAULT_EVENT_LIST EVENT 0x01 /end DEFAULT_EVENT_LIST /end DAQ_EVENT
 /end IF_DATA
/end MEASUREMENT
/begin MEASUREMENT xTau_puddleMass "" ULONG FP_Hundredth.Conversion 0 0 0 4294967295 ECU_ADDRESS 0x20000114 PHYS_UNIT "mm3"
 /begin IF_DATA XCP
  /begin DAQ_EVENT VARIABLE /begin AVAILABLE_EVENT_LIST EVENT 0x00 EVENT 0x01 EVENT 0x02 /end AVAILABLE_EVENT_LIST /begin DEFAULT_EVENT_LIST EVENT 0x01 /end DEFAULT_EVENT_LIST /end DAQ_EVENT
 /end IF_DATA
/end MEASUREMENT
/begin COMPU_METHOD CylDeactiveMaxCylRunTime.Conversion "" LINEAR "%6.3" "" COEFFS_LINEAR 0.00016666666667 0 /end COMPU_METHOD
/begin COMPU_METHOD FP_HundredMillion.Conversion "" LINEAR "%6.3" "" COEFFS_LINEAR 1E-08 0 /end COMPU_METHOD
/begin COMPU_METHOD FP_Hundredth.Conversion "" LINEAR "%6.3" "" COEFFS_LINEAR 0.01 0 /end COMPU_METHOD
/begin COMPU_METHOD FP_TenThousandth "" LINEAR "%6.3" "" COEFFS_LINEAR 1E-05 0 /end COMPU_METHOD
/begin COMPU_METHOD FP_Tenth.Conversion "" LINEAR "%6.3" "" COEFFS_LINEAR 0.1 0 /end COMPU_METHOD
/begin COMPU_METHOD FP_Thousandth.Conversion "" LINEAR "%6.3" "" COEFFS_LINEAR 0.001 0 /end COMPU_METHOD
/begin COMPU_METHOD InstanceRunTime.Conversion "" LINEAR "%6.3" "" COEFFS_LINEAR 0.000166666666667 0 /end COMPU_METHOD
/begin COMPU_METHOD MaintenanceHours.Conversion "" LINEAR "%6.3" "" COEFFS_LINEAR 1 0 /end COMPU_METHOD
/begin COMPU_METHOD PumpDutyInteg.Conversion "" LINEAR "%6.3" "" COEFFS_LINEAR 0.0005 0 /end COMPU_METHOD
/begin COMPU_METHOD SAERPM.Conversion "" LINEAR "%6.3" "" COEFFS_LINEAR 0.125 0 /end COMPU_METHOD
/begin COMPU_METHOD binaryState_t "" TAB_VERB "%.0" "" COMPU_TAB_REF binaryState_t /end COMPU_METHOD
/begin COMPU_METHOD crankFailSrc_t "enumeration table" TAB_VERB "%.0" "" COMPU_TAB_REF crankFailSrc_t /end COMPU_METHOD
/begin COMPU_METHOD crankFailSrc_t_Copy1 "enumeration table" TAB_VERB "%.0" "" COMPU_TAB_REF crankFailSrc_t_Copy1 /end COMPU_METHOD
/begin COMPU_METHOD crankMode_t "" TAB_VERB "%.0" "" COMPU_TAB_REF crankMode_t /end COMPU_METHOD
/begin COMPU_METHOD crankState_t "" TAB_VERB "%.0" "" COMPU_TAB_REF crankState_t /end COMPU_METHOD
/begin COMPU_METHOD cylinderDeactivation_t "" TAB_VERB "%.0" "" COMPU_TAB_REF cylinderDeactivation_t /end COMPU_METHOD
/begin COMPU_METHOD cylinderDeactivation_t_Copy1 "enumeration table" TAB_VERB "%.0" "" COMPU_TAB_REF cylinderDeactivation_t_Copy1 /end COMPU_METHOD
/begin COMPU_METHOD engCmdMethod_t "enumeration table" TAB_VERB "%.0" "" COMPU_TAB_REF engCmdMethod_t /end COMPU_METHOD
/begin COMPU_METHOD engCmdSource_t "enumeration table" TAB_VERB "%.0" "" COMPU_TAB_REF engCmdSource_t /end COMPU_METHOD
/begin COMPU_METHOD engineCmd_t "" TAB_VERB "%.0" "" COMPU_TAB_REF engineCmd_t /end COMPU_METHOD
/begin COMPU_METHOD externalCmdSource_t "enumeration table" TAB_VERB "%.0" "" COMPU_TAB_REF externalCmdSource_t /end COMPU_METHOD
/begin COMPU_METHOD externalEngCmdMethod_t "enumeration table" TAB_VERB "%.0" "" COMPU_TAB_REF externalEngCmdMethod_t /end COMPU_METHOD
/begin COMPU_METHOD injTrigger_t "" TAB_VERB "%.0" "" COMPU_TAB_REF injTrigger_t /end COMPU_METHOD
/begin COMPU_METHOD nosEnrichMethod_t "" TAB_VERB "%.0" "" COMPU_TAB_REF nosEnrichMethod_t /end COMPU_METHOD
/begin COMPU_METHOD opMode_t "" TAB_VERB "%.0" "" COMPU_TAB_REF opMode_t /end COMPU_METHOD
/begin COMPU_METHOD opMode_t_Copy1 "enumeration table" TAB_VERB "%.0" "" COMPU_TAB_REF opMode_t_Copy1 /end COMPU_METHOD
/begin COMPU_METHOD pumpControlMethod_t "" TAB_VERB "%.0" "" COMPU_TAB_REF pumpControlMethod_t /end COMPU_METHOD
/begin COMPU_METHOD pumpDriver_t "" TAB_VERB "%.0" "" COMPU_TAB_REF pumpDriver_t /end COMPU_METHOD
/begin COMPU_METHOD pumpModes_t "" TAB_VERB "%.0" "" COMPU_TAB_REF pumpModes_t /end COMPU_METHOD
/begin COMPU_METHOD pumpModes_t_Copy1 "enumeration table" TAB_VERB "%.0" "" COMPU_TAB_REF pumpModes_t_Copy1 /end COMPU_METHOD
/begin COMPU_METHOD serviceToolsState_t "" TAB_VERB "%.0" "" COMPU_TAB_REF serviceToolsState_t /end COMPU_METHOD
/begin COMPU_METHOD serviceToolsState_t_Copy1 "enumeration table" TAB_VERB "%.0" "" COMPU_TAB_REF serviceToolsState_t_Copy1 /end COMPU_METHOD
/begin COMPU_METHOD sparkEdgeSelect_t "" TAB_VERB "%.0" "" COMPU_TAB_REF sparkEdgeSelect_t /end COMPU_METHOD
/begin COMPU_METHOD sparkTtlEdgeType_t "" TAB_VERB "%.0" "" COMPU_TAB_REF sparkTtlEdgeType_t /end COMPU_METHOD
/begin COMPU_METHOD throttleCmdSource_t "" TAB_VERB "%.0" "" COMPU_TAB_REF throttleCmdSource_t /end COMPU_METHOD
/begin COMPU_METHOD throttleControlMethod_t "" TAB_VERB "%.0" "" COMPU_TAB_REF throttleControlMethod_t /end COMPU_METHOD
/begin COMPU_VTAB binaryState_t "" TAB_VERB 2 0 "OFF" 1 "ON" /end COMPU_VTAB
/begin COMPU_VTAB crankFailSrc_t "enumeration table" TAB_VERB 3 0 "CRANKFAIL_SRC_TIMEOUT" 1 "CRANKFAIL_SRC_TRIGGER_FAST" 2 "CRANKFAIL_SRC_TRIGGER_SLOW" /end COMPU_VTAB
/begin COMPU_VTAB crankFailSrc_t_Copy1 "enumeration table" TAB_VERB 4 0 "CRANKFAIL_SRC_NO_FAIL" 1 "CRANKFAIL_SRC_TIMEOUT" 2 "CRANKFAIL_SRC_TRIGGER_FAST" 3 "CRANKFAIL_SRC_TRIGGER_SLOW" /end COMPU_VTAB
/begin COMPU_VTAB crankMode_t "" TAB_VERB 2 0 "CRANK_MODE_MANUAL" 1 "CRANK_MODE_AUTO" /end COMPU_VTAB
/begin COMPU_VTAB crankState_t "" TAB_VERB 7 0 "TOOTH_INIT" 1 "CRANK_FIRST_EDGE" 2 "CRANK_FIRST_PERIOD" 3 "CRANK_TESTING_FOR_GAP" 4 "CRANK_VALIDATING_GAP" 5 "CRANK_SYNCHRONIZED" 6 "CRANK_SYNCHRONIZED_4C" /end COMPU_VTAB
/begin COMPU_VTAB cylinderDeactivation_t "" TAB_VERB 3 0 "CYL_DEACTIVATION_OFF" 1 "CYL_DEACTIVATION_CYL_ONE" 2 "CYL_DEACTIVATION_CYL_TWO" /end COMPU_VTAB
/begin COMPU_VTAB cylinderDeactivation_t_Copy1 "enumeration table" TAB_VERB 4 0 "CYL_DEACTIVATION_OFF" 1 "CYL_DEACTIVATION_CYL_ONE" 2 "CYL_DEACTIVATION_CYL_TWO" 3 "CYL_DEACTIVATION_CYL_TRANSITION" /end COMPU_VTAB
/begin COMPU_VTAB engCmdMethod_t "enumeration table" TAB_VERB 3 0 "ENG_CMD_METHOD_THROTTLE_COMMAND" 1 "ENG_CMD_METHOD_TORQUE_COMMAND" 2 "ENG_CMD_METHOD_SPEED_CONTROL" /end COMPU_VTAB
/begin COMPU_VTAB engCmdSource_t "enumeration table" TAB_VERB 3 0 "ENG_CMD_SOURCE_CAN" 1 "ENG_CMD_SOURCE_ANA_PWM" 2 "ENG_CMD_SOURCE_DISABLED" /end COMPU_VTAB
/begin COMPU_VTAB engineCmd_t "" TAB_VERB 3 0 "ENGINECMD_OFF" 1 "ENGINECMD_RUN" 2 "ENGINECMD_AUTO" /end COMPU_VTAB
/begin COMPU_VTAB externalCmdSource_t "enumeration table" TAB_VERB 2 0 "EXTERNAL_CMD_SOURCE_CAN" 1 "EXTERNAL_CMD_SOURCE_ANA_PWM" /end COMPU_VTAB
/begin COMPU_VTAB externalEngCmdMethod_t "enumeration table" TAB_VERB 3 0 "EXTERNAL_CTRL_DIRECT_COMMAND" 1 "EXTERNAL_CTRL_TORQUE_COMMAND" 2 "EXTERNAL_CTRL_SPEED_CONTROL" /end COMPU_VTAB
/begin COMPU_VTAB injTrigger_t "" TAB_VERB 2 0 "INJ_TRIGGER_EOI" 1 "INJ_TRIGGER_SOI" /end COMPU_VTAB
/begin COMPU_VTAB nosEnrichMethod_t "" TAB_VERB 2 0 "NOS_ENRICH_EXISTING_INJECTORS" 1 "NOS_ENRICH_3RD_INJ" /end COMPU_VTAB
/begin COMPU_VTAB opMode_t "" TAB_VERB 10 0 "OP_POWER_UP" 1 "OP_BUILT_IN_TEST" 2 "OP_FAULT" 3 "OP_SHUTDOWN" 4 "OP_STANDBY" 5 "OP_PRESTART" 6 "OP_READY_TO_RUN" 7 "OP_CRANKING" 8 "OP_STABILIZE" 9 "OP_RUN" /end COMPU_VTAB
/begin COMPU_VTAB opMode_t_Copy1 "enumeration table" TAB_VERB 11 0 "OP_POWER_UP" 1 "OP_BUILT_IN_TEST" 2 "OP_FAULT" 3 "OP_SHUTDOWN" 4 "OP_STANDBY" 5 "OP_PRESTART" 6 "OP_READY_TO_RUN" 7 "OP_CRANKING" 8 "OP_STABILIZE" 9 "OP_RUN" 10 "OP_SERVICE_TOOLS" /end COMPU_VTAB
/begin COMPU_VTAB pumpControlMethod_t "" TAB_VERB 2 0 "PUMP_CONTROL_CLOSED_LOOP" 1 "PUMP_CONTROL_OPEN_LOOP" /end COMPU_VTAB
/begin COMPU_VTAB pumpDriver_t "" TAB_VERB 2 0 "PUMPDRIVER_POWER" 1 "PUMPDRIVER_SIGNAL" /end COMPU_VTAB
/begin COMPU_VTAB pumpModes_t "" TAB_VERB 4 0 "PUMP_OFF" 1 "PUMP_AUTOPRIME" 2 "PUMP_BIT" 3 "PUMP_RUN" /end COMPU_VTAB
/begin COMPU_VTAB pumpModes_t_Copy1 "enumeration table" TAB_VERB 5 0 "PUMP_OFF" 1 "PUMP_AUTOPRIME" 2 "PUMP_BIT" 3 "PUMP_RUN" 4 "PUMP_ST_JOG" /end COMPU_VTAB
/begin COMPU_VTAB serviceToolsState_t "" TAB_VERB 11 0 "ST_STATE_IDLE" 1 "ST_STATE_FUEL_INJ_TEST" 2 "ST_STATE_OIL_INJ_TEST" 3 "ST_STATE_FUEL_PUMP_TEST" 4 "ST_STATE_IGNITION_TEST" 5 "ST_STATE_SERVO_TEST" 7 "ST_STATE_NOS_TEST" 8 "ST_STATE_WATER_PUMP_TEST" 10 "ST_STATE_HEATER_TEST" 13 "ST_STATE_LS_DRIVER_TEST" 14 "ST_STATE_DATALOGGER" /end COMPU_VTAB
/begin COMPU_VTAB serviceToolsState_t_Copy1 "enumeration table" TAB_VERB 14 0 "ST_STATE_IDLE" 1 "ST_STATE_FUEL_INJ_TEST" 2 "ST_STATE_OIL_INJ_TEST" 3 "ST_STATE_FUEL_PUMP_TEST" 4 "ST_STATE_IGNITION_TEST" 5 "ST_STATE_SERVO_TEST" 7 "ST_STATE_NOS_TEST" 8 "ST_STATE_WATER_PUMP_TEST" 10 "ST_STATE_HEATER_TEST" 13 "ST_STATE_LS_DRIVER_TEST" 16 "ST_STATE_RESET_SERVICE_RUN_HOURS" 17 "ST_STATE_RESET_FUEL_CONSUMPTION" 18 "ST_STATE_RESET_OIL_CONSUMPTION" 19 "ST_STATE_RESET_NOS_TIMER" /end COMPU_VTAB
/begin COMPU_VTAB sparkEdgeSelect_t "" TAB_VERB 2 0 "SPARK_EDGE_DWELL" 1 "SPARK_EDGE_TTL" /end COMPU_VTAB
/begin COMPU_VTAB sparkTtlEdgeType_t "" TAB_VERB 2 0 "SPARK_TRIGGER_RISING_EDGE" 1 "SPARK_TRIGGER_FALLING_EDGE" /end COMPU_VTAB
/begin COMPU_VTAB throttleCmdSource_t "" TAB_VERB 2 0 "THROTTLE_CMD_SOURCE_CAN" 1 "THROTTLE_CMD_SOURCE_ANA_PWM" /end COMPU_VTAB
/begin COMPU_VTAB throttleControlMethod_t "" TAB_VERB 3 0 "THROTTLE_CTRL_DIRECT_COMMAND" 1 "THROTTLE_CTRL_TORQUE_COMMAND" 2 "THROTTLE_CTRL_SPEED_CONTROL" /end COMPU_VTAB
/begin RECORD_LAYOUT AnaIn0Input.RecordLayout FNC_VALUES 1 SLONG ROW_DIR DIRECT AXIS_PTS_X 1 SLONG INDEX_INCR DIRECT /end RECORD_LAYOUT
/begin RECORD_LAYOUT AnaIn1Input.RecordLayout FNC_VALUES 1 SLONG ROW_DIR DIRECT AXIS_PTS_X 1 SLONG INDEX_INCR DIRECT /end RECORD_LAYOUT
/begin RECORD_LAYOUT BarometerOutput.RecordLayout AXIS_PTS_X 1 SLONG INDEX_INCR DIRECT FNC_VALUES 1 SLONG ROW_DIR DIRECT /end RECORD_LAYOUT
/begin RECORD_LAYOUT FuelPressureInput.RecordLayout FNC_VALUES 1 SLONG ROW_DIR DIRECT AXIS_PTS_X 1 SLONG INDEX_INCR DIRECT /end RECORD_LAYOUT
/begin RECORD_LAYOUT MapOutput.RecordLayout AXIS_PTS_X 1 SLONG INDEX_INCR DIRECT FNC_VALUES 1 SLONG ROW_DIR DIRECT /end RECORD_LAYOUT
/begin RECORD_LAYOUT PcbTempResistance.RecordLayout FNC_VALUES 1 SLONG ROW_DIR DIRECT AXIS_PTS_X 1 SLONG INDEX_INCR DIRECT /end RECORD_LAYOUT
/begin RECORD_LAYOUT PcbTempScale.RecordLayout AXIS_PTS_X 1 SLONG INDEX_INCR DIRECT FNC_VALUES 1 SLONG ROW_DIR DIRECT /end RECORD_LAYOUT
/begin RECORD_LAYOUT PcbTempScale.RecordLayout_Copy1 AXIS_PTS_X 1 SLONG INDEX_INCR DIRECT FNC_VALUES 1 SLONG ROW_DIR DIRECT /end RECORD_LAYOUT
/begin RECORD_LAYOUT PumpInletPressOutput.RecordLayout AXIS_PTS_X 1 SLONG INDEX_INCR DIRECT FNC_VALUES 1 SLONG ROW_DIR DIRECT /end RECORD_LAYOUT
/begin RECORD_LAYOUT PumpInletPressOutput.RecordLayout_Copy1 AXIS_PTS_X 1 SLONG INDEX_INCR DIRECT FNC_VALUES 1 SLONG ROW_DIR DIRECT /end RECORD_LAYOUT
/begin RECORD_LAYOUT TauCurve.RecordLayout AXIS_PTS_X 1 ULONG INDEX_INCR DIRECT FNC_VALUES 1 ULONG ROW_DIR DIRECT /end RECORD_LAYOUT
/begin RECORD_LAYOUT ThrottleCurrentOutput.RecordLayout AXIS_PTS_X 1 SLONG INDEX_INCR DIRECT FNC_VALUES 1 SLONG ROW_DIR DIRECT /end RECORD_LAYOUT
/begin RECORD_LAYOUT TpsOutput.RecordLayout AXIS_PTS_X 1 SLONG INDEX_INCR DIRECT FNC_VALUES 1 SLONG ROW_DIR DIRECT ALIGNMENT_LONG 4 /end RECORD_LAYOUT
/begin RECORD_LAYOUT TpsOutput.RecordLayout_Copy1 AXIS_PTS_X 1 SLONG INDEX_INCR DIRECT FNC_VALUES 1 SLONG ROW_DIR DIRECT /end RECORD_LAYOUT
/begin RECORD_LAYOUT TpsOutput.RecordLayout_Copy2 AXIS_PTS_X 1 SLONG INDEX_INCR DIRECT FNC_VALUES 1 SLONG ROW_DIR DIRECT /end RECORD_LAYOUT
/begin RECORD_LAYOUT __SLong_Axis AXIS_PTS_X 1 SLONG INDEX_INCR DIRECT /end RECORD_LAYOUT
/begin RECORD_LAYOUT __SLong_Value FNC_VALUES 1 SLONG ROW_DIR DIRECT /end RECORD_LAYOUT
/begin RECORD_LAYOUT __SWord_Axis AXIS_PTS_X 1 SWORD INDEX_INCR DIRECT /end RECORD_LAYOUT
/begin RECORD_LAYOUT __SWord_Value FNC_VALUES 1 SWORD ROW_DIR DIRECT /end RECORD_LAYOUT
/begin RECORD_LAYOUT __UByte_Value FNC_VALUES 1 UBYTE ROW_DIR DIRECT /end RECORD_LAYOUT
/begin RECORD_LAYOUT __ULong_Axis AXIS_PTS_X 1 ULONG INDEX_INCR DIRECT /end RECORD_LAYOUT
/begin RECORD_LAYOUT __ULong_Value FNC_VALUES 1 ULONG ROW_DIR DIRECT /end RECORD_LAYOUT
/begin RECORD_LAYOUT __UWord_Axis AXIS_PTS_X 1 UWORD INDEX_INCR DIRECT /end RECORD_LAYOUT
/begin RECORD_LAYOUT __UWord_Value FNC_VALUES 1 UWORD ROW_DIR DIRECT /end RECORD_LAYOUT
/end MODULE
/end PROJECT
