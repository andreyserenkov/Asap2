/* generated by ASAP2 Studio 2.6.30.12408 */ ASAP2_VERSION 1 71
/begin PROJECT ProjectName ""
/begin MODULE ModuleName "FCR-21"
/begin MOD_PAR "" ADDR_EPK 0xC01 ECU "FCR-21"
 /begin MEMORY_SEGMENT CAL_FLASH "" DATA FLASH INTERN 0x1C000 0x4000 -1 -1 -1 -1 -1
  /begin IF_DATA XCP
   /begin SEGMENT 0x01 0x01 0x00 0x00 0x00
    /begin CHECKSUM XCP_ADD_12 MAX_BLOCK_SIZE 0xFFFFFFFF EXTERNAL_FUNCTION "chksum.dll" /end CHECKSUM
    /begin PAGE 0x00 ECU_ACCESS_DONT_CARE XCP_READ_ACCESS_DONT_CARE XCP_WRITE_ACCESS_NOT_ALLOWED /end PAGE
   /end SEGMENT
  /end IF_DATA
 /end MEMORY_SEGMENT
 /begin MEMORY_SEGMENT FW_EPK "" CODE FLASH INTERN 0x1B7F0 0x8 -1 -1 -1 -1 -1
  /begin IF_DATA XCP
   /begin SEGMENT 0x00 0x00 0x00 0x00 0x00
    /begin CHECKSUM XCP_ADD_12 MAX_BLOCK_SIZE 0xFFFFFFFF EXTERNAL_FUNCTION "chksum.dll" /end CHECKSUM
   /end SEGMENT
  /end IF_DATA
 /end MEMORY_SEGMENT
 /begin MEMORY_SEGMENT PoolRAM "" SERAM RAM INTERN 0x20000600 0x800 -1 -1 -1 -1 -1
  /begin IF_DATA XCP
   /begin SEGMENT 0x01 0x00 0x00 0x00 0x00
    /begin CHECKSUM XCP_ADD_12 MAX_BLOCK_SIZE 0xFFFFFFFF EXTERNAL_FUNCTION "chksum.dll" /end CHECKSUM
   /end SEGMENT
  /end IF_DATA
 /end MEMORY_SEGMENT
 /begin CALIBRATION_METHOD "AUTOSAR_SINGLE_POINTERED" 0x1 /begin CALIBRATION_HANDLE 0x1FFFF000 0x1D4 0x4 /end CALIBRATION_HANDLE /end CALIBRATION_METHOD
/end MOD_PAR
/begin MOD_COMMON "" ALIGNMENT_BYTE 1 ALIGNMENT_WORD 2 ALIGNMENT_LONG 4 ALIGNMENT_FLOAT16_IEEE 1 ALIGNMENT_FLOAT32_IEEE 4 ALIGNMENT_FLOAT64_IEEE 8 ALIGNMENT_INT64 8 /end MOD_COMMON
/begin IF_DATA XCP
 /begin PROTOCOL_LAYER 0x0100 0x3C 0x64 0x00 0x00 0x00 0x00 0x00 0x08 0x08 BYTE_ORDER_MSB_LAST ADDRESS_GRANULARITY_BYTE OPTIONAL_CMD PROGRAM_RESET OPTIONAL_CMD PROGRAM OPTIONAL_CMD PROGRAM_CLEAR OPTIONAL_CMD PROGRAM_START OPTIONAL_CMD ALLOC_ODT_ENTRY OPTIONAL_CMD ALLOC_ODT OPTIONAL_CMD ALLOC_DAQ OPTIONAL_CMD FREE_DAQ OPTIONAL_CMD GET_DAQ_RESOLUTION_INFO OPTIONAL_CMD GET_DAQ_PROCESSOR_INFO OPTIONAL_CMD GET_DAQ_CLOCK OPTIONAL_CMD START_STOP_SYNCH OPTIONAL_CMD START_STOP_DAQ_LIST OPTIONAL_CMD GET_DAQ_LIST_MODE OPTIONAL_CMD SET_DAQ_LIST_MODE OPTIONAL_CMD WRITE_DAQ OPTIONAL_CMD SET_DAQ_PTR OPTIONAL_CMD CLEAR_DAQ_LIST OPTIONAL_CMD DOWNLOAD OPTIONAL_CMD BUILD_CHECKSUM OPTIONAL_CMD UPLOAD OPTIONAL_CMD SET_MTA /end PROTOCOL_LAYER
 /begin DAQ DYNAMIC 0x00 0x01 0x00 OPTIMISATION_TYPE_DEFAULT ADDRESS_EXTENSION_FREE IDENTIFICATION_FIELD_TYPE_ABSOLUTE GRANULARITY_ODT_ENTRY_SIZE_DAQ_BYTE 0x07 NO_OVERLOAD_INDICATION PRESCALER_SUPPORTED /begin TIMESTAMP_SUPPORTED 0x01 SIZE_WORD UNIT_1MS /end TIMESTAMP_SUPPORTED
  /begin DAQ_LIST 0x00 DAQ_LIST_TYPE LIST_TYPE MAX_ODT 0xFF MAX_ODT_ENTRIES 0xFF FIRST_PID 0x00 /end DAQ_LIST
  /begin EVENT "20ms" "20ms" 0x00 "DAQ" 0xFF 0x14 0x06 0x00 /end EVENT
 /end DAQ
 /begin PAG 0x03 /end PAG
 /begin PGM PGM_MODE_ABSOLUTE 0x20 0x00 /begin SECTOR "FLASH" 0x00 0x01C000 0x0200 0x00 0x00 0x00 /end SECTOR /begin SECTOR "FLASH" 0x01 0x01C200 0x0200 0x00 0x00 0x00 /end SECTOR /begin SECTOR "FLASH" 0x02 0x01C400 0x0200 0x00 0x00 0x00 /end SECTOR /begin SECTOR "FLASH" 0x03 0x01C600 0x0200 0x00 0x00 0x00 /end SECTOR /begin SECTOR "FLASH" 0x04 0x01C800 0x0200 0x00 0x00 0x00 /end SECTOR /begin SECTOR "FLASH" 0x05 0x01CA00 0x0200 0x00 0x00 0x00 /end SECTOR /begin SECTOR "FLASH" 0x06 0x01CC00 0x0200 0x00 0x00 0x00 /end SECTOR /begin SECTOR "FLASH" 0x07 0x01CE00 0x0200 0x00 0x00 0x00 /end SECTOR /begin SECTOR "FLASH" 0x08 0x01D000 0x0200 0x00 0x00 0x00 /end SECTOR /begin SECTOR "FLASH" 0x09 0x01D200 0x0200 0x00 0x00 0x00 /end SECTOR /begin SECTOR "FLASH" 0x0A 0x01D400 0x0200 0x00 0x00 0x00 /end SECTOR /begin SECTOR "FLASH" 0x0B 0x01D600 0x0200 0x00 0x00 0x00 /end SECTOR /begin SECTOR "FLASH" 0x0C 0x01D800 0x0200 0x00 0x00 0x00 /end SECTOR /begin SECTOR "FLASH" 0x0D 0x01DA00 0x0200 0x00 0x00 0x00 /end SECTOR /begin SECTOR "FLASH" 0x0E 0x01DC00 0x0200 0x00 0x00 0x00 /end SECTOR /begin SECTOR "FLASH" 0x0F 0x01DE00 0x0200 0x00 0x00 0x00 /end SECTOR /begin SECTOR "FLASH" 0x10 0x01E000 0x0200 0x00 0x00 0x00 /end SECTOR /begin SECTOR "FLASH" 0x11 0x01E200 0x0200 0x00 0x00 0x00 /end SECTOR /begin SECTOR "FLASH" 0x12 0x01E400 0x0200 0x00 0x00 0x00 /end SECTOR /begin SECTOR "FLASH" 0x13 0x01E600 0x0200 0x00 0x00 0x00 /end SECTOR /begin SECTOR "FLASH" 0x14 0x01E800 0x0200 0x00 0x00 0x00 /end SECTOR /begin SECTOR "FLASH" 0x15 0x01EA00 0x0200 0x00 0x00 0x00 /end SECTOR /begin SECTOR "FLASH" 0x16 0x01EC00 0x0200 0x00 0x00 0x00 /end SECTOR /begin SECTOR "FLASH" 0x17 0x01EE00 0x0200 0x00 0x00 0x00 /end SECTOR /begin SECTOR "FLASH" 0x18 0x01F000 0x0200 0x00 0x00 0x00 /end SECTOR /begin SECTOR "FLASH" 0x19 0x01F200 0x0200 0x00 0x00 0x00 /end SECTOR /begin SECTOR "FLASH" 0x1A 0x01F400 0x0200 0x00 0x00 0x00 /end SECTOR /begin SECTOR "FLASH" 0x1B 0x01F600 0x0200 0x00 0x00 0x00 /end SECTOR /begin SECTOR "FLASH" 0x1C 0x01F800 0x0200 0x00 0x00 0x00 /end SECTOR /begin SECTOR "FLASH" 0x1D 0x01FA00 0x0200 0x00 0x00 0x00 /end SECTOR /begin SECTOR "FLASH" 0x1E 0x01FC00 0x0200 0x00 0x00 0x00 /end SECTOR /begin SECTOR "FLASH" 0x1F 0x01FE00 0x0200 0x00 0x00 0x00 /end SECTOR /end PGM
 /begin XCP_ON_CAN 0x0100 CAN_ID_MASTER 0x92750001 CAN_ID_SLAVE 0x92750C00 BAUDRATE 0x07A120 SAMPLE_POINT 0x4B SAMPLE_RATE SINGLE BTL_CYCLES 0x08 SJW 0x02 SYNC_EDGE SINGLE /end XCP_ON_CAN
/end IF_DATA
/begin MEASUREMENT AccelEnrich "" SWORD TenthFP 0 0 -32768 32767 ECU_ADDRESS 0x200004C6 PHYS_UNIT "%" /end MEASUREMENT
/begin CHARACTERISTIC AccelMap "" MAP 0x1E3A4 TorqueMap.Layout 0 TenthFP 0 65535
 /begin AXIS_DESCR COM_AXIS RPM SAERPM.Conversion 20 0 9000 AXIS_PTS_REF RpmScale PHYS_UNIT "RPM" /end AXIS_DESCR
 /begin AXIS_DESCR COM_AXIS EngTemp Temperature 15 -70 1000 AXIS_PTS_REF TempScale FORMAT "%.15" /end AXIS_DESCR
 FORMAT "%.15" PHYS_UNIT "%" /end CHARACTERISTIC
/begin MEASUREMENT AccelRate "" SWORD NO_COMPU_METHOD 0 0 -32768 32767 ECU_ADDRESS 0x200004C8 FORMAT "%.15" /end MEASUREMENT
/begin CHARACTERISTIC AccelRateTimeConstant "" VALUE 0x1E5FC TorqueMap.Layout 0 NO_COMPU_METHOD 2 1000 FORMAT "%.15" /end CHARACTERISTIC
/begin CHARACTERISTIC AccelTrigger "" VALUE 0x1E3A0 __SWORD_S 0 NO_COMPU_METHOD -32768 32767 FORMAT "%.15" /end CHARACTERISTIC
/begin MEASUREMENT AirTemp "" SWORD Temperature 0 0 -45 250 ECU_ADDRESS 0x2000042C
 /begin IF_DATA XCP
  /begin DAQ_EVENT FIXED_EVENT_LIST "EVENT" 0x00 /end DAQ_EVENT
 /end IF_DATA
/end MEASUREMENT
/begin MEASUREMENT AirTempAccumulator "" SLONG NO_COMPU_METHOD 0 0 0 4294967295 ECU_ADDRESS 0x20001004 FORMAT "%.15" /end MEASUREMENT
/begin CHARACTERISTIC AirTempLookup "" CURVE 0x1E31C __SWORD_S 0 Temperature -70 1000
 /begin AXIS_DESCR COM_AXIS NO_INPUT_QUANTITY NO_COMPU_METHOD 50 0 4095 AXIS_PTS_REF AirTempVoltageScale FORMAT "%.15" PHYS_UNIT "deg C" /end AXIS_DESCR
 PHYS_UNIT "deg C" SYMBOL_LINK "AirTempScale" 0 /end CHARACTERISTIC
/begin AXIS_PTS AirTempVoltageScale "" 0x1E2B8 NO_INPUT_QUANTITY SSV__SWORD_S 0 NO_COMPU_METHOD 50 0 4095 DEPOSIT ABSOLUTE FORMAT "%.15" PHYS_UNIT "ATD val" SYMBOL_LINK "AirTempATD" 0 /end AXIS_PTS
/begin MEASUREMENT AnaIn1 "" UWORD NO_COMPU_METHOD 0 0 0 65535 ECU_ADDRESS 0x2000043E FORMAT "%.15"
 /begin IF_DATA XCP
  /begin DAQ_EVENT FIXED_EVENT_LIST "EVENT" 0x00 /end DAQ_EVENT
 /end IF_DATA
/end MEASUREMENT
/begin MEASUREMENT AnaIn2 "" UWORD NO_COMPU_METHOD 0 0 0 65535 ECU_ADDRESS 0x20000440 FORMAT "%.15"
 /begin IF_DATA XCP
  /begin DAQ_EVENT FIXED_EVENT_LIST "EVENT" 0x00 /end DAQ_EVENT
 /end IF_DATA
/end MEASUREMENT
/begin MEASUREMENT ArrayTooth "" UWORD NO_COMPU_METHOD 0 0 0 65535 ECU_ADDRESS 0x2000120E FORMAT "%.15" /end MEASUREMENT
/begin MEASUREMENT ArrayTooth2 "" UWORD NO_COMPU_METHOD 0 0 0 65535 ECU_ADDRESS 0x20001204 FORMAT "%.15" /end MEASUREMENT
/begin MEASUREMENT AutoPrime "" UWORD ThousandthFP 0 0 0 65535 ECU_ADDRESS 0x20000482 FORMAT "%1.3" PHYS_UNIT "sec" /end MEASUREMENT
/begin CHARACTERISTIC AutoPrimeCurve "" CURVE 0x1E0AC __UWORD_S 0 ThousandthFP 0 500
 /begin AXIS_DESCR COM_AXIS EngTemp Temperature 15 -70 1000 AXIS_PTS_REF TempScale FORMAT "%.15" /end AXIS_DESCR
 FORMAT "%.15" PHYS_UNIT "ms autoprime" /end CHARACTERISTIC
/begin MEASUREMENT Barometer "" SWORD NO_COMPU_METHOD 0 0 0 1200 ECU_ADDRESS 0x2000042A FORMAT "%.15" PHYS_UNIT "mbar"
 /begin IF_DATA XCP
  /begin DAQ_EVENT FIXED_EVENT_LIST "EVENT" 0x00 /end DAQ_EVENT
 /end IF_DATA
/end MEASUREMENT
/begin CHARACTERISTIC BarometerGain "" VALUE 0x1E120 __SWORD_S 0 Volt_ATD 0 65535 FORMAT "%.15" PHYS_UNIT "mbar/mV" /end CHARACTERISTIC
/begin AXIS_PTS BarometerLookup "" 0x1DF24 Barometer SSV__UWORD_S 0 NO_COMPU_METHOD 3 0 1200 DEPOSIT ABSOLUTE FORMAT "%.15" PHYS_UNIT "mbar" /end AXIS_PTS
/begin CHARACTERISTIC BarometerOffset "" VALUE 0x1E122 __SWORD_S 0 NO_COMPU_METHOD 0 65535 FORMAT "%.15" PHYS_UNIT "mbar" /end CHARACTERISTIC
/begin MEASUREMENT Barometer_High "Barometer above feasible range" UBYTE Errors.Conversion 0 0 0 255 BIT_MASK 0x20 ECU_ADDRESS 0x200004BC FORMAT "%.15" SYMBOL_LINK "fault_active_byte3" 0 /end MEASUREMENT
/begin MEASUREMENT Barometer_Low "Barometer below feasible range" UBYTE Errors.Conversion 0 0 0 255 BIT_MASK 0x10 ECU_ADDRESS 0x200004BC FORMAT "%.15" SYMBOL_LINK "fault_active_byte3" 0 /end MEASUREMENT
/begin CHARACTERISTIC BreakIn_Dur "" VALUE 0x1E6FE __UWord_Value 0 HundredthFP 0 65535 PHYS_UNIT "hr" /end CHARACTERISTIC
/begin CHARACTERISTIC BreakIn_OilEnrich "" VALUE 0x1E700 __UWord_Value 0 TenthFP 0 65535 PHYS_UNIT "%" /end CHARACTERISTIC
/begin MEASUREMENT CHT "" SWORD EGT.Conversion 0 0 0 900 ECU_ADDRESS 0x20000438 FORMAT "%3.1" PHYS_UNIT "deg C" SYMBOL_LINK "EGT2" 0
 /begin IF_DATA XCP
  /begin DAQ_EVENT FIXED_EVENT_LIST "EVENT" 0x00 /end DAQ_EVENT
 /end IF_DATA
/end MEASUREMENT
/begin MEASUREMENT CHT1 "" SWORD Temperature 0 0 -70 400 ECU_ADDRESS 0x20000432 FORMAT "%.15" PHYS_UNIT "deg C"
 /begin IF_DATA XCP
  /begin DAQ_EVENT FIXED_EVENT_LIST "EVENT" 0x00 /end DAQ_EVENT
 /end IF_DATA
/end MEASUREMENT
/begin MEASUREMENT CHT1_Open_Circuit "CHT sensor open circuit" UBYTE Errors.Conversion 0 0 0 255 BIT_MASK 0x20 ECU_ADDRESS 0x200004B9 SYMBOL_LINK "fault_active_byte0" 0 /end MEASUREMENT
/begin MEASUREMENT CHT1_Short_to_Gnd "Sensor short to ground" UBYTE Errors.Conversion 0 0 0 255 BIT_MASK 0x40 ECU_ADDRESS 0x200004B9 FORMAT "%.15" SYMBOL_LINK "fault_active_byte0" 0 /end MEASUREMENT
/begin MEASUREMENT CHT2 "" SWORD Temperature 0 0 -70 400 ECU_ADDRESS 0x20000434 FORMAT "%.15" PHYS_UNIT "deg C"
 /begin IF_DATA XCP
  /begin DAQ_EVENT FIXED_EVENT_LIST "EVENT" 0x00 /end DAQ_EVENT
 /end IF_DATA
/end MEASUREMENT
/begin MEASUREMENT CHT2_Open_Circuit "Sensor open circuit" UBYTE Errors.Conversion 0 0 0 255 BIT_MASK 0x1 ECU_ADDRESS 0x200004BA FORMAT "%.15" SYMBOL_LINK "fault_active_byte1" 0 /end MEASUREMENT
/begin MEASUREMENT CHT2_Short_to_Gnd "Sensor short to ground" UBYTE Errors.Conversion 0 0 0 255 BIT_MASK 0x2 ECU_ADDRESS 0x200004BA FORMAT "%.15" SYMBOL_LINK "fault_active_byte1" 0 /end MEASUREMENT
/begin CHARACTERISTIC CalNameEmission "" ASCII 0x1C000 __UBYTE_Z 0 NO_COMPU_METHOD 0 255 NUMBER 100 /end CHARACTERISTIC
/begin CHARACTERISTIC CanIdAnomaly "" VALUE 0x1E38C __ULONG_S 0 NO_COMPU_METHOD 0 4294967295 FORMAT "%.15" /end CHARACTERISTIC
/begin CHARACTERISTIC CanIdEngineCommand "" VALUE 0x1E384 __ULONG_S 0 NO_COMPU_METHOD 0 4294967295 FORMAT "%.15" /end CHARACTERISTIC
/begin CHARACTERISTIC CanIdEngineParameters "" VALUE 0x1E394 __ULONG_S 0 NO_COMPU_METHOD 0 4294967295 FORMAT "%.15" /end CHARACTERISTIC
/begin CHARACTERISTIC CanIdFaults "" VALUE 0x1E390 __ULONG_S 0 NO_COMPU_METHOD 0 4294967295 FORMAT "%.15" /end CHARACTERISTIC
/begin CHARACTERISTIC CanIdFuelParameters "" VALUE 0x1E388 __ULONG_S 0 NO_COMPU_METHOD 0 4294967295 FORMAT "%.15" /end CHARACTERISTIC
/begin CHARACTERISTIC CanIdSensor1 "" VALUE 0x1E398 __ULONG_S 0 NO_COMPU_METHOD 0 4294967295 FORMAT "%.15" /end CHARACTERISTIC
/begin CHARACTERISTIC CanIdSensor2 "" VALUE 0x1E39C __ULONG_S 0 NO_COMPU_METHOD 0 4294967295 FORMAT "%8.2" /end CHARACTERISTIC
/begin AXIS_PTS ChtCalLookup "" 0x1E18C NO_INPUT_QUANTITY SSV__SWORD_S 0 Temperature 50 -70 1000 DEPOSIT ABSOLUTE SYMBOL_LINK "ChtCalScale" 0 /end AXIS_PTS
/begin CHARACTERISTIC ChtCalVoltageScale "" CURVE 0x1E128 __SWORD_S 0 Volt_ATD 0 5000
 /begin AXIS_DESCR COM_AXIS NO_INPUT_QUANTITY Temperature 50 -70 1000 AXIS_PTS_REF ChtCalLookup /end AXIS_DESCR
 FORMAT "%.15" PHYS_UNIT "V" SYMBOL_LINK "ChtCalATD" 0 /end CHARACTERISTIC
/begin CHARACTERISTIC ClosedLoopEgtOperation "" VALUE 0x1E112 __UWORD_S 0 ClosedLoopEgtOperation.Conversion 0 65535 FORMAT "%.15" /end CHARACTERISTIC
/begin CHARACTERISTIC CrankDisconnect "" VALUE 0x1C0A8 __UWORD_S 0 SAERPM.Conversion 0 8000 PHYS_UNIT "RPM" /end CHARACTERISTIC
/begin MEASUREMENT CrankState "" UWORD NO_COMPU_METHOD 0 0 0 65535 ECU_ADDRESS 0x20000FC0 FORMAT "%.15" /end MEASUREMENT
/begin MEASUREMENT CrankState2 "" UWORD NO_COMPU_METHOD 0 0 0 65535 ECU_ADDRESS 0x20000FC2 FORMAT "%.15" /end MEASUREMENT
/begin MEASUREMENT Crank_Trigger_1_Fault "Faulty trigger signal detection, primary sensor" UBYTE Errors.Conversion 0 0 0 254 BIT_MASK 0x2 ECU_ADDRESS 0x200004B9 FORMAT "%.15" SYMBOL_LINK "fault_active_byte0" 0 /end MEASUREMENT
/begin MEASUREMENT Crank_Trigger_2_Fault "Faulty trigger signal detection, secondary sensor" UBYTE Errors.Conversion 0 0 0 255 BIT_MASK 0x8 ECU_ADDRESS 0x200004B9 FORMAT "%.15" SYMBOL_LINK "fault_active_byte0" 0 /end MEASUREMENT
/begin MEASUREMENT Crank_Trigger_Active "Crankshaft sensor currently active" UBYTE Crank.Conversion 0 0 0 255 BIT_MASK 0x1 ECU_ADDRESS 0x200004B9 FORMAT "%.15" SYMBOL_LINK "fault_active_byte0" 0 /end MEASUREMENT
/begin CHARACTERISTIC CylinderCount "Cylinder count for fuel injector quantity." VALUE 0x1E962 __UWord_Value 0 NO_COMPU_METHOD 0 65535 /end CHARACTERISTIC
/begin CHARACTERISTIC DeccelDecay "" VALUE 0x1E966 __SWord_Value 0 NO_COMPU_METHOD -32768 32767 /end CHARACTERISTIC
/begin MEASUREMENT DeccelEnrich "" SWORD TenthFP 0 0 -32768 32767 ECU_ADDRESS 0x200004EA PHYS_UNIT "%" /end MEASUREMENT
/begin CHARACTERISTIC DeccelMap "" MAP 0x1E968 __UWord_Value 0 TenthFP 0 65535 /begin AXIS_DESCR COM_AXIS RPM NO_COMPU_METHOD 20 0 0 AXIS_PTS_REF RpmScale /end AXIS_DESCR
 /begin AXIS_DESCR COM_AXIS EngTemp NO_COMPU_METHOD 15 0 0 AXIS_PTS_REF TempScale /end AXIS_DESCR
 PHYS_UNIT "%" /end CHARACTERISTIC
/begin CHARACTERISTIC DeccelRateTimeConstant "" VALUE 0x1EBC0 __UWord_Value 0 NO_COMPU_METHOD 0 65535 /end CHARACTERISTIC
/begin CHARACTERISTIC DeccelTrigger "" VALUE 0x1E964 __SWord_Value 0 NO_COMPU_METHOD -32768 32767 /end CHARACTERISTIC
/begin CHARACTERISTIC DeltaT "" VAL_BLK 0x200011B4 __UWord_Value 0 DeltaT.Conversion 0 65535 MATRIX_DIM 36 /end CHARACTERISTIC
/begin CHARACTERISTIC DeltaT2 "" VAL_BLK 0x20001210 __UWord_Value 0 NO_COMPU_METHOD 0 65535 MATRIX_DIM 36 /end CHARACTERISTIC
/begin MEASUREMENT DerateOverride "" UBYTE DerateOverride.Conversion 0 0 0 255 ECU_ADDRESS 0x2000040B /end MEASUREMENT
/begin MEASUREMENT DerateState "" SBYTE DerateState.CONVERSION 0 0 -128 127 ECU_ADDRESS 0x200004D2 FORMAT "%6.3" /end MEASUREMENT
/begin CHARACTERISTIC DiffMap "Differential gain look-up table for governor" MAP 0x1E694 __UWord_Value 0 TenthFP 0 65535
 /begin AXIS_DESCR COM_AXIS RPM SAERPM.Conversion 6 0 8000 AXIS_PTS_REF RpmScaleSmall PHYS_UNIT "RPM" /end AXIS_DESCR
 /begin AXIS_DESCR COM_AXIS Roughness NO_COMPU_METHOD 6 0 0 AXIS_PTS_REF RoughnessScaleSmall /end AXIS_DESCR
/end CHARACTERISTIC
/begin CHARACTERISTIC DiffTimeConstant "" VALUE 0x1E0FA __UWORD_S 0 NO_COMPU_METHOD 0 65535 FORMAT "%.15" /end CHARACTERISTIC
/begin CHARACTERISTIC DwellTooth "" VAL_BLK 0x20000E20 __ULong_Value 0 NO_COMPU_METHOD 0 4294967295 MATRIX_DIM 2 /end CHARACTERISTIC
/begin MEASUREMENT DwellTooth2 "" ULONG NO_COMPU_METHOD 0 0 0 4294967295 ECU_ADDRESS 0x20001294 FORMAT "%.15" /end MEASUREMENT
/begin MEASUREMENT DwellToothNext2 "" ULONG NO_COMPU_METHOD 0 0 0 4294967295 ECU_ADDRESS 0x200012A0 FORMAT "%.15" /end MEASUREMENT
/begin MEASUREMENT EGT "" UWORD EGT.Conversion 0 0 0 900 ECU_ADDRESS 0x200004D0 PHYS_UNIT "deg C" /end MEASUREMENT
/begin MEASUREMENT EGT1 "" SWORD EGT.Conversion 0 0 0 900 ECU_ADDRESS 0x20000436 FORMAT "%3.1" PHYS_UNIT "deg C"
 /begin IF_DATA XCP
  /begin DAQ_EVENT FIXED_EVENT_LIST "EVENT" 0x00 /end DAQ_EVENT
 /end IF_DATA
/end MEASUREMENT
/begin MEASUREMENT EGT1_Open_Circuit "Thermocouple open circuit" UBYTE Errors.Conversion 0 0 0 255 BIT_MASK 0x8 ECU_ADDRESS 0x200004BA FORMAT "%.15" SYMBOL_LINK "fault_active_byte1" 0 /end MEASUREMENT
/begin MEASUREMENT EGT1_Short_to_Gnd "Thermocouple short to ground" UBYTE Errors.Conversion 0 0 0 255 BIT_MASK 0x10 ECU_ADDRESS 0x200004BA FORMAT "%.15" SYMBOL_LINK "fault_active_byte1" 0 /end MEASUREMENT
/begin MEASUREMENT EGT2 "" SWORD EGT.Conversion 0 0 -32768 32767 ECU_ADDRESS 0x20000438 /end MEASUREMENT
/begin MEASUREMENT EGT2_Open_Circuit "Thermocouple open circuit" UBYTE Errors.Conversion 0 0 0 255 BIT_MASK 0x40 ECU_ADDRESS 0x200004BA FORMAT "%.15" SYMBOL_LINK "fault_active_byte1" 0 /end MEASUREMENT
/begin MEASUREMENT EGT2_Short_to_Gnd "Thermocouple short to ground" UBYTE Errors.Conversion 0 0 0 255 BIT_MASK 0x80 ECU_ADDRESS 0x200004BA FORMAT "%.15" SYMBOL_LINK "fault_active_byte1" 0 /end MEASUREMENT
/begin CHARACTERISTIC EgtCorrectionLimit "" VALUE 0x1E110 __SWORD_S 0 NO_COMPU_METHOD -32768 32767 FORMAT "%.15" /end CHARACTERISTIC
/begin MEASUREMENT EgtFeedback "" SWORD Temperature 0 0 0 900 ECU_ADDRESS 0x20000478 FORMAT "%.15" PHYS_UNIT "deg C"
 /begin IF_DATA XCP
  /begin DAQ_EVENT FIXED_EVENT_LIST "EVENT" 0x00 /end DAQ_EVENT
 /end IF_DATA
/end MEASUREMENT
/begin MEASUREMENT EgtFuelCorrection "" SWORD NO_COMPU_METHOD 0 0 -2147483648 2147483647 ECU_ADDRESS 0x20000480 FORMAT "%.15"
 /begin IF_DATA XCP
  /begin DAQ_EVENT FIXED_EVENT_LIST "EVENT" 0x00 /end DAQ_EVENT
 /end IF_DATA
/end MEASUREMENT
/begin MEASUREMENT EgtInteg "" SWORD NO_COMPU_METHOD 0 0 -2147483648 2147483647 ECU_ADDRESS 0x2000047E FORMAT "%.15"
 /begin IF_DATA XCP
  /begin DAQ_EVENT FIXED_EVENT_LIST "EVENT" 0x00 /end DAQ_EVENT
 /end IF_DATA
/end MEASUREMENT
/begin CHARACTERISTIC EgtIntegGain "" VALUE 0x1E10E __UWORD_S 0 NO_COMPU_METHOD 0 65535 FORMAT "%.15" /end CHARACTERISTIC
/begin CHARACTERISTIC EgtMap1 "" MAP 0x1D81C __UWORD_Z 0 NO_COMPU_METHOD 0 4294967295
 /begin AXIS_DESCR COM_AXIS RPM SAERPM.Conversion 20 0 9000 AXIS_PTS_REF RpmScale PHYS_UNIT "RPM" /end AXIS_DESCR
 /begin AXIS_DESCR COM_AXIS Torque TenthFP 15 -40 100 AXIS_PTS_REF TorqueScale PHYS_UNIT "%" /end AXIS_DESCR
 FORMAT "%.15" /end CHARACTERISTIC
/begin CHARACTERISTIC EgtMap2 "" MAP 0x1DA74 __UWORD_Z 0 NO_COMPU_METHOD 0 4294967295
 /begin AXIS_DESCR COM_AXIS RPM SAERPM.Conversion 20 0 9000 AXIS_PTS_REF RpmScale PHYS_UNIT "RPM" /end AXIS_DESCR
 /begin AXIS_DESCR COM_AXIS Torque TenthFP 15 -40 100 AXIS_PTS_REF TorqueScale PHYS_UNIT "%" /end AXIS_DESCR
 FORMAT "%.15" /end CHARACTERISTIC
/begin CHARACTERISTIC EgtMap3 "" MAP 0x1DCCC __UWORD_Z 0 NO_COMPU_METHOD 0 4294967295
 /begin AXIS_DESCR COM_AXIS RPM SAERPM.Conversion 20 0 9000 AXIS_PTS_REF RpmScale PHYS_UNIT "RPM" /end AXIS_DESCR
 /begin AXIS_DESCR COM_AXIS Torque TenthFP 15 -40 100 AXIS_PTS_REF TorqueScale PHYS_UNIT "%" /end AXIS_DESCR
 FORMAT "%.15" /end CHARACTERISTIC
/begin MEASUREMENT EgtProp "" SWORD NO_COMPU_METHOD 0 0 -2147483648 2147483647 ECU_ADDRESS 0x2000047C FORMAT "%.15"
 /begin IF_DATA XCP
  /begin DAQ_EVENT FIXED_EVENT_LIST "EVENT" 0x00 /end DAQ_EVENT
 /end IF_DATA
/end MEASUREMENT
/begin CHARACTERISTIC EgtPropGain "" VALUE 0x1E10C __UWORD_S 0 NO_COMPU_METHOD 0 65535 FORMAT "%.15" /end CHARACTERISTIC
/begin MEASUREMENT EgtTarget "" SWORD Temperature 0 0 0 900 ECU_ADDRESS 0x2000047A FORMAT "%.15" PHYS_UNIT "deg C"
 /begin IF_DATA XCP
  /begin DAQ_EVENT FIXED_EVENT_LIST "EVENT" 0x00 /end DAQ_EVENT
 /end IF_DATA
/end MEASUREMENT
/begin MEASUREMENT EngTemp "" SWORD Temperature 0 0 0 900 ECU_ADDRESS 0x2000042E FORMAT "%.15" PHYS_UNIT "deg C"
 /begin IF_DATA XCP
  /begin DAQ_EVENT FIXED_EVENT_LIST "EVENT" 0x00 /end DAQ_EVENT
 /end IF_DATA
/end MEASUREMENT
/begin MEASUREMENT EngineOutput "" SWORD TenthFP 0 0 -32768 32767 ECU_ADDRESS 0x200004F0 PHYS_UNIT "%" /end MEASUREMENT
/begin CHARACTERISTIC EngineRotation "" VALUE 0x1E382 __SBYTE_S 0 enginetype_t -128 127 FORMAT "%6.3" /end CHARACTERISTIC
/begin MEASUREMENT EngineStateCmd "" SBYTE EngineStateCmd.CONVERSION 0 0 0 255 ECU_ADDRESS 0x2000040A FORMAT "%6.3" /end MEASUREMENT
/begin MEASUREMENT EngineStateCmdXcp "" SBYTE EngineStateCmd.CONVERSION 0 0 0 255 ECU_ADDRESS 0x200004C2 FORMAT "%.15" READ_WRITE /end MEASUREMENT
/begin CHARACTERISTIC EngineTempCompCurve "" CURVE 0x1E06C __UWORD_S 0 Enrichment.Conversion 0 500
 /begin AXIS_DESCR COM_AXIS EngTemp Temperature 15 -70 1000 AXIS_PTS_REF TempScale FORMAT "%.15" /end AXIS_DESCR
 PHYS_UNIT "% Enrichment" /end CHARACTERISTIC
/begin CHARACTERISTIC FW_Version "" ASCII 0x1B7F0 __UBYTE_Z 0 NO_COMPU_METHOD 0 255 NUMBER 4 /end CHARACTERISTIC
/begin CHARACTERISTIC FlywheelMissingTeeth "" VALUE 0x1C068 __ULONG_S 0 NO_COMPU_METHOD 0 4294967295 FORMAT "%.15" /end CHARACTERISTIC
/begin CHARACTERISTIC FlywheelTeeth "" VALUE 0x1C064 __ULONG_S 0 NO_COMPU_METHOD 0 4294967295 FORMAT "%.15" /end CHARACTERISTIC
/begin MEASUREMENT FuelM "" SWORD Enrichment.Conversion 0 0 -80 30000 ECU_ADDRESS 0x20000400 FORMAT "%.15" PHYS_UNIT "%" READ_WRITE /end MEASUREMENT
/begin CHARACTERISTIC FuelMap1_Map "" MAP 0x1C7B4 __UWORD_Z 0 HundredthFP 0 100
 /begin AXIS_DESCR COM_AXIS RPM SAERPM.Conversion 20 0 9000 AXIS_PTS_REF RpmScale PHYS_UNIT "RPM" /end AXIS_DESCR
 /begin AXIS_DESCR COM_AXIS ManifoldPressure NO_COMPU_METHOD 15 0 1200 AXIS_PTS_REF MapScale FORMAT "%.15" PHYS_UNIT "mbar" /end AXIS_DESCR
 PHYS_UNIT "mg/shot" /end CHARACTERISTIC
/begin CHARACTERISTIC FuelMap1_Throt "" MAP 0x1C0AC __UWORD_Z 0 HundredthFP 0 300
 /begin AXIS_DESCR COM_AXIS RPM SAERPM.Conversion 20 0 9000 AXIS_PTS_REF RpmScale PHYS_UNIT "RPM" /end AXIS_DESCR
 /begin AXIS_DESCR COM_AXIS ThrottlePosDes TenthFP 15 0 100 AXIS_PTS_REF ThrottleScale PHYS_UNIT "% Throttle" /end AXIS_DESCR
 PHYS_UNIT "mg/shot" /end CHARACTERISTIC
/begin CHARACTERISTIC FuelMap2_Map "" MAP 0x1CA0C __UWORD_Z 0 HundredthFP 0 100
 /begin AXIS_DESCR COM_AXIS RPM SAERPM.Conversion 20 0 9000 AXIS_PTS_REF RpmScale PHYS_UNIT "RPM" /end AXIS_DESCR
 /begin AXIS_DESCR COM_AXIS ManifoldPressure NO_COMPU_METHOD 15 0 1200 AXIS_PTS_REF MapScale FORMAT "%.15" PHYS_UNIT "mbar" /end AXIS_DESCR
 PHYS_UNIT "mg/shot" /end CHARACTERISTIC
/begin CHARACTERISTIC FuelMap2_Throt "" MAP 0x1C304 __UWORD_Z 0 HundredthFP 0 100
 /begin AXIS_DESCR COM_AXIS RPM SAERPM.Conversion 20 0 9000 AXIS_PTS_REF RpmScale PHYS_UNIT "RPM" /end AXIS_DESCR
 /begin AXIS_DESCR COM_AXIS ThrottlePosDes TenthFP 15 0 100 AXIS_PTS_REF ThrottleScale PHYS_UNIT "% Throttle" /end AXIS_DESCR
 PHYS_UNIT "mg/shot" /end CHARACTERISTIC
/begin CHARACTERISTIC FuelMap3_Map "" MAP 0x1CC64 __UWORD_Z 0 HundredthFP 0 100
 /begin AXIS_DESCR COM_AXIS RPM SAERPM.Conversion 20 0 9000 AXIS_PTS_REF RpmScale PHYS_UNIT "RPM" /end AXIS_DESCR
 /begin AXIS_DESCR COM_AXIS ManifoldPressure NO_COMPU_METHOD 15 0 1200 AXIS_PTS_REF MapScale FORMAT "%.15" PHYS_UNIT "mbar" /end AXIS_DESCR
 PHYS_UNIT "mg/shot" /end CHARACTERISTIC
/begin CHARACTERISTIC FuelMap3_Throt "" MAP 0x1C55C __UWORD_Z 0 HundredthFP 0 100
 /begin AXIS_DESCR COM_AXIS RPM SAERPM.Conversion 20 0 9000 AXIS_PTS_REF RpmScale PHYS_UNIT "RPM" /end AXIS_DESCR
 /begin AXIS_DESCR COM_AXIS ThrottlePosDes TenthFP 15 0 100 AXIS_PTS_REF ThrottleScale PHYS_UNIT "% Throttle" /end AXIS_DESCR
 PHYS_UNIT "mg/shot" /end CHARACTERISTIC
/begin MEASUREMENT FuelMapType "" UBYTE FuelMapType.Conversion 0 0 0 255 ECU_ADDRESS 0x20000410 /end MEASUREMENT
/begin MEASUREMENT FuelMapTypeXCP "" UBYTE FuelMapType.Conversion 0 0 0 255 ECU_ADDRESS 0x20000409 READ_WRITE /end MEASUREMENT
/begin CHARACTERISTIC FuelPresDes "" VALUE 0x1E0D0 __ULONG_S 0 NO_COMPU_METHOD 0 10000 FORMAT "%.15" PHYS_UNIT "mbar" /end CHARACTERISTIC
/begin MEASUREMENT FuelPressure "" UWORD NO_COMPU_METHOD 0 0 0 10000 ECU_ADDRESS 0x20000442 FORMAT "%.15" PHYS_UNIT "mbar"
 /begin IF_DATA XCP
  /begin DAQ_EVENT FIXED_EVENT_LIST "EVENT" 0x00 /end DAQ_EVENT
 /end IF_DATA
/end MEASUREMENT
/begin CHARACTERISTIC FuelPressureGain "" VALUE 0x1E11C __SWORD_S 0 Volt_ATD 0 65535 FORMAT "%.15" PHYS_UNIT "mbar/mV" /end CHARACTERISTIC
/begin CHARACTERISTIC FuelPressureOffset "" VALUE 0x1E11E __SWORD_S 0 NO_COMPU_METHOD -30000 30000 FORMAT "%.15" PHYS_UNIT "mbar" /end CHARACTERISTIC
/begin CHARACTERISTIC FuelPumpAutoPrimeFF "" VALUE 0x1E0E4 __ULONG_S 0 NO_COMPU_METHOD 0 4294967295 FORMAT "%.15" /end CHARACTERISTIC
/begin CHARACTERISTIC FuelPumpFFattenuation "" VALUE 0x1E0DC __ULONG_S 0 NO_COMPU_METHOD 0 4294967295 FORMAT "%.15" /end CHARACTERISTIC
/begin CHARACTERISTIC FuelPumpFFoffset "" VALUE 0x1E0E0 __SLONG_S 0 NO_COMPU_METHOD -2147483648 2147483647 FORMAT "%.15" /end CHARACTERISTIC
/begin CHARACTERISTIC FuelPumpInteg "" VALUE 0x1E0D8 __SLONG_S 0 NO_COMPU_METHOD 0 4294967295 FORMAT "%.15" /end CHARACTERISTIC
/begin MEASUREMENT FuelPumpMainPwm "" UBYTE NO_COMPU_METHOD 0 0 0 127 ECU_ADDRESS 0x200004BE FORMAT "%.15" PHYS_UNIT "%" /end MEASUREMENT
/begin CHARACTERISTIC FuelPumpProp "" VALUE 0x1E0D4 __SLONG_S 0 NO_COMPU_METHOD 0 4294967295 FORMAT "%.15" /end CHARACTERISTIC
/begin MEASUREMENT FuelTable "" SWORD HundredthFP 0 0 0 64 ECU_ADDRESS 0x20000472 FORMAT "%.15" PHYS_UNIT "mg/shot"
 /begin IF_DATA XCP
  /begin DAQ_EVENT FIXED_EVENT_LIST "EVENT" 0x00 /end DAQ_EVENT
 /end IF_DATA
/end MEASUREMENT
/begin MEASUREMENT FuelTemp "" SWORD Temperature 0 0 -70 400 ECU_ADDRESS 0x2000043A FORMAT "%.15" PHYS_UNIT "deg C"
 /begin IF_DATA XCP
  /begin DAQ_EVENT FIXED_EVENT_LIST "EVENT" 0x00 /end DAQ_EVENT
 /end IF_DATA
/end MEASUREMENT
/begin CHARACTERISTIC FuelTempLookup "" CURVE 0x1E254 __SWORD_S 0 Temperature -70 1000
 /begin AXIS_DESCR COM_AXIS NO_INPUT_QUANTITY NO_COMPU_METHOD 50 0 4095 AXIS_PTS_REF FuelTempVoltageScale EXTENDED_LIMITS -700 1000 FORMAT "%6.3" PHYS_UNIT "V" /end AXIS_DESCR
 SYMBOL_LINK "FuelTempScale" 0 /end CHARACTERISTIC
/begin AXIS_PTS FuelTempVoltageScale "" 0x1E1F0 NO_INPUT_QUANTITY SSV__SWORD_S 0 NO_COMPU_METHOD 50 0 4095 DEPOSIT ABSOLUTE EXTENDED_LIMITS -700 1000 FORMAT "%6.3" MONOTONY MONOTONOUS PHYS_UNIT "V" SYMBOL_LINK "FuelTempATD" 0 /end AXIS_PTS
/begin MEASUREMENT Fuel_AD_Comp "" SWORD Enrichment.Conversion 0 0 0 64 ECU_ADDRESS 0x20000474 FORMAT "%.15" PHYS_UNIT "%"
 /begin IF_DATA XCP
  /begin DAQ_EVENT FIXED_EVENT_LIST "EVENT" 0x00 /end DAQ_EVENT
 /end IF_DATA
/end MEASUREMENT
/begin MEASUREMENT Fuel_EngTemp_Comp "" SWORD Enrichment.Conversion 0 0 -99 500 ECU_ADDRESS 0x20000470 PHYS_UNIT "%"
 /begin IF_DATA XCP
  /begin DAQ_EVENT FIXED_EVENT_LIST "EVENT" 0x00 /end DAQ_EVENT
 /end IF_DATA
/end MEASUREMENT
/begin MEASUREMENT Fuel_Final "" SWORD HundredthFP 0 0 0 64 ECU_ADDRESS 0x2000041C FORMAT "%.15" PHYS_UNIT "mg/shot"
 /begin IF_DATA XCP
  /begin DAQ_EVENT FIXED_EVENT_LIST "EVENT" 0x00 /end DAQ_EVENT
 /end IF_DATA
/end MEASUREMENT
/begin MEASUREMENT Fuel_OnTime_Comp "" SWORD Enrichment.Conversion 0 0 0 64 ECU_ADDRESS 0x20000476 FORMAT "%.15" PHYS_UNIT "%"
 /begin IF_DATA XCP
  /begin DAQ_EVENT FIXED_EVENT_LIST "EVENT" 0x00 /end DAQ_EVENT
 /end IF_DATA
/end MEASUREMENT
/begin MEASUREMENT Fuel_Temp_Open_Circuit "Sensor open circuit" UBYTE Errors.Conversion 0 0 0 255 BIT_MASK 0x2 ECU_ADDRESS 0x200004BB FORMAT "%.15" SYMBOL_LINK "fault_active_byte2" 0 /end MEASUREMENT
/begin MEASUREMENT Fuel_Temp_Short_to_Gnd "Sensor short to gnd" UBYTE Errors.Conversion 0 0 0 255 BIT_MASK 0x4 ECU_ADDRESS 0x200004BB FORMAT "%.15" SYMBOL_LINK "fault_active_byte2" 0 /end MEASUREMENT
/begin MEASUREMENT GovMode "" UWORD GovMode.Conversion 0 0 0 65535 ECU_ADDRESS 0x20000418
 /begin IF_DATA XCP
  /begin DAQ_EVENT FIXED_EVENT_LIST "EVENT" 0x00 /end DAQ_EVENT
 /end IF_DATA
/end MEASUREMENT
/begin MEASUREMENT IAT_Open_Circuit "Intake Air Temp sensor open circuit" UBYTE Errors.Conversion 0 0 0 255 BIT_MASK 0x2 ECU_ADDRESS 0x200004BD FORMAT "%.15" SYMBOL_LINK "fault_active_byte4" 0 /end MEASUREMENT
/begin MEASUREMENT IAT_Short_to_Gnd "Intake Air Temp sensor short to ground" UBYTE Errors.Conversion 0 0 0 255 BIT_MASK 0x1 ECU_ADDRESS 0x200004BD FORMAT "%.15" SYMBOL_LINK "fault_active_byte4" 0 /end MEASUREMENT
/begin CHARACTERISTIC IdleD "" VALUE 0x1E0EC __UWORD_S 0 TenthFP 0 65535 FORMAT "%.15" /end CHARACTERISTIC
/begin CHARACTERISTIC IdleI "" VALUE 0x1E0EA __UWORD_S 0 TenthFP 0 65535 FORMAT "%.15" /end CHARACTERISTIC
/begin CHARACTERISTIC IdleP "" VALUE 0x1E0E8 __UWORD_S 0 TenthFP 0 65535 FORMAT "%.15" /end CHARACTERISTIC
/begin CHARACTERISTIC IdleRoughness "" VALUE 0x1E0F4 __UWORD_S 0 NO_COMPU_METHOD 0 500 FORMAT "%.15" /end CHARACTERISTIC
/begin AXIS_PTS IgnEnergyScale "" 0x1E04C SparkEnergy SSV__UWORD_S 0 TenthFP 15 0 100 DEPOSIT ABSOLUTE FORMAT "%.15" MONOTONY MON_INCREASE PHYS_UNIT "mJ" /end AXIS_PTS
/begin CHARACTERISTIC Inj1Timing "" VALUE 0x1C0A4 __UBYTE_S 0 NO_COMPU_METHOD 0 23 FORMAT "%.15" PHYS_UNIT "tooth" /end CHARACTERISTIC
/begin CHARACTERISTIC Inj1Timing2 "" VALUE 0x1C0A5 __UBYTE_S 0 NO_COMPU_METHOD 0 23 FORMAT "%.15" PHYS_UNIT "tooth" /end CHARACTERISTIC
/begin MEASUREMENT InjDual "" UWORD NO_COMPU_METHOD 0 0 0 65535 ECU_ADDRESS 0x200004BE FORMAT "%.15" READ_WRITE /end MEASUREMENT
/begin CHARACTERISTIC InjDurBias "" VALUE 0x1C0A2 __SWORD_S 0 TenthFP -5000 5000 PHYS_UNIT "ms" /end CHARACTERISTIC
/begin CHARACTERISTIC InjDurGain "" VALUE 0x1C0A0 __SWORD_S 0 ThousandthFP 0 10 PHYS_UNIT "ms/mg" /end CHARACTERISTIC
/begin CHARACTERISTIC InjDurVoltCorr "" CURVE 0x1C078 __SWORD_S 0 ThousandthFP -5000 5000
 /begin AXIS_DESCR COM_AXIS SystemVoltage HundredthFP 20 0 36 AXIS_PTS_REF VoltageScale PHYS_UNIT "V" /end AXIS_DESCR
 PHYS_UNIT "ms" /end CHARACTERISTIC
/begin MEASUREMENT InjDuration "" UWORD ThousandthFP 0 0 0 64 ECU_ADDRESS 0x2000041E FORMAT "%.15" PHYS_UNIT "ms"
 /begin IF_DATA XCP
  /begin DAQ_EVENT FIXED_EVENT_LIST "EVENT" 0x00 /end DAQ_EVENT
 /end IF_DATA
/end MEASUREMENT
/begin MEASUREMENT Inj_1_Open_Circuit "Injector 1 open circuit" UBYTE Errors.Conversion 0 0 0 255 BIT_MASK 0x10 ECU_ADDRESS 0x200004BB FORMAT "%.15" SYMBOL_LINK "fault_active_byte2" 0 /end MEASUREMENT
/begin MEASUREMENT Inj_1_Overcurrent "Injector 1 overcurrent" UBYTE Errors.Conversion 0 0 0 255 BIT_MASK 0x20 ECU_ADDRESS 0x200004BB FORMAT "%.15" SYMBOL_LINK "fault_active_byte2" 0 /end MEASUREMENT
/begin MEASUREMENT Inj_1_Overtemp "Injector 1 driver overheating" UBYTE Errors.Conversion 0 0 0 255 BIT_MASK 0x40 ECU_ADDRESS 0x200004BB FORMAT "%.15" SYMBOL_LINK "fault_active_byte2" 0 /end MEASUREMENT
/begin MEASUREMENT Inj_1_Short_to_Gnd "Injector 1 short to gnd" UBYTE Errors.Conversion 0 0 0 255 BIT_MASK 0x80 ECU_ADDRESS 0x200004BB FORMAT "%.15" SYMBOL_LINK "fault_active_byte2" 0 /end MEASUREMENT
/begin MEASUREMENT Inj_2_Open_Circuit "Injector 2 open circuit" UBYTE Errors.Conversion 0 0 0 255 BIT_MASK 0x1 ECU_ADDRESS 0x200004BC FORMAT "%.15" SYMBOL_LINK "fault_active_byte3" 0 /end MEASUREMENT
/begin MEASUREMENT Inj_2_Overcurrent "Injector 2 overcurrent" UBYTE Errors.Conversion 0 0 0 255 BIT_MASK 0x2 ECU_ADDRESS 0x200004BC FORMAT "%.15" SYMBOL_LINK "fault_active_byte3" 0 /end MEASUREMENT
/begin MEASUREMENT Inj_2_Overtemp "Injector 2 overtemp" UBYTE Errors.Conversion 0 0 0 255 BIT_MASK 0x4 ECU_ADDRESS 0x200004BC FORMAT "%.15" SYMBOL_LINK "fault_active_byte3" 0 /end MEASUREMENT
/begin MEASUREMENT Inj_2_Short_to_Gnd "Injector 2 short to gnd" UBYTE Errors.Conversion 0 0 0 255 BIT_MASK 0x8 ECU_ADDRESS 0x200004BC FORMAT "%.15" SYMBOL_LINK "fault_active_byte3" 0 /end MEASUREMENT
/begin CHARACTERISTIC IntegMap "Integrator gain look-up table for governor" MAP 0x1E64C __UWord_Value 0 TenthFP 0 65535
 /begin AXIS_DESCR COM_AXIS RPM SAERPM.Conversion 6 0 8000 AXIS_PTS_REF RpmScaleSmall PHYS_UNIT "RPM" /end AXIS_DESCR
 /begin AXIS_DESCR COM_AXIS Roughness NO_COMPU_METHOD 6 0 0 AXIS_PTS_REF RoughnessScaleSmall /end AXIS_DESCR
/end CHARACTERISTIC
/begin MEASUREMENT Kd "" UWORD NO_COMPU_METHOD 0 0 0 4294967295 ECU_ADDRESS 0x2000044C FORMAT "%.15"
 /begin IF_DATA XCP
  /begin DAQ_EVENT FIXED_EVENT_LIST "EVENT" 0x00 /end DAQ_EVENT
 /end IF_DATA
/end MEASUREMENT
/begin MEASUREMENT Ki "" UWORD NO_COMPU_METHOD 0 0 0 4294967295 ECU_ADDRESS 0x2000044A FORMAT "%.15"
 /begin IF_DATA XCP
  /begin DAQ_EVENT FIXED_EVENT_LIST "EVENT" 0x00 /end DAQ_EVENT
 /end IF_DATA
/end MEASUREMENT
/begin MEASUREMENT Ki_Pump "" SLONG TenThousandth 0 0 -2147483648 2147483647 ECU_ADDRESS 0x20000464 FORMAT "%.15"
 /begin IF_DATA XCP
  /begin DAQ_EVENT FIXED_EVENT_LIST "EVENT" 0x00 /end DAQ_EVENT
 /end IF_DATA
/end MEASUREMENT
/begin MEASUREMENT Kp "" UWORD NO_COMPU_METHOD 0 0 0 4294967295 ECU_ADDRESS 0x20000448 FORMAT "%.15"
 /begin IF_DATA XCP
  /begin DAQ_EVENT FIXED_EVENT_LIST "EVENT" 0x00 /end DAQ_EVENT
 /end IF_DATA
/end MEASUREMENT
/begin MEASUREMENT Kp_Pump "" SLONG HundredthFP 0 0 -2147483648 2147483647 ECU_ADDRESS 0x20000460 FORMAT "%.15"
 /begin IF_DATA XCP
  /begin DAQ_EVENT FIXED_EVENT_LIST "EVENT" 0x00 /end DAQ_EVENT
 /end IF_DATA
/end MEASUREMENT
/begin MEASUREMENT MAP_High "Manifold pressure above feasible range" UBYTE Errors.Conversion 0 0 0 255 BIT_MASK 0x80 ECU_ADDRESS 0x200004BC FORMAT "%.15" SYMBOL_LINK "fault_active_byte3" 0 /end MEASUREMENT
/begin MEASUREMENT MAP_Low "Manifold pressure below feasible range" UBYTE Errors.Conversion 0 0 0 255 BIT_MASK 0x40 ECU_ADDRESS 0x200004BC FORMAT "%.15" SYMBOL_LINK "fault_active_byte3" 0 /end MEASUREMENT
/begin MEASUREMENT ManifoldPressure "" UWORD NO_COMPU_METHOD 0 0 0 1500 ECU_ADDRESS 0x2000043C FORMAT "%.15" PHYS_UNIT "mbar" SYMBOL_LINK "MAP" 0
 /begin IF_DATA XCP
  /begin DAQ_EVENT FIXED_EVENT_LIST "EVENT" 0x00 /end DAQ_EVENT
 /end IF_DATA
/end MEASUREMENT
/begin MEASUREMENT MapCrank "" UWORD MapCrank.Conversion 0 0 0 65535 ECU_ADDRESS 0x20000488 FORMAT "%.15" LAYOUT ROW_DIR MATRIX_DIM 23 PHYS_UNIT "mbar"
 /begin IF_DATA XCP
  /begin DAQ_EVENT FIXED_EVENT_LIST "EVENT" 0x00 /end DAQ_EVENT
 /end IF_DATA
/end MEASUREMENT
/begin CHARACTERISTIC MapGain "" VALUE 0x1E118 __SWORD_S 0 Volt_ATD 0 1000 FORMAT "%.15" PHYS_UNIT "mbar/mV" /end CHARACTERISTIC
/begin CHARACTERISTIC MapOffset "" VALUE 0x1E11A __SWORD_S 0 NO_COMPU_METHOD 0 65535 FORMAT "%.15" PHYS_UNIT "mbar" /end CHARACTERISTIC
/begin AXIS_PTS MapScale "" 0x1DFBC ManifoldPressure SSV__UWORD_S 0 NO_COMPU_METHOD 15 0 1200 DEPOSIT ABSOLUTE FORMAT "%.15" MONOTONY MON_INCREASE PHYS_UNIT "mbar" /end AXIS_PTS
/begin CHARACTERISTIC MapTrigger "" VALUE 0x1C0A6 __UBYTE_S 0 NO_COMPU_METHOD 0 24 FORMAT "%.15" PHYS_UNIT "tooth" /end CHARACTERISTIC
/begin MEASUREMENT MaxTorque "" SWORD TenthFP 0 0 -40 100 ECU_ADDRESS 0x200004EE PHYS_UNIT "%" /end MEASUREMENT
/begin CHARACTERISTIC MaxTorqueCurve "" CURVE 0x1EBC4 __SWord_Value 0 TenthFP -40 100
 /begin AXIS_DESCR COM_AXIS RPM SAERPM.Conversion 20 0 8190 AXIS_PTS_REF RpmScale PHYS_UNIT "RPM" /end AXIS_DESCR
 PHYS_UNIT "%" /end CHARACTERISTIC
/begin CHARACTERISTIC MinDwell "" VALUE 0x1C074 __ULONG_S 0 ThousandthFP 100 5000 PHYS_UNIT "ms" /end CHARACTERISTIC
/begin CHARACTERISTIC OilInj_CalFactor "" VALUE 0x1E960 __UWord_Value 0 NO_COMPU_METHOD 0 5000 PHYS_UNIT "uL/shot" /end CHARACTERISTIC
/begin CHARACTERISTIC OilInj_Map "" MAP 0x1E704 __UWord_Value 0 TenthFP 0 500
 /begin AXIS_DESCR COM_AXIS RPM SAERPM.Conversion 20 0 0 AXIS_PTS_REF RpmScale PHYS_UNIT "RPM" /end AXIS_DESCR
 /begin AXIS_DESCR COM_AXIS ThrottlePosDes TenthFP 15 0 0 AXIS_PTS_REF ThrottleScale PHYS_UNIT "%" /end AXIS_DESCR
 PHYS_UNIT "Ratio" /end CHARACTERISTIC
/begin CHARACTERISTIC OilInj_MaxPeriod "" VALUE 0x1E95E __UWord_Value 0 TenX.Conversion 0 65535 PHYS_UNIT "ms" /end CHARACTERISTIC
/begin MEASUREMENT OilInj_Period "" UWORD TenX.Conversion 0 0 0 65535 ECU_ADDRESS 0x200004E6 PHYS_UNIT "ms" /end MEASUREMENT
/begin MEASUREMENT OilInj_Qty "" UWORD ThousandthFP 0 0 0 65535 ECU_ADDRESS 0x200004E8 PHYS_UNIT "cc/min" /end MEASUREMENT
/begin MEASUREMENT OilInj_Ratio "" UWORD TenthFP 0 0 0 65535 ECU_ADDRESS 0x200004E4 PHYS_UNIT "ratio" /end MEASUREMENT
/begin CHARACTERISTIC OilInj_ShotWidth "" VALUE 0x1E95C __UWord_Value 0 TenX.Conversion 0 65535 PHYS_UNIT "ms" /end CHARACTERISTIC
/begin CHARACTERISTIC OnTimeCompCurve "" CURVE 0x1E08C __UWORD_S 0 Enrichment.Conversion 0 500
 /begin AXIS_DESCR COM_AXIS EngTemp Temperature 15 -70 1000 AXIS_PTS_REF TempScale FORMAT "%.15" /end AXIS_DESCR
 PHYS_UNIT "% Enrichment" /end CHARACTERISTIC
/begin CHARACTERISTIC OnTimeDecay "" VALUE 0x1E0CC __UWORD_S 0 NO_COMPU_METHOD 0 60000 FORMAT "%.3" /end CHARACTERISTIC
/begin MEASUREMENT OpMode "" UWORD OpMode.Conversion 0 0 0 65535 ECU_ADDRESS 0x2000041A
 /begin IF_DATA XCP
  /begin DAQ_EVENT FIXED_EVENT_LIST "EVENT" 0x00 /end DAQ_EVENT
 /end IF_DATA
/end MEASUREMENT
/begin CHARACTERISTIC PropMap "Proportional gain look-up table for governor" MAP 0x1E604 __UWord_Value 0 TenthFP 0 65535
 /begin AXIS_DESCR COM_AXIS RPM SAERPM.Conversion 6 0 8000 AXIS_PTS_REF RpmScaleSmall PHYS_UNIT "RPM" /end AXIS_DESCR
 /begin AXIS_DESCR COM_AXIS Roughness NO_COMPU_METHOD 6 0 0 AXIS_PTS_REF RoughnessScaleSmall /end AXIS_DESCR
/end CHARACTERISTIC
/begin MEASUREMENT PumpCommand "" UWORD ThousandthFP 0 0 0 5 ECU_ADDRESS 0x2000046E FORMAT "%.15" PHYS_UNIT "V"
 /begin IF_DATA XCP
  /begin DAQ_EVENT FIXED_EVENT_LIST "EVENT" 0x00 /end DAQ_EVENT
 /end IF_DATA
/end MEASUREMENT
/begin MEASUREMENT PumpDuty "" SWORD NO_COMPU_METHOD 0 0 -32768 32767 ECU_ADDRESS 0x2000046C FORMAT "%.15"
 /begin IF_DATA XCP
  /begin DAQ_EVENT FIXED_EVENT_LIST "EVENT" 0x00 /end DAQ_EVENT
 /end IF_DATA
/end MEASUREMENT
/begin MEASUREMENT Pump_FF "" SLONG HundredthFP 0 0 -2147483648 2147483647 ECU_ADDRESS 0x20000468 FORMAT "%.15"
 /begin IF_DATA XCP
  /begin DAQ_EVENT FIXED_EVENT_LIST "EVENT" 0x00 /end DAQ_EVENT
 /end IF_DATA
/end MEASUREMENT
/begin MEASUREMENT RPM "" SLONG SAERPM.Conversion 0 0 0 8000 ECU_ADDRESS 0x20000414 PHYS_UNIT "RPM"
 /begin IF_DATA XCP
  /begin DAQ_EVENT FIXED_EVENT_LIST "EVENT" 0x00 /end DAQ_EVENT
 /end IF_DATA
/end MEASUREMENT
/begin MEASUREMENT RPMdes "" UWORD SAERPM.Conversion 0 0 -2147483648 2147483647 ECU_ADDRESS 0x2000040C FORMAT "%.15" PHYS_UNIT "RPM"
 /begin IF_DATA XCP
  /begin DAQ_EVENT FIXED_EVENT_LIST "EVENT" 0x00 /end DAQ_EVENT
 /end IF_DATA
/end MEASUREMENT
/begin MEASUREMENT RPMdesXCP "" UWORD SAERPM.Conversion 0 0 0 8000 ECU_ADDRESS 0x20000406 PHYS_UNIT "RPM" READ_WRITE /end MEASUREMENT
/begin CHARACTERISTIC RevPerCycle "revolutions per cycle 2/4 stroke" VALUE 0x1C070 __UBYTE_S 0 NO_COMPU_METHOD 0 4294967295 FORMAT "%.15" /end CHARACTERISTIC
/begin MEASUREMENT Roughness "" UWORD NO_COMPU_METHOD 0 0 0 4294967295 ECU_ADDRESS 0x2000044E FORMAT "%.15"
 /begin IF_DATA XCP
  /begin DAQ_EVENT FIXED_EVENT_LIST "EVENT" 0x00 /end DAQ_EVENT
 /end IF_DATA
/end MEASUREMENT
/begin AXIS_PTS RoughnessScaleSmall "" 0x1E6E8 Roughness __UWord_Axis 0 NO_COMPU_METHOD 6 0 65535 /end AXIS_PTS
/begin CHARACTERISTIC RoughnessTC "" VALUE 0x1E108 __ULONG_S 0 NO_COMPU_METHOD 0 4294967295 FORMAT "%.15" /end CHARACTERISTIC
/begin CHARACTERISTIC RpmDampTC "Time constant for smoothing RPM into governor" VALUE 0x1E600 __UWord_Value 0 NO_COMPU_METHOD 0 65535 /end CHARACTERISTIC
/begin CHARACTERISTIC RpmDesTimeConstant "" VALUE 0x1E0F8 __UWORD_S 0 NO_COMPU_METHOD 0 65535 FORMAT "%.15" /end CHARACTERISTIC
/begin CHARACTERISTIC RpmLimitHysteresis "" VALUE 0x1E104 __ULONG_S 0 SAERPM.Conversion 0 4294967295 FORMAT "%.15" PHYS_UNIT "RPM" /end CHARACTERISTIC
/begin CHARACTERISTIC RpmLimitOverSpeed "" VALUE 0x1E0FC __ULONG_S 0 SAERPM.Conversion 0 4294967295 PHYS_UNIT "RPM" /end CHARACTERISTIC
/begin CHARACTERISTIC RpmLimitShutdown "" VALUE 0x1E100 __ULONG_S 0 SAERPM.Conversion 0 9000 FORMAT "%.15" PHYS_UNIT "RPM" /end CHARACTERISTIC
/begin AXIS_PTS RpmScale "" 0x1DF2C RPM SSV__ULONG_S 0 SAERPM.Conversion 20 0 9000 DEPOSIT ABSOLUTE MONOTONY MON_INCREASE PHYS_UNIT "RPM" /end AXIS_PTS
/begin AXIS_PTS RpmScaleSmall "" 0x1E6DC RPM __UWord_Axis 0 SAERPM.Conversion 6 0 8000 FORMAT "" PHYS_UNIT "RPM" /end AXIS_PTS
/begin CHARACTERISTIC RunD "" VALUE 0x1E0F2 __UWORD_S 0 TenthFP 0 65535 FORMAT "%.15" /end CHARACTERISTIC
/begin MEASUREMENT RunHours "" ULONG HundredthFP 0 0 0 4294967295 ECU_ADDRESS 0x20000484 PHYS_UNIT "hr" /end MEASUREMENT
/begin CHARACTERISTIC RunI "" VALUE 0x1E0F0 __UWORD_S 0 TenthFP 0 65535 FORMAT "%.15" /end CHARACTERISTIC
/begin CHARACTERISTIC RunP "" VALUE 0x1E0EE __UWORD_S 0 TenthFP 0 65535 FORMAT "%.15" /end CHARACTERISTIC
/begin CHARACTERISTIC RunRoughness "" VALUE 0x1E0F6 __UWORD_S 0 NO_COMPU_METHOD 0 5000 FORMAT "%.15" /end CHARACTERISTIC
/begin CHARACTERISTIC ServoClosed "" VALUE 0x1E114 __SWORD_S 0 NO_COMPU_METHOD -3000 3000 EXTENDED_LIMITS -4000 4000 FORMAT "%.15" /end CHARACTERISTIC
/begin MEASUREMENT ServoPulseWidth "" UWORD ThousandthFP 0 0 1000 3000 ECU_ADDRESS 0x2000045C FORMAT "%1.3" PHYS_UNIT "ms"
 /begin IF_DATA XCP
  /begin DAQ_EVENT FIXED_EVENT_LIST "EVENT" 0x00 /end DAQ_EVENT
 /end IF_DATA
/end MEASUREMENT
/begin CHARACTERISTIC ServoSpan "" VALUE 0x1E116 __SWORD_S 0 NO_COMPU_METHOD 0 3000 EXTENDED_LIMITS -4000 4000 FORMAT "%.15" /end CHARACTERISTIC
/begin MEASUREMENT ShutdownXCP "" UBYTE ShutdownXCP.Conversion 0 0 0 65535 ECU_ADDRESS 0x20000408 READ_WRITE /end MEASUREMENT
/begin MEASUREMENT SparkCut "" SWORD NO_COMPU_METHOD 0 0 -32768 32767 ECU_ADDRESS 0x20001042 FORMAT "%.15" /end MEASUREMENT
/begin CHARACTERISTIC SparkCutGov "Speed control error at which spark is cut during overspeed." VALUE 0x1E380 __SWORD_S 0 SparkCutGov.Conversion 0 8190 PHYS_UNIT "RPM" /end CHARACTERISTIC
/begin MEASUREMENT SparkDwell "" UWORD ThousandthFP 0 0 0 15 ECU_ADDRESS 0x20000446 FORMAT "%.15" PHYS_UNIT "ms"
 /begin IF_DATA XCP
  /begin DAQ_EVENT FIXED_EVENT_LIST "EVENT" 0x00 /end DAQ_EVENT
 /end IF_DATA
/end MEASUREMENT
/begin CHARACTERISTIC SparkDwellMap "" MAP 0x1D36C __UWORD_Z 0 ThousandthFP 0 10
 /begin AXIS_DESCR COM_AXIS SystemVoltage HundredthFP 20 0 36 AXIS_PTS_REF VoltageScale PHYS_UNIT "V" /end AXIS_DESCR
 /begin AXIS_DESCR COM_AXIS SparkEnergy TenthFP 15 0 100 AXIS_PTS_REF IgnEnergyScale FORMAT "%.15" PHYS_UNIT "mJ" /end AXIS_DESCR
 PHYS_UNIT "ms" /end CHARACTERISTIC
/begin MEASUREMENT SparkEnergy "" UWORD TenthFP 0 0 0 100 ECU_ADDRESS 0x20000444 FORMAT "%.15" PHYS_UNIT "mJ"
 /begin IF_DATA XCP
  /begin DAQ_EVENT FIXED_EVENT_LIST "EVENT" 0x00 /end DAQ_EVENT
 /end IF_DATA
/end MEASUREMENT
/begin CHARACTERISTIC SparkEnergyMap "" MAP 0x1D114 __UWORD_Z 0 TenthFP 0 90
 /begin AXIS_DESCR COM_AXIS RPM SAERPM.Conversion 20 0 9000 AXIS_PTS_REF RpmScale PHYS_UNIT "RPM" /end AXIS_DESCR
 /begin AXIS_DESCR COM_AXIS ThrottlePosDes TenthFP 15 0 100 AXIS_PTS_REF ThrottleScale PHYS_UNIT "% Throttle" /end AXIS_DESCR
 PHYS_UNIT "mJ" /end CHARACTERISTIC
/begin MEASUREMENT SparkOffsetXCP "" SWORD TenthFP 0 0 -80 80 ECU_ADDRESS 0x20000402 FORMAT "%.15" PHYS_UNIT "deg Advance" READ_WRITE /end MEASUREMENT
/begin MEASUREMENT SparkTiming "" SWORD SparkTiming.Conversion 0 0 -80 80 ECU_ADDRESS 0x20000420 FORMAT "%.15" PHYS_UNIT "deg BTDC"
 /begin IF_DATA XCP
  /begin DAQ_EVENT FIXED_EVENT_LIST "EVENT" 0x00 /end DAQ_EVENT
 /end IF_DATA
/end MEASUREMENT
/begin CHARACTERISTIC SparkTimingMap "" MAP 0x1CEBC __SWORD_Z 0 SparkTiming.Conversion -80 80
 /begin AXIS_DESCR COM_AXIS RPM SAERPM.Conversion 20 0 9000 AXIS_PTS_REF RpmScale PHYS_UNIT "RPM" /end AXIS_DESCR
 /begin AXIS_DESCR COM_AXIS ThrottlePosDes TenthFP 15 0 100 AXIS_PTS_REF ThrottleScale PHYS_UNIT "% Throttle" /end AXIS_DESCR
 PHYS_UNIT "deg BTDC" /end CHARACTERISTIC
/begin CHARACTERISTIC StartingTorque "" VALUE 0x1E0CA __UWORD_S 0 TenthFP -40 100 FORMAT "%.15" PHYS_UNIT "% Torque" /end CHARACTERISTIC
/begin MEASUREMENT SystemVoltage "" UWORD HundredthFP 0 0 0 36 ECU_ADDRESS 0x20000430 FORMAT "%.15" PHYS_UNIT "V"
 /begin IF_DATA XCP
  /begin DAQ_EVENT FIXED_EVENT_LIST "EVENT" 0x00 /end DAQ_EVENT
 /end IF_DATA
/end MEASUREMENT
/begin MEASUREMENT TPS_Error "Throttle position sensor discrepancy detected" UBYTE Errors.Conversion 0 0 0 255 BIT_MASK 0x4 ECU_ADDRESS 0x200004BD FORMAT "%.15" SYMBOL_LINK "fault_active_byte4" 0
 /begin IF_DATA XCP
  /begin DAQ_EVENT FIXED_EVENT_LIST "EVENT" 0x00 /end DAQ_EVENT
 /end IF_DATA
/end MEASUREMENT
/begin AXIS_PTS TempScale "" 0x1DFDC EngTemp SSV__SWORD_S 0 Temperature 15 -70 1000 DEPOSIT ABSOLUTE FORMAT "%.15" MONOTONY MON_INCREASE /end AXIS_PTS
/begin MEASUREMENT ThrotDesXCP "" UWORD TenthFP 0 0 0 100 ECU_ADDRESS 0x20000404 PHYS_UNIT "% Throttle" READ_WRITE /end MEASUREMENT
/begin CHARACTERISTIC ThrottleBacklashComp "" VALUE 0x1E5FE TorqueMap.Layout 0 TenthFP 0 50 PHYS_UNIT "%" /end CHARACTERISTIC
/begin MEASUREMENT ThrottlePosAct "" UWORD TenthFP 0 0 0 100 ECU_ADDRESS 0x20000428 PHYS_UNIT "% Throttle"
 /begin IF_DATA XCP
  /begin DAQ_EVENT FIXED_EVENT_LIST "EVENT" 0x00 /end DAQ_EVENT
 /end IF_DATA
/end MEASUREMENT
/begin MEASUREMENT ThrottlePosDes "" UWORD TenthFP 0 0 0 100 ECU_ADDRESS 0x20000422 PHYS_UNIT "% Throttle"
 /begin IF_DATA XCP
  /begin DAQ_EVENT FIXED_EVENT_LIST "EVENT" 0x00 /end DAQ_EVENT
 /end IF_DATA
/end MEASUREMENT
/begin AXIS_PTS ThrottleScale "" 0x1DF7C ThrottlePosDes SSV__UWORD_S 0 TenthFP 15 0 100 DEPOSIT ABSOLUTE MONOTONY MON_INCREASE PHYS_UNIT "% Throttle" /end AXIS_PTS
/begin MEASUREMENT TimingTooth "" UWORD NO_COMPU_METHOD 0 0 0 65535 ECU_ADDRESS 0x20001258 FORMAT "%.15" /end MEASUREMENT
/begin MEASUREMENT TimingTooth2 "" UWORD NO_COMPU_METHOD 0 0 0 65535 ECU_ADDRESS 0x20001200 FORMAT "%.15" /end MEASUREMENT
/begin CHARACTERISTIC ToothError "" VALUE 0x1C071 __UBYTE_S 0 NO_COMPU_METHOD 0 255 FORMAT "%.15" /end CHARACTERISTIC
/begin MEASUREMENT ToothOffset "" UWORD NO_COMPU_METHOD 0 0 0 65535 ECU_ADDRESS 0x2000120C FORMAT "%.15" /end MEASUREMENT
/begin MEASUREMENT ToothOffset2 "" UWORD NO_COMPU_METHOD 0 0 0 65535 ECU_ADDRESS 0x20001202 FORMAT "%.15" /end MEASUREMENT
/begin MEASUREMENT TorqDiff "" SLONG HundredthFP 0 0 -40 100 ECU_ADDRESS 0x20000458 FORMAT "%.15" PHYS_UNIT "% Torque"
 /begin IF_DATA XCP
  /begin DAQ_EVENT FIXED_EVENT_LIST "EVENT" 0x00 /end DAQ_EVENT
 /end IF_DATA
/end MEASUREMENT
/begin MEASUREMENT TorqInteg "" SLONG TorqInteg.Conversion 0 0 -2147483648 2147483647 ECU_ADDRESS 0x20000454 PHYS_UNIT "% Torque" /end MEASUREMENT
/begin MEASUREMENT TorqProp "" SLONG TorqProp.Conversion 0 0 -40 100 ECU_ADDRESS 0x20000450 FORMAT "%.15" PHYS_UNIT "% Torque"
 /begin IF_DATA XCP
  /begin DAQ_EVENT FIXED_EVENT_LIST "EVENT" 0x00 /end DAQ_EVENT
 /end IF_DATA
/end MEASUREMENT
/begin MEASUREMENT Torque "" SWORD TenthFP 0 0 -40 100 ECU_ADDRESS 0x20000424 FORMAT "%.15" PHYS_UNIT "% Torque"
 /begin IF_DATA XCP
  /begin DAQ_EVENT FIXED_EVENT_LIST "EVENT" 0x00 /end DAQ_EVENT
 /end IF_DATA
/end MEASUREMENT
/begin MEASUREMENT TorqueFF_XCP "" SWORD TenthFP 0 0 -40 100 ECU_ADDRESS 0x200004C4 PHYS_UNIT "%" READ_WRITE /end MEASUREMENT
/begin MEASUREMENT TorqueFeedForward "" SWORD TenthFP 0 0 -40 100 ECU_ADDRESS 0x2000040E PHYS_UNIT "% Torque"
 /begin IF_DATA XCP
  /begin DAQ_EVENT FIXED_EVENT_LIST "EVENT" 0x00 /end DAQ_EVENT
 /end IF_DATA
/end MEASUREMENT
/begin CHARACTERISTIC TorqueMap "" MAP 0x1D5C4 TorqueMap.Layout 0 TenthFP -40 150
 /begin AXIS_DESCR COM_AXIS RPM SAERPM.Conversion 20 0 9000 AXIS_PTS_REF RpmScale PHYS_UNIT "RPM" /end AXIS_DESCR
 /begin AXIS_DESCR COM_AXIS Torque TenthFP 15 -40 100 AXIS_PTS_REF TorqueScale PHYS_UNIT "%" /end AXIS_DESCR
 PHYS_UNIT "% Torque" /end CHARACTERISTIC
/begin MEASUREMENT TorqueMax "" SWORD TenthFP 0 0 -40 100 ECU_ADDRESS 0x20000426 PHYS_UNIT "% Torque"
 /begin IF_DATA XCP
  /begin DAQ_EVENT FIXED_EVENT_LIST "EVENT" 0x00 /end DAQ_EVENT
 /end IF_DATA
/end MEASUREMENT
/begin AXIS_PTS TorqueScale "" 0x1DF9C Torque TorqueScale.Layout 0 TenthFP 15 -40 100 DEPOSIT ABSOLUTE PHYS_UNIT "%" /end AXIS_PTS
/begin CHARACTERISTIC TpsMax "" VALUE 0x1E124 __SWORD_S 0 Volt_ATD 0 5000 FORMAT "%.15" PHYS_UNIT "V" /end CHARACTERISTIC
/begin CHARACTERISTIC TpsMin "" VALUE 0x1E126 __SWORD_S 0 Volt_ATD 0 5000 FORMAT "%.15" PHYS_UNIT "V" /end CHARACTERISTIC
/begin MEASUREMENT TriggerActive "" UWORD NO_COMPU_METHOD 0 0 0 65535 ECU_ADDRESS 0x20000FC4 FORMAT "%.15" /end MEASUREMENT
/begin MEASUREMENT TriggerFaultCounter "" UWORD NO_COMPU_METHOD 0 0 0 65535 ECU_ADDRESS 0x2000116E FORMAT "%.15" /end MEASUREMENT
/begin MEASUREMENT TriggerFaultSource "" SBYTE TriggerFaultSource.CONVERSION 0 0 -128 127 ECU_ADDRESS 0x2000116C FORMAT "%6.3" /end MEASUREMENT
/begin CHARACTERISTIC TriggerPos "deg TDC after missing teeth, trigger 1" VALUE 0x1C06C __UWORD_S 0 TenthFP 0 4294967295 PHYS_UNIT "deg" /end CHARACTERISTIC
/begin CHARACTERISTIC TriggerPos2 "deg TDC after missing teeth, trigger 2" VALUE 0x1C06E __UWORD_S 0 TenthFP 0 65535 PHYS_UNIT "deg" /end CHARACTERISTIC
/begin AXIS_PTS VoltageScale "" 0x1DFFC SystemVoltage SSV__ULONG_S 0 HundredthFP 20 0 36 DEPOSIT ABSOLUTE PHYS_UNIT "V" /end AXIS_PTS
/begin MEASUREMENT autoPrimeTimeout "" UWORD NO_COMPU_METHOD 0 0 0 65535 ECU_ADDRESS 0x20000FF8 FORMAT "%.15" /end MEASUREMENT
/begin MEASUREMENT backlashOffset "" SWORD NO_COMPU_METHOD 0 0 -32768 32767 ECU_ADDRESS 0x20001026 FORMAT "%.15" /end MEASUREMENT
/begin MEASUREMENT engine_ic_faults "" ULONG NO_COMPU_METHOD 0 0 0 4294967295 ECU_ADDRESS 0x200004CC FORMAT "%.15" /end MEASUREMENT
/begin MEASUREMENT restartTimer "" ULONG HundredthFP 0 0 0 4294967295 ECU_ADDRESS 0x2000124C PHYS_UNIT "s" /end MEASUREMENT
/begin MEASUREMENT rpm1 "" ULONG SAERPM.Conversion 0 0 0 4294967295 ECU_ADDRESS 0x20001208 /end MEASUREMENT
/begin MEASUREMENT rpm2 "" ULONG SAERPM.Conversion 0 0 0 4294967295 ECU_ADDRESS 0x200011FC /end MEASUREMENT
/begin COMPU_METHOD CHT1_High.Conversion "" TAB_VERB "%6.3" "" COMPU_TAB_REF CHT1_High.Conversion.Table /end COMPU_METHOD
/begin COMPU_METHOD CanIdSensor2.Conversion "" IDENTICAL "%6.3" "" /end COMPU_METHOD
/begin COMPU_METHOD ClosedLoopEgtOperation.Conversion "" TAB_VERB "%6.3" "" COMPU_TAB_REF ClosedLoopEgtOperation.Conversion.Table /end COMPU_METHOD
/begin COMPU_METHOD Crank.Conversion "" TAB_VERB "%6.3" "" COMPU_TAB_REF Crank.Conversion.Table /end COMPU_METHOD
/begin COMPU_METHOD CrankState.Conversion "" TAB_VERB "%6.3" "" COMPU_TAB_REF CrankState.Conversion.Table /end COMPU_METHOD
/begin COMPU_METHOD DeltaT.Conversion "" LINEAR "%6.3" "" COEFFS_LINEAR 0.8 0 /end COMPU_METHOD
/begin COMPU_METHOD DerateOverride.Conversion "" TAB_VERB "%6.3" "" COMPU_TAB_REF DerateOverride.Conversion.Table /end COMPU_METHOD
/begin COMPU_METHOD DerateState.CONVERSION "enumeration table" TAB_VERB "%.0" "" COMPU_TAB_REF DerateState.CONVERSION /end COMPU_METHOD
/begin COMPU_METHOD EGT.Conversion "" LINEAR "%6.3" "" COEFFS_LINEAR 0.25 0 /end COMPU_METHOD
/begin COMPU_METHOD EgtState "enumeration table" TAB_VERB "%.0" "" COMPU_TAB_REF EgtState /end COMPU_METHOD
/begin COMPU_METHOD EgtState.OLD_Copy1 "" TAB_VERB "%6.3" "" COMPU_TAB_REF EgtState.OLD_1 /end COMPU_METHOD
/begin COMPU_METHOD EngineRotation.CONVERSION "enumeration table" TAB_VERB "%.0" "" COMPU_TAB_REF EngineRotation.CONVERSION /end COMPU_METHOD
/begin COMPU_METHOD EngineStateCmd.CONVERSION "enumeration table" TAB_VERB "%.0" "" COMPU_TAB_REF EngineStateCmd.CONVERSION /end COMPU_METHOD
/begin COMPU_METHOD EngineStateCmd.Conversion "" TAB_VERB "%6.3" "" COMPU_TAB_REF EngineStateCmd.Conversion.Table /end COMPU_METHOD
/begin COMPU_METHOD EngineStateCmdXcp.CONVERSION "enumeration table" TAB_VERB "%.0" "" COMPU_TAB_REF EngineStateCmdXcp.CONVERSION /end COMPU_METHOD
/begin COMPU_METHOD Enrichment.Conversion "" LINEAR "%6.3" "" COEFFS_LINEAR 0.1 -100 /end COMPU_METHOD
/begin COMPU_METHOD Errors.Conversion "" TAB_VERB "%6.3" "" COMPU_TAB_REF Errors.Conversion.Table /end COMPU_METHOD
/begin COMPU_METHOD FuelMapType.Conversion "" TAB_VERB "%6.3" "" COMPU_TAB_REF FuelMapType.Conversion.Table /end COMPU_METHOD
/begin COMPU_METHOD GovMode.Conversion "" TAB_VERB "%6.3" "" COMPU_TAB_REF GovMode.Conversion.Table /end COMPU_METHOD
/begin COMPU_METHOD HundredthFP "" LINEAR "%6.3" "" COEFFS_LINEAR 0.01 0 /end COMPU_METHOD
/begin COMPU_METHOD MapCrank.Conversion "" LINEAR "%6.3" "" COEFFS_LINEAR 0.271 105 /end COMPU_METHOD
/begin COMPU_METHOD OpMode.Conversion "" TAB_VERB "%6.3" "" COMPU_TAB_REF OpMode.Conversion.Table /end COMPU_METHOD
/begin COMPU_METHOD SAERPM.Conversion "" LINEAR "%6.3" "" COEFFS_LINEAR 0.125 0 /end COMPU_METHOD
/begin COMPU_METHOD ShutdownXCP.Conversion "" TAB_VERB "%6.3" "" COMPU_TAB_REF ShutdownXCP.Conversion.Table /end COMPU_METHOD
/begin COMPU_METHOD SparkCutGov.Conversion "" LINEAR "%6.3" "" COEFFS_LINEAR -1 0 /end COMPU_METHOD
/begin COMPU_METHOD SparkTiming.Conversion "" LINEAR "%6.3" "deg" COEFFS_LINEAR -0.1 0 /end COMPU_METHOD
/begin COMPU_METHOD SpiState "enumeration table" TAB_VERB "%.0" "" COMPU_TAB_REF SpiState /end COMPU_METHOD
/begin COMPU_METHOD SpiState.OLD_Copy1 "" TAB_VERB "%6.3" "" COMPU_TAB_REF SpiState.OLD_1 /end COMPU_METHOD
/begin COMPU_METHOD SpiState.OLD_Copy2 "enumeration table" TAB_VERB "%.0" "" COMPU_TAB_REF SpiState.OLD_2 /end COMPU_METHOD
/begin COMPU_METHOD Table_0 "" TAB_VERB "%6.3" "" COMPU_TAB_REF Table_0 /end COMPU_METHOD
/begin COMPU_METHOD Table_1 "" TAB_VERB "%6.3" "" COMPU_TAB_REF Table_1 /end COMPU_METHOD
/begin COMPU_METHOD Table_11 "" TAB_VERB "%6.3" "" COMPU_TAB_REF Table_11 /end COMPU_METHOD
/begin COMPU_METHOD Temperature "" LINEAR "%3.1" "degC" COEFFS_LINEAR 0.1 0 /end COMPU_METHOD
/begin COMPU_METHOD TenThousandth "" LINEAR "%6.3" "" COEFFS_LINEAR 0.0001 0 /end COMPU_METHOD
/begin COMPU_METHOD TenX.Conversion "" LINEAR "%6.3" "" COEFFS_LINEAR 10 0 /end COMPU_METHOD
/begin COMPU_METHOD TenthFP "" LINEAR "%6.3" "" COEFFS_LINEAR 0.1 0 /end COMPU_METHOD
/begin COMPU_METHOD ThousandthFP "" LINEAR "%6.3" "" COEFFS_LINEAR 0.001 0 /end COMPU_METHOD
/begin COMPU_METHOD TorqInteg.Conversion "" LINEAR "%6.3" "" COEFFS_LINEAR 1E-05 0 /end COMPU_METHOD
/begin COMPU_METHOD TorqProp.Conversion "" LINEAR "%6.3" "" COEFFS_LINEAR 1E-05 0 /end COMPU_METHOD
/begin COMPU_METHOD TriggerFaultSource.CONVERSION "enumeration table" TAB_VERB "%.0" "" COMPU_TAB_REF TriggerFaultSource.CONVERSION /end COMPU_METHOD
/begin COMPU_METHOD Volt_ATD "Converts ATD in ECU to voltage" LINEAR "%6.3" "V/5V_12bit_ATD" COEFFS_LINEAR 1.221 0 /end COMPU_METHOD
/begin COMPU_METHOD Wdog_state.Conversion "" TAB_VERB "%6.3" "" COMPU_TAB_REF Wdog_state.Conversion.Table /end COMPU_METHOD
/begin COMPU_METHOD enginetype_t "enumeration table" TAB_VERB "%.0" "" COMPU_TAB_REF enginetype_t /end COMPU_METHOD
/begin COMPU_VTAB CHT1_High.Conversion.Table "" TAB_VERB 2 0 "OK" 1 "Faulty" DEFAULT_VALUE "" /end COMPU_VTAB
/begin COMPU_VTAB ClosedLoopEgtOperation.Conversion.Table "" TAB_VERB 2 0 "Open Loop" 1 "Closed Loop" DEFAULT_VALUE "" /end COMPU_VTAB
/begin COMPU_VTAB Crank.Conversion.Table "" TAB_VERB 2 0 "1 - Primary" 1 "2 - Secondary" DEFAULT_VALUE "" /end COMPU_VTAB
/begin COMPU_VTAB CrankState.Conversion.Table "" TAB_VERB 7 0 "Tooth Init" 1 "First Edge" 2 "Testing for gap" 3 "Validating gap" 4 "First Revolution" 5 "Synchronizing" 6 "Synchronizing 4C" DEFAULT_VALUE "" /end COMPU_VTAB
/begin COMPU_VTAB DerateOverride.Conversion.Table "" TAB_VERB 2 0 "Off" 1 "Active" DEFAULT_VALUE "" /end COMPU_VTAB
/begin COMPU_VTAB_RANGE DerateState.CONVERSION "" 4 0 0 "DERATE_OFF" 1 1 "Derate_Peak" 2 2 "Derate_Cruise" 3 3 "Derate_Override" DEFAULT_VALUE "" /end COMPU_VTAB_RANGE
/begin COMPU_VTAB_RANGE EgtState "" 5 0 0 "EgtState_Uninitialized" 1 1 "EgtState_Ready" 2 2 "EgtState_ReadingEgtOne" 3 3 "EgtState_ReadEgtTwo" 4 4 "EgtState_ReadingEgtTwo" DEFAULT_VALUE "" /end COMPU_VTAB_RANGE
/begin COMPU_VTAB EgtState.OLD_1 "" TAB_VERB 5 0 "EgtState_Uninitialized" 1 "EgtState_Ready" 2 "EgtState_ReadingEgtOne" 3 "EgtState_ReadEgtTwo" 4 "EgtState_ReadingEgtTwo" DEFAULT_VALUE "" /end COMPU_VTAB
/begin COMPU_VTAB_RANGE EngineRotation.CONVERSION "" 2 0 0 "RotationType_Standard" 1 1 "RotationType_Counter" DEFAULT_VALUE "" /end COMPU_VTAB_RANGE
/begin COMPU_VTAB_RANGE EngineStateCmd.CONVERSION "" 3 0 0 "EngineCmd_Off" 1 1 "EngineCmd_Run" 2 2 "EngineCmd_Auto" DEFAULT_VALUE "" /end COMPU_VTAB_RANGE
/begin COMPU_VTAB EngineStateCmd.Conversion.Table "" TAB_VERB 2 0 "Off" 1 "Run" DEFAULT_VALUE "" /end COMPU_VTAB
/begin COMPU_VTAB_RANGE EngineStateCmdXcp.CONVERSION "" 7 0 0 "ENGINESTATE_OFF" 1 1 "ENGINESTATE_PREHEAT" 2 2 "ENGINESTATE_START" 3 3 "ENGINESTATE_STABILIZE" 4 4 "ENGINESTATE_BIT" 5 5 "ENGINESTATE_RUN" 6 6 "ENGINESTATE_SHUTDOWN" DEFAULT_VALUE "" /end COMPU_VTAB_RANGE
/begin COMPU_VTAB Errors.Conversion.Table "" TAB_VERB 2 0 "OK" 1 "Fault" DEFAULT_VALUE "" /end COMPU_VTAB
/begin COMPU_VTAB FuelMapType.Conversion.Table "" TAB_VERB 3 0 "Auto" 1 "Throttle Position" 2 "Manifold Pressure" DEFAULT_VALUE "" /end COMPU_VTAB
/begin COMPU_VTAB GovMode.Conversion.Table "" TAB_VERB 3 0 "Idle" 1 "Run" 2 "RevLimit" DEFAULT_VALUE "" /end COMPU_VTAB
/begin COMPU_VTAB OpMode.Conversion.Table "" TAB_VERB 10 0 "Standby" 1 "AutoPrime" 2 "Overspeed" 3 "Shutdown" 4 "Crankfail" 5 "Preheat" 6 "Run Up" 7 "Run Open Loop" 8 "Run Closed Loop" 9 "Cranking" DEFAULT_VALUE "" /end COMPU_VTAB
/begin COMPU_VTAB ShutdownXCP.Conversion.Table "" TAB_VERB 2 0 "Off" 1 "On" DEFAULT_VALUE "" /end COMPU_VTAB
/begin COMPU_VTAB_RANGE SpiState "" 4 0 0 "SpiState_Uninitialized" 1 1 "SpiState_Ready" 2 2 "SpiState_TxRx_Byte_0" 3 3 "SpiState_TxRx_Byte_1" DEFAULT_VALUE "" /end COMPU_VTAB_RANGE
/begin COMPU_VTAB SpiState.OLD_1 "" TAB_VERB 6 0 "SpiState_Uninitialized" 1 "SpiState_Ready" 2 "SpiState_TxRx_Byte_0" 3 "SpiState_TxRx_Byte_1" 4 "SpiState_TxRx_Buf_Byte_0" 5 "SpiState_TxRx_Buf_Byte_1" DEFAULT_VALUE "" /end COMPU_VTAB
/begin COMPU_VTAB_RANGE SpiState.OLD_2 "" 6 0 0 "SpiState_Uninitialized" 1 1 "SpiState_Ready" 2 2 "SpiState_TxRx_Byte_0" 3 3 "SpiState_TxRx_Byte_1" 4 4 "SpiState_TxRx_Buf_Byte_0" 5 5 "SpiState_TxRx_Buf_Byte_1" DEFAULT_VALUE "" /end COMPU_VTAB_RANGE
/begin COMPU_VTAB Table_0 "" TAB_VERB 2 0 "RotationType_Standard" 1 "RotationType_Counter" DEFAULT_VALUE "" /end COMPU_VTAB
/begin COMPU_VTAB Table_1 "" TAB_VERB 5 0 "Clear" 1 "Reset" 2 "Interval_TooLong" 3 "Interval_TooShort" 4 "Interval_MissingTeeth" DEFAULT_VALUE "" /end COMPU_VTAB
/begin COMPU_VTAB Table_11 "" TAB_VERB 4 0 "DERATE_OFF" 1 "Derate_Peak" 2 "Derate_Cruise" 3 "Derate_Override" DEFAULT_VALUE "" /end COMPU_VTAB
/begin COMPU_VTAB_RANGE TriggerFaultSource.CONVERSION "" 5 0 0 "Clear" 1 1 "Reset" 2 2 "Interval_TooLong" 3 3 "Interval_TooShort" 4 4 "Interval_MissingTeeth" DEFAULT_VALUE "" /end COMPU_VTAB_RANGE
/begin COMPU_VTAB Wdog_state.Conversion.Table "" TAB_VERB 14 0 "Init" 1 "RunOp1" 2 "RunOp2" 3 "RunOp3" 4 "RunOp4" 5 "RunOp5" 6 "Standby" 7 "Autoprime" 8 "New_Inj" 9 "Sustained_Inj" 10 "Spark" 11 "FTM1" 12 "FTM0" 13 "Trig2" DEFAULT_VALUE "" /end COMPU_VTAB
/begin COMPU_VTAB enginetype_t "enumeration table" TAB_VERB 2 0 "EngineType_No_2" 1 "EngineType_No_1" /end COMPU_VTAB
/begin RECORD_LAYOUT SSV__A_INT64_S AXIS_PTS_X 1 A_INT64 INDEX_INCR DIRECT /end RECORD_LAYOUT
/begin RECORD_LAYOUT SSV__A_UINT64_S AXIS_PTS_X 1 A_UINT64 INDEX_INCR DIRECT /end RECORD_LAYOUT
/begin RECORD_LAYOUT SSV__FLOAT32_IEEE_S AXIS_PTS_X 1 FLOAT32_IEEE INDEX_INCR DIRECT /end RECORD_LAYOUT
/begin RECORD_LAYOUT SSV__FLOAT64_IEEE_S AXIS_PTS_X 1 FLOAT64_IEEE INDEX_INCR DIRECT /end RECORD_LAYOUT
/begin RECORD_LAYOUT SSV__SBYTE_S AXIS_PTS_X 1 SBYTE INDEX_INCR DIRECT /end RECORD_LAYOUT
/begin RECORD_LAYOUT SSV__SLONG_S AXIS_PTS_X 1 SLONG INDEX_INCR DIRECT /end RECORD_LAYOUT
/begin RECORD_LAYOUT SSV__SWORD_S AXIS_PTS_X 1 SWORD INDEX_INCR DIRECT /end RECORD_LAYOUT
/begin RECORD_LAYOUT SSV__UBYTE_S AXIS_PTS_X 1 UBYTE INDEX_INCR DIRECT /end RECORD_LAYOUT
/begin RECORD_LAYOUT SSV__ULONG_S AXIS_PTS_X 1 ULONG INDEX_INCR DIRECT /end RECORD_LAYOUT
/begin RECORD_LAYOUT SSV__UWORD_S AXIS_PTS_X 1 UWORD INDEX_INCR DIRECT /end RECORD_LAYOUT
/begin RECORD_LAYOUT TorqueMap.Layout FNC_VALUES 1 UWORD ROW_DIR DIRECT /end RECORD_LAYOUT
/begin RECORD_LAYOUT TorqueScale.Layout AXIS_PTS_X 1 SWORD INDEX_INCR DIRECT /end RECORD_LAYOUT
/begin RECORD_LAYOUT __A_INT64_S FNC_VALUES 1 A_INT64 COLUMN_DIR DIRECT /end RECORD_LAYOUT
/begin RECORD_LAYOUT __A_INT64_Z FNC_VALUES 1 A_INT64 ROW_DIR DIRECT /end RECORD_LAYOUT
/begin RECORD_LAYOUT __A_UINT64_S FNC_VALUES 1 A_UINT64 COLUMN_DIR DIRECT /end RECORD_LAYOUT
/begin RECORD_LAYOUT __A_UINT64_Z FNC_VALUES 1 A_UINT64 ROW_DIR DIRECT /end RECORD_LAYOUT
/begin RECORD_LAYOUT __FLOAT32_IEEE_S FNC_VALUES 1 FLOAT32_IEEE COLUMN_DIR DIRECT /end RECORD_LAYOUT
/begin RECORD_LAYOUT __FLOAT32_IEEE_Z FNC_VALUES 1 FLOAT32_IEEE ROW_DIR DIRECT /end RECORD_LAYOUT
/begin RECORD_LAYOUT __FLOAT64_IEEE_S FNC_VALUES 1 FLOAT64_IEEE COLUMN_DIR DIRECT /end RECORD_LAYOUT
/begin RECORD_LAYOUT __FLOAT64_IEEE_Z FNC_VALUES 1 FLOAT64_IEEE ROW_DIR DIRECT /end RECORD_LAYOUT
/begin RECORD_LAYOUT __SBYTE_S FNC_VALUES 1 SBYTE COLUMN_DIR DIRECT /end RECORD_LAYOUT
/begin RECORD_LAYOUT __SBYTE_Z FNC_VALUES 1 SBYTE ROW_DIR DIRECT /end RECORD_LAYOUT
/begin RECORD_LAYOUT __SLONG_S FNC_VALUES 1 SLONG COLUMN_DIR DIRECT /end RECORD_LAYOUT
/begin RECORD_LAYOUT __SLONG_Z FNC_VALUES 1 SLONG ROW_DIR DIRECT /end RECORD_LAYOUT
/begin RECORD_LAYOUT __SWORD_S FNC_VALUES 1 SWORD COLUMN_DIR DIRECT /end RECORD_LAYOUT
/begin RECORD_LAYOUT __SWORD_Z FNC_VALUES 1 SWORD ROW_DIR DIRECT /end RECORD_LAYOUT
/begin RECORD_LAYOUT __SWord_Value FNC_VALUES 1 SWORD ROW_DIR DIRECT /end RECORD_LAYOUT
/begin RECORD_LAYOUT __UBYTE_S FNC_VALUES 1 UBYTE COLUMN_DIR DIRECT /end RECORD_LAYOUT
/begin RECORD_LAYOUT __UBYTE_Z FNC_VALUES 1 UBYTE ROW_DIR DIRECT /end RECORD_LAYOUT
/begin RECORD_LAYOUT __ULONG_S FNC_VALUES 1 ULONG COLUMN_DIR DIRECT /end RECORD_LAYOUT
/begin RECORD_LAYOUT __ULONG_Z FNC_VALUES 1 ULONG ROW_DIR DIRECT /end RECORD_LAYOUT
/begin RECORD_LAYOUT __ULong_Value FNC_VALUES 1 ULONG ROW_DIR DIRECT /end RECORD_LAYOUT
/begin RECORD_LAYOUT __UWORD_S FNC_VALUES 1 UWORD COLUMN_DIR DIRECT /end RECORD_LAYOUT
/begin RECORD_LAYOUT __UWORD_Z FNC_VALUES 1 UWORD ROW_DIR DIRECT /end RECORD_LAYOUT
/begin RECORD_LAYOUT __UWord_Axis AXIS_PTS_X 1 UWORD INDEX_INCR DIRECT /end RECORD_LAYOUT
/begin RECORD_LAYOUT __UWord_Value FNC_VALUES 1 UWORD ROW_DIR DIRECT /end RECORD_LAYOUT
/begin UNIT Celsius "" "degC" EXTENDED_SI SI_EXPONENTS 0 0 0 0 1 0 0 /end UNIT
/end MODULE
/end PROJECT
