/* generated by ASAP2 Studio 2.6.30.12408 */ ASAP2_VERSION 1 71
/begin PROJECT ProjectName ""
/begin MODULE ModuleName "iAPU"
/begin MOD_PAR "" PHONE_NO "867-5309"
 /begin MEMORY_SEGMENT CAL_FLASH "" DATA FLASH INTERN 0x7C000 0x800 -1 -1 -1 -1 -1
  /begin IF_DATA XCP
   /begin SEGMENT 0x00 0x01 0x00 0x00 0x00
    /begin CHECKSUM XCP_ADD_12 MAX_BLOCK_SIZE 0xFFFFFFFF EXTERNAL_FUNCTION "chksum.dll" /end CHECKSUM
    /begin PAGE 0x00 ECU_ACCESS_DONT_CARE XCP_READ_ACCESS_DONT_CARE XCP_WRITE_ACCESS_DONT_CARE /end PAGE
   /end SEGMENT
  /end IF_DATA
 /end MEMORY_SEGMENT
 /begin MEMORY_SEGMENT PoolRAM "" SERAM RAM INTERN 0x20006600 0x800 -1 -1 -1 -1 -1
  /begin IF_DATA XCP
   /begin SEGMENT 0x01 0x00 0x00 0x00 0x00
    /begin CHECKSUM XCP_ADD_12 MAX_BLOCK_SIZE 0xFFFFFFFF EXTERNAL_FUNCTION "chksum.dll" /end CHECKSUM
   /end SEGMENT
  /end IF_DATA
 /end MEMORY_SEGMENT
 /begin CALIBRATION_METHOD "AUTOSAR_SINGLE_POINTERED" 0x1 /begin CALIBRATION_HANDLE 0x20005000 0x134 0x4 /end CALIBRATION_HANDLE /end CALIBRATION_METHOD
/end MOD_PAR
/begin MOD_COMMON "" ALIGNMENT_BYTE 1 ALIGNMENT_WORD 2 ALIGNMENT_LONG 4 ALIGNMENT_FLOAT16_IEEE 1 ALIGNMENT_FLOAT32_IEEE 4 ALIGNMENT_FLOAT64_IEEE 8 ALIGNMENT_INT64 8 /end MOD_COMMON
/begin IF_DATA XCP
 /begin PROTOCOL_LAYER 0x0100 0x64 0x64 0x00 0x00 0x00 0x00 0x00 0x08 0x08 BYTE_ORDER_MSB_FIRST ADDRESS_GRANULARITY_BYTE OPTIONAL_CMD PROGRAM_RESET OPTIONAL_CMD PROGRAM OPTIONAL_CMD PROGRAM_CLEAR OPTIONAL_CMD PROGRAM_START OPTIONAL_CMD ALLOC_ODT_ENTRY OPTIONAL_CMD ALLOC_ODT OPTIONAL_CMD ALLOC_DAQ OPTIONAL_CMD FREE_DAQ OPTIONAL_CMD GET_DAQ_RESOLUTION_INFO OPTIONAL_CMD GET_DAQ_PROCESSOR_INFO OPTIONAL_CMD START_STOP_SYNCH OPTIONAL_CMD START_STOP_DAQ_LIST OPTIONAL_CMD GET_DAQ_LIST_MODE OPTIONAL_CMD SET_DAQ_LIST_MODE OPTIONAL_CMD WRITE_DAQ OPTIONAL_CMD SET_DAQ_PTR OPTIONAL_CMD CLEAR_DAQ_LIST OPTIONAL_CMD DOWNLOAD OPTIONAL_CMD BUILD_CHECKSUM OPTIONAL_CMD UPLOAD OPTIONAL_CMD SET_MTA /end PROTOCOL_LAYER
 /begin DAQ DYNAMIC 0x00 0x01 0x00 OPTIMISATION_TYPE_DEFAULT ADDRESS_EXTENSION_FREE IDENTIFICATION_FIELD_TYPE_ABSOLUTE GRANULARITY_ODT_ENTRY_SIZE_DAQ_BYTE 0x07 NO_OVERLOAD_INDICATION PRESCALER_SUPPORTED
  /begin DAQ_LIST 0x00 DAQ_LIST_TYPE DAQ MAX_ODT 0xFF MAX_ODT_ENTRIES 0xFF FIRST_PID 0x00 /end DAQ_LIST
  /begin EVENT "20ms" "20ms" 0x00 DAQ 0xFF 0x14 0x06 0x00 /end EVENT
 /end DAQ
 /begin PAG 0x02 /end PAG
 /begin PGM PGM_MODE_ABSOLUTE 0x02 0x00 /begin SECTOR "FLASH" 0x00 0x07C000 0x1000 0x00 0x00 0x00 /end SECTOR /begin SECTOR "FLASH" 0x01 0x07D000 0x1000 0x00 0x00 0x00 /end SECTOR /end PGM
 /begin XCP_ON_CAN 0x0100 CAN_ID_MASTER 0x92750002 CAN_ID_SLAVE 0x92750C01 BAUDRATE 0x0F4240 SAMPLE_POINT 0x4B SAMPLE_RATE SINGLE BTL_CYCLES 0x08 SJW 0x02 SYNC_EDGE SINGLE /end XCP_ON_CAN
/end IF_DATA
/begin CHARACTERISTIC AnaIn1Translation "" CURVE 0x7C16C __SWord_Value 0 NO_COMPU_METHOD -32768 32767
 /begin AXIS_DESCR COM_AXIS NO_INPUT_QUANTITY NO_COMPU_METHOD 2 0 0 AXIS_PTS_REF AnaIn1VoltageScale /end AXIS_DESCR
/end CHARACTERISTIC
/begin AXIS_PTS AnaIn1VoltageScale "" 0x7C168 NO_INPUT_QUANTITY __SWord_Axis 0 NO_COMPU_METHOD 2 -32768 32767 /end AXIS_PTS
/begin CHARACTERISTIC AnaIn2Translation "" CURVE 0x7C174 __SWord_Value 0 NO_COMPU_METHOD -32768 32767
 /begin AXIS_DESCR COM_AXIS NO_INPUT_QUANTITY NO_COMPU_METHOD 2 0 0 AXIS_PTS_REF AnaIn2VoltageScale /end AXIS_DESCR
/end CHARACTERISTIC
/begin AXIS_PTS AnaIn2VoltageScale "" 0x7C170 NO_INPUT_QUANTITY __SWord_Axis 0 NO_COMPU_METHOD 2 -32768 32767 /end AXIS_PTS
/begin CHARACTERISTIC AnaIn3Translation "" CURVE 0x7C17C __SWord_Value 0 NO_COMPU_METHOD -32768 32767
 /begin AXIS_DESCR FIX_AXIS NO_INPUT_QUANTITY NO_COMPU_METHOD 2 0 0 FIX_AXIS_PAR_DIST 0 1 1 /end AXIS_DESCR
/end CHARACTERISTIC
/begin AXIS_PTS AnaIn3VoltageScale "" 0x7C178 NO_INPUT_QUANTITY __SWord_Axis 0 NO_COMPU_METHOD 2 -32768 32767 /end AXIS_PTS
/begin CHARACTERISTIC CalComments "" ASCII 0x7C000 __UByte_Value 0 NO_COMPU_METHOD 0 255 NUMBER 200 /end CHARACTERISTIC
/begin MEASUREMENT CanCmdOverrideXCP "" UBYTE binaryState_t 0 0 0 255 ECU_ADDRESS 0x200000E8 READ_WRITE /end MEASUREMENT
/begin MEASUREMENT ContactorStateXCP "" UBYTE binaryState_t 0 0 0 255 ECU_ADDRESS 0x1FFF840C READ_WRITE /end MEASUREMENT
/begin CHARACTERISTIC CoolingFanDutyManual "" VALUE 0x7C1A8 __SByte_Value 0 NO_COMPU_METHOD -128 127 /end CHARACTERISTIC
/begin CHARACTERISTIC CoolingFanEnable "" VALUE 0x7C180 __UByte_Value 0 binaryState_t 0 255 /end CHARACTERISTIC
/begin CHARACTERISTIC CoolingFanTCDuty "" CURVE 0x7C198 __SWord_Value 0 NO_COMPU_METHOD -32768 32767
 /begin AXIS_DESCR COM_AXIS NO_INPUT_QUANTITY NO_COMPU_METHOD 4 0 0 AXIS_PTS_REF CoolingFanTCTempScale /end AXIS_DESCR
/end CHARACTERISTIC
/begin AXIS_PTS CoolingFanTCTempScale "" 0x7C188 NO_INPUT_QUANTITY __SWord_Axis 0 NO_COMPU_METHOD 4 -32768 32767 /end AXIS_PTS
/begin CHARACTERISTIC CoolingFanTempControl "" VALUE 0x7C182 __UByte_Value 0 binaryState_t 0 255 /end CHARACTERISTIC
/begin CHARACTERISTIC CoolingFanTestEnable "" VALUE 0x7C184 __UByte_Value 0 binaryState_t 0 255 /end CHARACTERISTIC
/begin AXIS_PTS CurrentCmdScale "" 0x7C334 currentSetpoint __UWord_Axis 0 TenthFP 12 0 65535 PHYS_UNIT "A" /end AXIS_PTS
/begin CHARACTERISTIC EnclosureFanDutyManual "" VALUE 0x7C1A9 __SByte_Value 0 NO_COMPU_METHOD -128 127 /end CHARACTERISTIC
/begin CHARACTERISTIC EnclosureFanEnable "" VALUE 0x7C181 __UByte_Value 0 binaryState_t 0 255 /end CHARACTERISTIC
/begin CHARACTERISTIC EnclosureFanTCDuty "" CURVE 0x7C1A0 __SWord_Value 0 NO_COMPU_METHOD -32768 32767
 /begin AXIS_DESCR COM_AXIS NO_INPUT_QUANTITY NO_COMPU_METHOD 4 0 0 AXIS_PTS_REF EnclosureFanTCTempScale /end AXIS_DESCR
/end CHARACTERISTIC
/begin AXIS_PTS EnclosureFanTCTempScale "" 0x7C190 NO_INPUT_QUANTITY __SWord_Axis 0 NO_COMPU_METHOD 4 -32768 32767 /end AXIS_PTS
/begin CHARACTERISTIC EnclosureFanTempControl "" VALUE 0x7C183 __UByte_Value 0 binaryState_t 0 255 /end CHARACTERISTIC
/begin CHARACTERISTIC EnclosureFanTestEnable "" VALUE 0x7C185 __UByte_Value 0 binaryState_t 0 255 /end CHARACTERISTIC
/begin CHARACTERISTIC EnclosureTempTranslation "" CURVE 0x7C110 __SWord_Value 0 NO_COMPU_METHOD -32768 32767
 /begin AXIS_DESCR COM_AXIS NO_INPUT_QUANTITY NO_COMPU_METHOD 11 0 0 AXIS_PTS_REF EnclosureTempVoltageScale READ_ONLY /end AXIS_DESCR
/end CHARACTERISTIC
/begin AXIS_PTS EnclosureTempVoltageScale "" 0x7C0F8 EnclosureTemp __SWord_Axis 0 NO_COMPU_METHOD 11 -32768 32767 /end AXIS_PTS
/begin MEASUREMENT EngineOutput "" SWORD TenthFP 0 0 0 255 ECU_ADDRESS 0x200064F6 /end MEASUREMENT
/begin CHARACTERISTIC EngineRunHysteresis "" VALUE 0x7C274 __SLong_Value 0 NO_COMPU_METHOD -2147483648 2147483647 /end CHARACTERISTIC
/begin CHARACTERISTIC EngineRunThreshold "" VALUE 0x7C270 __SLong_Value 0 NO_COMPU_METHOD -2147483648 2147483647 /end CHARACTERISTIC
/begin AXIS_PTS EngineSpeedScale "" 0x7C304 Engine_Speed_Target __UWord_Axis 0 NO_COMPU_METHOD 12 0 8000 PHYS_UNIT "RPM" /end AXIS_PTS
/begin CHARACTERISTIC EngineSpeedTargetScale "" CURVE 0x7C34C __UWord_Value 0 EngineSpeedTargetScale.Conversion 0 65535
 /begin AXIS_DESCR COM_AXIS cmdTargetCurrent NO_COMPU_METHOD 12 0 0 AXIS_PTS_REF CurrentCmdScale /end AXIS_DESCR
 PHYS_UNIT "RPM" /end CHARACTERISTIC
/begin MEASUREMENT EngineTorque "" UBYTE EngineTorque.Conversion 0 0 0 255 ECU_ADDRESS 0x2000641C PHYS_UNIT "%" /end MEASUREMENT
/begin CHARACTERISTIC EngineTorqueCurve "" CURVE 0x7C31C __SWord_Value 0 TenthFP -32768 32767
 /begin AXIS_DESCR COM_AXIS cmdTargetCurrent NO_COMPU_METHOD 12 0 0 AXIS_PTS_REF CurrentCmdScale /end AXIS_DESCR
 PHYS_UNIT "Nm" /end CHARACTERISTIC
/begin MEASUREMENT EngineTorqueMax "" UBYTE EngineTorqueMax.Conversion 0 0 0 255 ECU_ADDRESS 0x200064F4 PHYS_UNIT "%" /end MEASUREMENT
/begin MEASUREMENT Engine_Boost_Pressure "" UBYTE Engine_Boost_Pressure.Conversion 0 0 0 255 ECU_ADDRESS 0x200064CB PHYS_UNIT "kPa" SYMBOL_LINK "engBoostPressure" 0 /end MEASUREMENT
/begin MEASUREMENT Engine_CAC_Outlet_Temp "" UBYTE Engine_CAC_Outlet_Temp.Conversion 0 0 0 255 ECU_ADDRESS 0x200064CA PHYS_UNIT "deg C" SYMBOL_LINK "engCacOutletTemp" 0 /end MEASUREMENT
/begin MEASUREMENT Engine_Coolant_Temp "" UBYTE coolantTemp.Conversion 0 0 -40 210 ECU_ADDRESS 0x20006434 PHYS_UNIT "C" SYMBOL_LINK "coolantTemp" 0 /end MEASUREMENT
/begin MEASUREMENT Engine_Speed "" UWORD SAERPM.Conversion 0 0 0 65535 ECU_ADDRESS 0x20006418 PHYS_UNIT "RPM" SYMBOL_LINK "EngineSpeed" 0 /end MEASUREMENT
/begin MEASUREMENT Engine_Speed_Target "" UWORD SAERPM.Conversion 0 0 0 65535 ECU_ADDRESS 0x2000641A PHYS_UNIT "RPM" SYMBOL_LINK "EngineSpeedTarget" 0 /end MEASUREMENT
/begin CHARACTERISTIC FW_Version "" ASCII 0x7BFF0 __UByte_Value 0 NO_COMPU_METHOD 0 255 NUMBER 6 /end CHARACTERISTIC
/begin MEASUREMENT FeedForwardTerm "" SLONG NO_COMPU_METHOD 0 0 -2147483648 2147483647 ECU_ADDRESS 0x20000030 /end MEASUREMENT
/begin CHARACTERISTIC HTCoolantPressureTranslation "" CURVE 0x7C15C __SWord_Value 0 NO_COMPU_METHOD -32768 32767
 /begin AXIS_DESCR COM_AXIS NO_INPUT_QUANTITY NO_COMPU_METHOD 2 0 0 AXIS_PTS_REF HTCoolantPressureVoltageScale /end AXIS_DESCR
/end CHARACTERISTIC
/begin AXIS_PTS HTCoolantPressureVoltageScale "" 0x7C158 NO_INPUT_QUANTITY __SWord_Axis 0 NO_COMPU_METHOD 2 -32768 32767 /end AXIS_PTS
/begin CHARACTERISTIC HTPumpDutyManual "" VALUE 0x7C26C __SByte_Value 0 NO_COMPU_METHOD -128 127 /end CHARACTERISTIC
/begin CHARACTERISTIC HTPumpDutyMap "" MAP 0x7C234 __SWord_Value 0 NO_COMPU_METHOD -32768 32767
 /begin AXIS_DESCR COM_AXIS NO_INPUT_QUANTITY NO_COMPU_METHOD 7 0 0 AXIS_PTS_REF HTPumpEngineSpeedScale /end AXIS_DESCR
 /begin AXIS_DESCR COM_AXIS NO_INPUT_QUANTITY NO_COMPU_METHOD 4 0 0 AXIS_PTS_REF HTPumpTempScale /end AXIS_DESCR
/end CHARACTERISTIC
/begin CHARACTERISTIC HTPumpEnable "" VALUE 0x7C20D __UByte_Value 0 binaryState_t 0 255 /end CHARACTERISTIC
/begin AXIS_PTS HTPumpEngineSpeedScale "" 0x7C218 NO_INPUT_QUANTITY __SLong_Axis 0 NO_COMPU_METHOD 7 -2147483648 2147483647 /end AXIS_PTS
/begin CHARACTERISTIC HTPumpManualControl "" VALUE 0x7C20E __UByte_Value 0 binaryState_t 0 255 /end CHARACTERISTIC
/begin AXIS_PTS HTPumpTempScale "" 0x7C210 NO_INPUT_QUANTITY __SWord_Axis 0 NO_COMPU_METHOD 4 -32768 32767 /end AXIS_PTS
/begin CHARACTERISTIC HTPumpTestEnable "" VALUE 0x7C20F __UByte_Value 0 binaryState_t 0 255 /end CHARACTERISTIC
/begin MEASUREMENT InvTorqueInteg "" SLONG HundredThousandthFP.Conversion 0 0 -2147483648 2147483647 ECU_ADDRESS 0x200064D0 PHYS_UNIT "Nm" /end MEASUREMENT
/begin MEASUREMENT InvTorqueProp "" SLONG TenThousandth 0 0 -2147483648 2147483647 ECU_ADDRESS 0x200064CC PHYS_UNIT "Nm" /end MEASUREMENT
/begin CHARACTERISTIC Ki_current "" VALUE 0x7C2B8 __SLong_Value 0 NO_COMPU_METHOD -10000 10000 /end CHARACTERISTIC
/begin CHARACTERISTIC Kp_current "" VALUE 0x7C2B4 __SLong_Value 0 NO_COMPU_METHOD -10000 10000 /end CHARACTERISTIC
/begin CHARACTERISTIC LTCoolantPressureTranslation "" CURVE 0x7C164 __SWord_Value 0 NO_COMPU_METHOD -32768 32767
 /begin AXIS_DESCR COM_AXIS NO_INPUT_QUANTITY NO_COMPU_METHOD 2 0 0 AXIS_PTS_REF LTCoolantPressureVoltageScale /end AXIS_DESCR
/end CHARACTERISTIC
/begin AXIS_PTS LTCoolantPressureVoltageScale "" 0x7C160 NO_INPUT_QUANTITY __SWord_Axis 0 NO_COMPU_METHOD 2 -32768 32767 /end AXIS_PTS
/begin CHARACTERISTIC LTECTTranslation "" CURVE 0x7C0E0 __SWord_Value 0 NO_COMPU_METHOD -32768 32767
 /begin AXIS_DESCR COM_AXIS NO_INPUT_QUANTITY NO_COMPU_METHOD 11 0 0 AXIS_PTS_REF LTECTVoltageScale /end AXIS_DESCR
/end CHARACTERISTIC
/begin AXIS_PTS LTECTVoltageScale "" 0x7C0C8 LTECTTemp __SWord_Axis 0 NO_COMPU_METHOD 11 -32768 32767 /end AXIS_PTS
/begin CHARACTERISTIC LTPumpDutyManual "" VALUE 0x7C20C __SByte_Value 0 NO_COMPU_METHOD -128 127 /end CHARACTERISTIC
/begin CHARACTERISTIC LTPumpDutyMap "" MAP 0x7C1D4 __SWord_Value 0 NO_COMPU_METHOD -32768 32767
 /begin AXIS_DESCR COM_AXIS NO_INPUT_QUANTITY NO_COMPU_METHOD 7 0 0 AXIS_PTS_REF LTPumpEngineSpeedScale /end AXIS_DESCR
 /begin AXIS_DESCR COM_AXIS NO_INPUT_QUANTITY NO_COMPU_METHOD 4 0 0 AXIS_PTS_REF LTPumpTempScale /end AXIS_DESCR
/end CHARACTERISTIC
/begin CHARACTERISTIC LTPumpEnable "" VALUE 0x7C1AA __UByte_Value 0 binaryState_t 0 255 /end CHARACTERISTIC
/begin AXIS_PTS LTPumpEngineSpeedScale "" 0x7C1B8 NO_INPUT_QUANTITY __SLong_Axis 0 NO_COMPU_METHOD 7 -2147483648 2147483647 /end AXIS_PTS
/begin CHARACTERISTIC LTPumpManualControl "" VALUE 0x7C1AB __UByte_Value 0 binaryState_t 0 255 /end CHARACTERISTIC
/begin AXIS_PTS LTPumpTempScale "" 0x7C1B0 NO_INPUT_QUANTITY __SWord_Axis 0 NO_COMPU_METHOD 4 -32768 32767 /end AXIS_PTS
/begin CHARACTERISTIC LTPumpTestEnable "" VALUE 0x7C1AC __UByte_Value 0 binaryState_t 0 1 /end CHARACTERISTIC
/begin CHARACTERISTIC LTPumpTestEnable_Copy1 "" VALUE 0x7C1AC __UByte_Value 0 binaryState_t 0 255 SYMBOL_LINK "LTPumpTestEnable" 0 /end CHARACTERISTIC
/begin MEASUREMENT MotorOilPressure "" SWORD TenthFP 0 0 -32768 32767 ECU_ADDRESS 0x2000645E PHYS_UNIT "psi" SYMBOL_LINK "invAnaIn3" 0 /end MEASUREMENT
/begin MEASUREMENT SpeedControlOverrideXCP "" UBYTE binaryState_t 0 0 0 255 ECU_ADDRESS 0x200000EE READ_WRITE /end MEASUREMENT
/begin MEASUREMENT SystemCoreClock "" ULONG NO_COMPU_METHOD 0 0 0 4294967295 ECU_ADDRESS 0x0 /end MEASUREMENT
/begin CHARACTERISTIC Temp3Translation "" CURVE 0x7C140 __SWord_Value 0 NO_COMPU_METHOD -32768 32767
 /begin AXIS_DESCR COM_AXIS NO_INPUT_QUANTITY NO_COMPU_METHOD 11 0 0 AXIS_PTS_REF Temp3VoltageScale /end AXIS_DESCR
/end CHARACTERISTIC
/begin AXIS_PTS Temp3VoltageScale "" 0x7C128 NO_INPUT_QUANTITY __SWord_Axis 0 NO_COMPU_METHOD 11 -32768 32767 /end AXIS_PTS
/begin MEASUREMENT TorqueFF "" SWORD TenthFP 0 0 -32768 32767 ECU_ADDRESS 0x200064FE PHYS_UNIT "%" /end MEASUREMENT
/begin MEASUREMENT can1OverrideTimeoutCtr "" UWORD NO_COMPU_METHOD 0 0 0 65535 ECU_ADDRESS 0x2000002C /end MEASUREMENT
/begin CHARACTERISTIC canEEC1TimeoutLen "" VALUE 0x7C2A4 __ULong_Value 0 NO_COMPU_METHOD 0 4294967295 /end CHARACTERISTIC
/begin CHARACTERISTIC canEFLP1TimeoutLen "" VALUE 0x7C2AC __ULong_Value 0 NO_COMPU_METHOD 0 4294967295 /end CHARACTERISTIC
/begin CHARACTERISTIC canET1TimeoutLen "" VALUE 0x7C2B0 __ULong_Value 0 NO_COMPU_METHOD 0 4294967295 /end CHARACTERISTIC
/begin CHARACTERISTIC canVEP1TimeoutLen "" VALUE 0x7C2A8 __ULong_Value 0 NO_COMPU_METHOD 0 4294967295 /end CHARACTERISTIC
/begin MEASUREMENT cm350PIDstate "" UBYTE cm350PIDstate_t 0 0 0 255 ECU_ADDRESS 0x20000727 /end MEASUREMENT
/begin MEASUREMENT cm350PowerUpState "" UBYTE cm350PowerUpState_t 0 0 0 255 ECU_ADDRESS 0x20000726 /end MEASUREMENT
/begin MEASUREMENT cm350SaturationState "" UBYTE cm350SaturationState_t_Copy1 0 0 0 255 ECU_ADDRESS 0x20000725 /end MEASUREMENT
/begin MEASUREMENT cm350State "" UBYTE cm350State_t 0 0 0 255 ECU_ADDRESS 0x20000724 /end MEASUREMENT
/begin MEASUREMENT cmdBattleMode "" UBYTE NO_COMPU_METHOD 0 0 0 255 ECU_ADDRESS 0x200064B6 /end MEASUREMENT
/begin MEASUREMENT cmdCurrentOutputDisable "" UBYTE binaryState_t 0 0 0 255 ECU_ADDRESS 0x200064EF /end MEASUREMENT
/begin MEASUREMENT cmdCurrentOutputDisableXCP "" UBYTE binaryState_t 0 0 0 255 ECU_ADDRESS 0x200000E9 READ_WRITE /end MEASUREMENT
/begin MEASUREMENT cmdEngineSpeedCommand "" UWORD SAERPM.Conversion 0 0 0 65535 ECU_ADDRESS 0x200064B8 PHYS_UNIT "RPM" /end MEASUREMENT
/begin MEASUREMENT cmdStartStop "" UBYTE cmdOpMode_t 0 0 0 255 ECU_ADDRESS 0x200064BA /end MEASUREMENT
/begin MEASUREMENT cmdStartStopXCP "" UBYTE cmdOpMode_t 0 0 0 255 ECU_ADDRESS 0x200000EA READ_WRITE /end MEASUREMENT
/begin MEASUREMENT cmdTargetCurrent "" UWORD TenthFP 0 0 0 65535 ECU_ADDRESS 0x200064BC PHYS_UNIT "A" /end MEASUREMENT
/begin MEASUREMENT cmdTargetCurrentXCP "" UWORD NO_COMPU_METHOD 0 0 0 65535 ECU_ADDRESS 0x200000EC READ_WRITE /end MEASUREMENT
/begin CHARACTERISTIC crankingPauseTime "" VALUE 0x7C27A __SWord_Value 0 NO_COMPU_METHOD -32768 32767 /end CHARACTERISTIC
/begin CHARACTERISTIC crankingRetries "" VALUE 0x7C27C __SWord_Value 0 NO_COMPU_METHOD -32768 32767 /end CHARACTERISTIC
/begin CHARACTERISTIC crankingTime "" VALUE 0x7C278 __SWord_Value 0 NO_COMPU_METHOD -32768 32767 /end CHARACTERISTIC
/begin MEASUREMENT crankingTry "" UWORD NO_COMPU_METHOD 0 0 0 65535 ECU_ADDRESS 0x200000D2 /end MEASUREMENT
/begin MEASUREMENT currentSetPointRampRate "" SLONG currentSetPointRampRate.Conversion 0 0 0 10000 ECU_ADDRESS 0x1FFF8404 PHYS_UNIT "A/s" READ_WRITE /end MEASUREMENT
/begin MEASUREMENT currentSetpoint "" UWORD TenthFP 0 0 0 65535 ECU_ADDRESS 0x200064F2 PHYS_UNIT "A" /end MEASUREMENT
/begin CHARACTERISTIC ecuDM1TimeoutLen "" VALUE 0x7C2A0 __ULong_Value 0 NO_COMPU_METHOD 0 4294967295 /end CHARACTERISTIC
/begin MEASUREMENT ecuVoltage "" UWORD ecuVoltage.Conversion 0 0 0 65535 ECU_ADDRESS 0x2000642E PHYS_UNIT "V" /end MEASUREMENT
/begin CHARACTERISTIC engProtectECUTimeoutLen "" VALUE 0x7C290 __ULong_Value 0 NO_COMPU_METHOD 0 4294967295 /end CHARACTERISTIC
/begin MEASUREMENT engProtectionSystemECU "" UBYTE engProtectionSystemECU.Conversion 0 0 0 255 ECU_ADDRESS 0x20006429 /end MEASUREMENT
/begin MEASUREMENT engStarterMode "" UWORD NO_COMPU_METHOD 0 0 0 65535 ECU_ADDRESS 0x2000642C /end MEASUREMENT
/begin MEASUREMENT engWaitToStart "" UBYTE NO_COMPU_METHOD 0 0 0 255 ECU_ADDRESS 0x20006428 /end MEASUREMENT
/begin MEASUREMENT engineRunHours "" ULONG engineRunHours.Conversion 0 0 0 4294967295 ECU_ADDRESS 0x200064C4 PHYS_UNIT "hr" /end MEASUREMENT
/begin MEASUREMENT errorPiLoop "" SLONG NO_COMPU_METHOD 0 0 -2147483648 2147483647 ECU_ADDRESS 0x2000003C /end MEASUREMENT
/begin MEASUREMENT faultCode "" UWORD NO_COMPU_METHOD 0 0 0 65535 ECU_ADDRESS 0x20006426 /end MEASUREMENT
/begin MEASUREMENT faultCount "" UWORD NO_COMPU_METHOD 0 0 0 65535 ECU_ADDRESS 0x20006424 /end MEASUREMENT
/begin MEASUREMENT faultsEngine "" ULONG NO_COMPU_METHOD 0 0 0 255 ECU_ADDRESS 0x200064C0 /end MEASUREMENT
/begin MEASUREMENT faultsPresent "" UWORD NO_COMPU_METHOD 0 0 0 65535 ECU_ADDRESS 0x200064BE /end MEASUREMENT
/begin MEASUREMENT fuelRate "" UWORD fuelRate.Conversion 0 0 0 65535 ECU_ADDRESS 0x200064C8 PHYS_UNIT "L/hr" /end MEASUREMENT
/begin CHARACTERISTIC highCoolTempTimeoutLen "" VALUE 0x7C298 __ULong_Value 0 NO_COMPU_METHOD 0 4294967295 /end CHARACTERISTIC
/begin CHARACTERISTIC highCoolantTempThreshold "" VALUE 0x7C288 __SWord_Value 0 NO_COMPU_METHOD -32768 32767 /end CHARACTERISTIC
/begin CHARACTERISTIC highOilTempThreshold "" VALUE 0x7C286 __SWord_Value 0 NO_COMPU_METHOD -32768 32767 /end CHARACTERISTIC
/begin CHARACTERISTIC highOilTempTimeoutLen "" VALUE 0x7C29C __ULong_Value 0 NO_COMPU_METHOD 0 4294967295 /end CHARACTERISTIC
/begin MEASUREMENT inputEstop "" UBYTE binaryState_t 0 0 0 255 ECU_ADDRESS 0x200064D8 /end MEASUREMENT
/begin MEASUREMENT invActiveDischargeState "" UBYTE dischargeState_t 0 0 0 255 ECU_ADDRESS 0x20006492 /end MEASUREMENT
/begin MEASUREMENT invCmdDirection "" UBYTE invDirectionCommand.Conversion 0 0 0 255 ECU_ADDRESS 0x200064B0 /end MEASUREMENT
/begin MEASUREMENT invCmdInverterDischarge "" UBYTE NO_COMPU_METHOD 0 0 0 255 ECU_ADDRESS 0x200064B2 /end MEASUREMENT
/begin MEASUREMENT invCmdInverterEnable "" UBYTE NO_COMPU_METHOD 0 0 0 255 ECU_ADDRESS 0x200064B1 /end MEASUREMENT
/begin MEASUREMENT invCmdSpeed "" SWORD NO_COMPU_METHOD 0 0 -32768 32767 ECU_ADDRESS 0x200064AE PHYS_UNIT "RPM" /end MEASUREMENT
/begin MEASUREMENT invCmdSpeedModeEnable "" UBYTE NO_COMPU_METHOD 0 0 0 255 ECU_ADDRESS 0x200064B3 /end MEASUREMENT
/begin MEASUREMENT invCmdTorque "" SWORD invCmdTorque.Conversion 0 0 -32768 32767 ECU_ADDRESS 0x200064AC PHYS_UNIT "Nm" /end MEASUREMENT
/begin MEASUREMENT invCmdTorqueLimit "" SWORD TenthFP 0 0 -32768 32767 ECU_ADDRESS 0x200064B4 PHYS_UNIT "Nm" /end MEASUREMENT
/begin CHARACTERISTIC invCrankingDirection "" VALUE 0x7C2FC __SLong_Value 0 invDirectionCommand.Conversion -2147483648 2147483647 /end CHARACTERISTIC
/begin CHARACTERISTIC invCrankingSpeed "" VALUE 0x7C2F4 __SLong_Value 0 NO_COMPU_METHOD -6000 6000 PHYS_UNIT "RPM" /end CHARACTERISTIC
/begin CHARACTERISTIC invCrankingTorque "" VALUE 0x7C2F8 __SLong_Value 0 TenthFP -650 650 PHYS_UNIT "Nm" /end CHARACTERISTIC
/begin AXIS_PTS invCurrentFF "" 0x7C2D4 NO_INPUT_QUANTITY __UWord_Axis 0 TenthFP 11 0 65535 PHYS_UNIT "A" /end AXIS_PTS
/begin MEASUREMENT invDcBusCurrent "" SWORD TenthFP 0 0 -32768 32767 ECU_ADDRESS 0x20006476 PHYS_UNIT "A" /end MEASUREMENT
/begin MEASUREMENT invDcBusCurrentAvg "" SLONG TenthFP 0 0 -2147483648 2147483647 ECU_ADDRESS 0x200064E0 PHYS_UNIT "A" /end MEASUREMENT
/begin MEASUREMENT invDcBusVoltage "" SWORD TenthFP 0 0 -32768 32767 ECU_ADDRESS 0x20006478 PHYS_UNIT "V" /end MEASUREMENT
/begin CHARACTERISTIC invDcCurrentAvgTC "" VALUE 0x7C2EC __UWord_Value 0 NO_COMPU_METHOD 0 65535 /end CHARACTERISTIC
/begin CHARACTERISTIC invDirection "" VALUE 0x7C300 __SLong_Value 0 invDirectionCommand.Conversion -2147483648 2147483647 /end CHARACTERISTIC
/begin MEASUREMENT invDirectionCommand "" UBYTE invDirectionCommand.Conversion 0 0 0 255 ECU_ADDRESS 0x20006499 /end MEASUREMENT
/begin MEASUREMENT invEnableLockout "" UBYTE NO_COMPU_METHOD 0 0 0 255 ECU_ADDRESS 0x20006498 /end MEASUREMENT
/begin MEASUREMENT invEnableState "" UBYTE NO_COMPU_METHOD 0 0 0 255 ECU_ADDRESS 0x20006495 /end MEASUREMENT
/begin MEASUREMENT invFaultCodes "" ULONG NO_COMPU_METHOD 0 0 0 4294967295 ECU_ADDRESS 0x200064A4 MATRIX_DIM 2 /end MEASUREMENT
/begin CHARACTERISTIC invIntegMaxError "" VALUE 0x7C364 __SLong_Value 0 TenthFP -2147483648 2147483647 /end CHARACTERISTIC
/begin MEASUREMENT invInverterState "" UBYTE invState_t 0 0 0 255 ECU_ADDRESS 0x2000648C /end MEASUREMENT
/begin MEASUREMENT invMotorSpeed "" SWORD invMotorSpeed.Conversion 0 0 -32768 32767 ECU_ADDRESS 0x2000646A PHYS_UNIT "RPM" /end MEASUREMENT
/begin MEASUREMENT invOutputVoltage "" SWORD TenthFP 0 0 -32768 32767 ECU_ADDRESS 0x2000647A PHYS_UNIT "V" /end MEASUREMENT
/begin MEASUREMENT invPhaseCurrentA "" SWORD TenthFP 0 0 -32768 32767 ECU_ADDRESS 0x20006470 PHYS_UNIT "A" /end MEASUREMENT
/begin MEASUREMENT invPhaseCurrentB "" SWORD TenthFP 0 0 -32768 32767 ECU_ADDRESS 0x20006472 PHYS_UNIT "A" /end MEASUREMENT
/begin MEASUREMENT invPhaseCurrentC "" SWORD TenthFP 0 0 -32768 32767 ECU_ADDRESS 0x20006474 PHYS_UNIT "A" /end MEASUREMENT
/begin MEASUREMENT invPowerUp "" UBYTE NO_COMPU_METHOD 0 0 0 255 ECU_ADDRESS 0x200000DA /end MEASUREMENT
/begin MEASUREMENT invRunMode "" UBYTE NO_COMPU_METHOD 0 0 0 255 ECU_ADDRESS 0x20006490 /end MEASUREMENT
/begin MEASUREMENT invSpeedCmdXCP "" SWORD invSpeedCmdXCP.Conversion 0 0 -32768 32767 ECU_ADDRESS 0x1FFF840E READ_WRITE /end MEASUREMENT
/begin MEASUREMENT invTemp1_GateDriver "" SWORD TenthFP 0 0 -32768 32767 ECU_ADDRESS 0x20006448 PHYS_UNIT "deg C" /end MEASUREMENT
/begin MEASUREMENT invTemp1_ModuleA "" SWORD TenthFP 0 0 -32768 32767 ECU_ADDRESS 0x20006442 PHYS_UNIT "deg C" /end MEASUREMENT
/begin MEASUREMENT invTemp1_ModuleB "" SWORD TenthFP 0 0 -32768 32767 ECU_ADDRESS 0x20006444 PHYS_UNIT "deg C" /end MEASUREMENT
/begin MEASUREMENT invTemp1_ModuleC "" SWORD TenthFP 0 0 -32768 32767 ECU_ADDRESS 0x20006446 PHYS_UNIT "deg C" /end MEASUREMENT
/begin MEASUREMENT invTemp2_CtrlBoard "" SWORD TenthFP 0 0 -32768 32767 ECU_ADDRESS 0x2000644A PHYS_UNIT "deg C" /end MEASUREMENT
/begin MEASUREMENT invTemp3_CoolantTemp "" SWORD TenthFP 0 0 -32768 32767 ECU_ADDRESS 0x20006452 PHYS_UNIT "deg C" /end MEASUREMENT
/begin MEASUREMENT invTemp3_HotSpotTemp "" SWORD TenthFP 0 0 -32768 32767 ECU_ADDRESS 0x20006454 PHYS_UNIT "deg C" /end MEASUREMENT
/begin MEASUREMENT invTemp3_MotorTemp "" SWORD TenthFP 0 0 -32768 32767 ECU_ADDRESS 0x20006456 PHYS_UNIT "deg C" /end MEASUREMENT
/begin CHARACTERISTIC invTorqueFF "" CURVE 0x7C2BC __UWord_Value 0 TenthFP 0 65535
 /begin AXIS_DESCR COM_AXIS NO_INPUT_QUANTITY NO_COMPU_METHOD 11 0 0 AXIS_PTS_REF invCurrentFF /end AXIS_DESCR
 PHYS_UNIT "Nm" /end CHARACTERISTIC
/begin MEASUREMENT invTorqueLimit "" SLONG TenthFP 0 0 -2147483648 2147483647 ECU_ADDRESS 0x200064E8 PHYS_UNIT "Nm" /end MEASUREMENT
/begin CHARACTERISTIC invTorqueLimitMax "" VALUE 0x7C2F0 __SLong_Value 0 TenthFP -2147483648 2147483647 PHYS_UNIT "Nm" /end CHARACTERISTIC
/begin MEASUREMENT invTorqueLimitTarget "" SLONG TenthFP 0 0 -2147483648 2147483647 ECU_ADDRESS 0x200064E4 PHYS_UNIT "Nm" /end MEASUREMENT
/begin CHARACTERISTIC invTorqueStepDown "" VALUE 0x7C2EA __SWord_Value 0 HundredThousandthFP.Conversion -32768 32767 PHYS_UNIT "Nm" /end CHARACTERISTIC
/begin MEASUREMENT invVsmState "" UBYTE vsmState_t 0 0 0 255 ECU_ADDRESS 0x20006488 /end MEASUREMENT
/begin MEASUREMENT invVsmStateTimer "" ULONG NO_COMPU_METHOD 0 0 0 4294967295 ECU_ADDRESS 0x20000028 /end MEASUREMENT
/begin CHARACTERISTIC lowECUVoltageThreshold "" VALUE 0x7C280 __SLong_Value 0 NO_COMPU_METHOD -2147483648 2147483647 /end CHARACTERISTIC
/begin CHARACTERISTIC lowOilPresTimeoutLen "" VALUE 0x7C294 __ULong_Value 0 NO_COMPU_METHOD 0 4294967295 /end CHARACTERISTIC
/begin CHARACTERISTIC lowOilPressureThreshold "" VALUE 0x7C284 __SWord_Value 0 NO_COMPU_METHOD -32768 32767 /end CHARACTERISTIC
/begin MEASUREMENT oilPressure "" UBYTE oilPressure.Conversion 0 0 0 1000 ECU_ADDRESS 0x20006430 /end MEASUREMENT
/begin MEASUREMENT oilTemp "" UWORD oilTemp.Conversion 0 0 -273 1734.96 ECU_ADDRESS 0x20006432 /end MEASUREMENT
/begin MEASUREMENT opMode "" UBYTE opModes_t_Copy2 0 0 0 255 ECU_ADDRESS 0x2000641D /end MEASUREMENT
/begin MEASUREMENT outputEcuPower "" UBYTE binaryState_t 0 0 0 255 ECU_ADDRESS 0x200064D4 /end MEASUREMENT
/begin MEASUREMENT outputFuelLiftPump "" UBYTE binaryState_t 0 0 0 255 ECU_ADDRESS 0x200064D6 /end MEASUREMENT
/begin MEASUREMENT outputKL15 "" UBYTE binaryState_t 0 0 0 255 ECU_ADDRESS 0x200064D5 /end MEASUREMENT
/begin MEASUREMENT outputStarter "" UBYTE binaryState_t 0 0 0 255 ECU_ADDRESS 0x200064D7 /end MEASUREMENT
/begin MEASUREMENT runTimer "" ULONG NO_COMPU_METHOD 0 0 0 4294967295 ECU_ADDRESS 0x200000DC /end MEASUREMENT
/begin MEASUREMENT starterSource "" UBYTE starterSource_t 0 0 0 255 ECU_ADDRESS 0x200064EE /end MEASUREMENT
/begin MEASUREMENT torqueLimit "" SLONG TenthFP 0 0 -2147483648 2147483647 ECU_ADDRESS 0x20000720 PHYS_UNIT "Nm" /end MEASUREMENT
/begin CHARACTERISTIC voltageFaultTimeoutLen "" VALUE 0x7C28C __ULong_Value 0 NO_COMPU_METHOD 0 4294967295 /end CHARACTERISTIC
/begin COMPU_METHOD CHT1_High.Conversion "" TAB_VERB "%6.3" "" COMPU_TAB_REF CHT1_High.Conversion.Table /end COMPU_METHOD
/begin COMPU_METHOD CanIdSensor2.Conversion "" IDENTICAL "%6.3" "" /end COMPU_METHOD
/begin COMPU_METHOD ClosedLoopEgtOperation.Conversion "" TAB_VERB "%6.3" "" COMPU_TAB_REF ClosedLoopEgtOperation.Conversion.Table /end COMPU_METHOD
/begin COMPU_METHOD Crank.Conversion "" TAB_VERB "%6.3" "" COMPU_TAB_REF Crank.Conversion.Table /end COMPU_METHOD
/begin COMPU_METHOD CrankState.Conversion "" TAB_VERB "%6.3" "" COMPU_TAB_REF CrankState.Conversion.Table /end COMPU_METHOD
/begin COMPU_METHOD DerateOverride.Conversion "" TAB_VERB "%6.3" "" COMPU_TAB_REF DerateOverride.Conversion.Table /end COMPU_METHOD
/begin COMPU_METHOD EGT.Conversion "" LINEAR "%6.3" "" COEFFS_LINEAR 0.25 0 /end COMPU_METHOD
/begin COMPU_METHOD EgtState "enumeration table" TAB_VERB "%.0" "" COMPU_TAB_REF EgtState /end COMPU_METHOD
/begin COMPU_METHOD EgtState.OLD_Copy1 "" TAB_VERB "%6.3" "" COMPU_TAB_REF EgtState.OLD_1 /end COMPU_METHOD
/begin COMPU_METHOD EngineRotation.CONVERSION "enumeration table" TAB_VERB "%.0" "" COMPU_TAB_REF EngineRotation.CONVERSION /end COMPU_METHOD
/begin COMPU_METHOD EngineSpeedTarget.Conversion "" IDENTICAL "%6.3" "" /end COMPU_METHOD
/begin COMPU_METHOD EngineSpeedTargetScale.Conversion "" LINEAR "%6.3" "" COEFFS_LINEAR 2 0 /end COMPU_METHOD
/begin COMPU_METHOD EngineStateCmd.CONVERSION "enumeration table" TAB_VERB "%.0" "" COMPU_TAB_REF EngineStateCmd.CONVERSION /end COMPU_METHOD
/begin COMPU_METHOD EngineStateCmd.Conversion "" TAB_VERB "%6.3" "" COMPU_TAB_REF EngineStateCmd.Conversion.Table /end COMPU_METHOD
/begin COMPU_METHOD EngineStateCmdXcp.CONVERSION "enumeration table" TAB_VERB "%.0" "" COMPU_TAB_REF EngineStateCmdXcp.CONVERSION /end COMPU_METHOD
/begin COMPU_METHOD EngineTorque.Conversion "" LINEAR "%6.3" "" COEFFS_LINEAR 1 -125 /end COMPU_METHOD
/begin COMPU_METHOD EngineTorqueMax.Conversion "" LINEAR "%6.3" "" COEFFS_LINEAR 0.4 0 /end COMPU_METHOD
/begin COMPU_METHOD Engine_Boost_Pressure.Conversion "" LINEAR "%6.3" "" COEFFS_LINEAR 2 0 /end COMPU_METHOD
/begin COMPU_METHOD Engine_CAC_Outlet_Temp.Conversion "" LINEAR "%6.3" "" COEFFS_LINEAR 1 -40 /end COMPU_METHOD
/begin COMPU_METHOD Enrichment.Conversion "" LINEAR "%6.3" "" COEFFS_LINEAR 0.1 -100 /end COMPU_METHOD
/begin COMPU_METHOD Errors.Conversion "" TAB_VERB "%6.3" "" COMPU_TAB_REF Errors.Conversion.Table /end COMPU_METHOD
/begin COMPU_METHOD FuelMapType.Conversion "" TAB_VERB "%6.3" "" COMPU_TAB_REF FuelMapType.Conversion.Table /end COMPU_METHOD
/begin COMPU_METHOD GovMode.Conversion "" TAB_VERB "%6.3" "" COMPU_TAB_REF GovMode.Conversion.Table /end COMPU_METHOD
/begin COMPU_METHOD HundredThousandthFP.Conversion "" LINEAR "%6.3" "" COEFFS_LINEAR 1E-06 0 /end COMPU_METHOD
/begin COMPU_METHOD HundredthFP "" LINEAR "%6.3" "" COEFFS_LINEAR 0.01 0 /end COMPU_METHOD
/begin COMPU_METHOD MapCrank.Conversion "" LINEAR "%6.3" "" COEFFS_LINEAR 0.271 105 /end COMPU_METHOD
/begin COMPU_METHOD OpMode.Conversion "" TAB_VERB "%6.3" "" COMPU_TAB_REF OpMode.Conversion.Table /end COMPU_METHOD
/begin COMPU_METHOD SAERPM.Conversion "" LINEAR "%6.3" "" COEFFS_LINEAR 0.125 0 /end COMPU_METHOD
/begin COMPU_METHOD ShutdownXCP.Conversion "" TAB_VERB "%6.3" "" COMPU_TAB_REF ShutdownXCP.Conversion.Table /end COMPU_METHOD
/begin COMPU_METHOD SparkCutGov.Conversion "" LINEAR "%6.3" "" COEFFS_LINEAR -1 0 /end COMPU_METHOD
/begin COMPU_METHOD SparkTiming.Conversion "" LINEAR "%6.3" "deg" COEFFS_LINEAR -0.1 0 /end COMPU_METHOD
/begin COMPU_METHOD SpiState "enumeration table" TAB_VERB "%.0" "" COMPU_TAB_REF SpiState /end COMPU_METHOD
/begin COMPU_METHOD SpiState.OLD_Copy1 "" TAB_VERB "%6.3" "" COMPU_TAB_REF SpiState.OLD_1 /end COMPU_METHOD
/begin COMPU_METHOD SpiState.OLD_Copy2 "enumeration table" TAB_VERB "%.0" "" COMPU_TAB_REF SpiState.OLD_2 /end COMPU_METHOD
/begin COMPU_METHOD Table_0 "" TAB_VERB "%6.3" "" COMPU_TAB_REF Table_0 /end COMPU_METHOD
/begin COMPU_METHOD Table_1 "" TAB_VERB "%6.3" "" COMPU_TAB_REF Table_1 /end COMPU_METHOD
/begin COMPU_METHOD Temperature "" LINEAR "%3.1" "degC" COEFFS_LINEAR 0.1 0 /end COMPU_METHOD
/begin COMPU_METHOD TenThousandth "" LINEAR "%6.3" "" COEFFS_LINEAR 0.0001 0 /end COMPU_METHOD
/begin COMPU_METHOD TenthFP "" LINEAR "%6.3" "" COEFFS_LINEAR 0.1 0 /end COMPU_METHOD
/begin COMPU_METHOD ThousandthFP "" LINEAR "%6.3" "" COEFFS_LINEAR 0.001 0 /end COMPU_METHOD
/begin COMPU_METHOD TorqInteg.Conversion "" LINEAR "%6.3" "" COEFFS_LINEAR 1E-05 0 /end COMPU_METHOD
/begin COMPU_METHOD TorqProp.Conversion "" LINEAR "%6.3" "" COEFFS_LINEAR 1E-05 0 /end COMPU_METHOD
/begin COMPU_METHOD TriggerFaultSource.CONVERSION "enumeration table" TAB_VERB "%.0" "" COMPU_TAB_REF TriggerFaultSource.CONVERSION /end COMPU_METHOD
/begin COMPU_METHOD Volt_ATD "Converts ATD in ECU to voltage" LINEAR "%6.3" "V/5V_12bit_ATD" COEFFS_LINEAR 1.221 0 /end COMPU_METHOD
/begin COMPU_METHOD Wdog_state.Conversion "" TAB_VERB "%6.3" "" COMPU_TAB_REF Wdog_state.Conversion.Table /end COMPU_METHOD
/begin COMPU_METHOD binaryState_t "" TAB_VERB "%.0" "" COMPU_TAB_REF binaryState_t /end COMPU_METHOD
/begin COMPU_METHOD cm350PIDstate_t "" TAB_VERB "%.0" "" COMPU_TAB_REF cm350PIDstate_t /end COMPU_METHOD
/begin COMPU_METHOD cm350PowerUpState_t "" TAB_VERB "%.0" "" COMPU_TAB_REF cm350PowerUpState_t /end COMPU_METHOD
/begin COMPU_METHOD cm350SaturationState_t "" TAB_VERB "%.0" "" COMPU_TAB_REF cm350SaturationState_t /end COMPU_METHOD
/begin COMPU_METHOD cm350SaturationState_t_Copy1 "enumeration table" TAB_VERB "%.0" "" COMPU_TAB_REF cm350SaturationState_t_Copy1 /end COMPU_METHOD
/begin COMPU_METHOD cm350ShutdownState_t "" TAB_VERB "%.0" "" COMPU_TAB_REF cm350ShutdownState_t /end COMPU_METHOD
/begin COMPU_METHOD cm350State_t "" TAB_VERB "%.0" "" COMPU_TAB_REF cm350State_t /end COMPU_METHOD
/begin COMPU_METHOD cmdOpMode_t "" TAB_VERB "%.0" "" COMPU_TAB_REF cmdOpMode_t /end COMPU_METHOD
/begin COMPU_METHOD coolantTemp.Conversion "" LINEAR "%6.3" "" COEFFS_LINEAR 1 -40 /end COMPU_METHOD
/begin COMPU_METHOD currentSetPointRampRate.Conversion "" LINEAR "%6.3" "" COEFFS_LINEAR 10 0 /end COMPU_METHOD
/begin COMPU_METHOD dischargeState_t "" TAB_VERB "%.0" "" COMPU_TAB_REF dischargeState_t /end COMPU_METHOD
/begin COMPU_METHOD ecuVoltage.Conversion "" LINEAR "%6.3" "" COEFFS_LINEAR 0.005 0 /end COMPU_METHOD
/begin COMPU_METHOD engProtectionSystemECU.Conversion "" TAB_VERB "%6.3" "" COMPU_TAB_REF engProtectionSystemECU.Conversion.Table /end COMPU_METHOD
/begin COMPU_METHOD engineRunHours.Conversion "" LINEAR "%6.3" "" COEFFS_LINEAR 0.05 0 /end COMPU_METHOD
/begin COMPU_METHOD fuelRate.Conversion "" LINEAR "%6.3" "" COEFFS_LINEAR 0.05 0 /end COMPU_METHOD
/begin COMPU_METHOD invCmdTorque.Conversion "" LINEAR "%6.3" "" COEFFS_LINEAR -0.1 0 /end COMPU_METHOD
/begin COMPU_METHOD invDirection.Conversion "" TAB_VERB "%6.3" "" COMPU_TAB_REF invCrankingDirection.Conversion.Table /end COMPU_METHOD
/begin COMPU_METHOD invDirectionCommand.Conversion "" TAB_VERB "%6.3" "" COMPU_TAB_REF invDirectionCommand.Conversion.Table /end COMPU_METHOD
/begin COMPU_METHOD invMotorSpeed.Conversion "" LINEAR "%6.3" "" COEFFS_LINEAR -1 0 /end COMPU_METHOD
/begin COMPU_METHOD invSpeedCmdXCP.Conversion "" LINEAR "%6.3" "" COEFFS_LINEAR -1 0 /end COMPU_METHOD
/begin COMPU_METHOD invState_t "" TAB_VERB "%.0" "" COMPU_TAB_REF invState_t /end COMPU_METHOD
/begin COMPU_METHOD invTemp1_GateDriver.Conversion "" IDENTICAL "%6.3" "" /end COMPU_METHOD
/begin COMPU_METHOD oilPressure.Conversion "" LINEAR "%6.3" "kPa" COEFFS_LINEAR 4 0 /end COMPU_METHOD
/begin COMPU_METHOD oilTemp.Conversion "" LINEAR "%6.3" "C" COEFFS_LINEAR 0.03125 -273 /end COMPU_METHOD
/begin COMPU_METHOD opModes_t "" TAB_VERB "%.0" "" COMPU_TAB_REF opModes_t /end COMPU_METHOD
/begin COMPU_METHOD opModes_t_Copy1 "enumeration table" TAB_VERB "%.0" "" COMPU_TAB_REF opModes_t_Copy1 /end COMPU_METHOD
/begin COMPU_METHOD opModes_t_Copy2 "" TAB_VERB "%.0" "" COMPU_TAB_REF opModes_t_Copy2 /end COMPU_METHOD
/begin COMPU_METHOD opModes_t_Copy3 "enumeration table" TAB_VERB "%.0" "" COMPU_TAB_REF opModes_t_Copy3 /end COMPU_METHOD
/begin COMPU_METHOD starterSource_t "" TAB_VERB "%.0" "" COMPU_TAB_REF starterSource_t /end COMPU_METHOD
/begin COMPU_METHOD vsmState_t "" TAB_VERB "%.0" "" COMPU_TAB_REF vsmState_t /end COMPU_METHOD
/begin COMPU_VTAB CHT1_High.Conversion.Table "" TAB_VERB 2 0 "OK" 1 "Faulty" DEFAULT_VALUE "" /end COMPU_VTAB
/begin COMPU_VTAB ClosedLoopEgtOperation.Conversion.Table "" TAB_VERB 2 0 "Open Loop" 1 "Closed Loop" DEFAULT_VALUE "" /end COMPU_VTAB
/begin COMPU_VTAB Crank.Conversion.Table "" TAB_VERB 2 0 "1 - Primary" 1 "2 - Secondary" DEFAULT_VALUE "" /end COMPU_VTAB
/begin COMPU_VTAB CrankState.Conversion.Table "" TAB_VERB 7 0 "Tooth Init" 1 "First Edge" 2 "Testing for gap" 3 "Validating gap" 4 "First Revolution" 5 "Synchronizing" 6 "Synchronizing 4C" DEFAULT_VALUE "" /end COMPU_VTAB
/begin COMPU_VTAB DerateOverride.Conversion.Table "" TAB_VERB 2 0 "Off" 1 "Active" DEFAULT_VALUE "" /end COMPU_VTAB
/begin COMPU_VTAB_RANGE EgtState "" 5 0 0 "EgtState_Uninitialized" 1 1 "EgtState_Ready" 2 2 "EgtState_ReadingEgtOne" 3 3 "EgtState_ReadEgtTwo" 4 4 "EgtState_ReadingEgtTwo" DEFAULT_VALUE "" /end COMPU_VTAB_RANGE
/begin COMPU_VTAB EgtState.OLD_1 "" TAB_VERB 5 0 "EgtState_Uninitialized" 1 "EgtState_Ready" 2 "EgtState_ReadingEgtOne" 3 "EgtState_ReadEgtTwo" 4 "EgtState_ReadingEgtTwo" DEFAULT_VALUE "" /end COMPU_VTAB
/begin COMPU_VTAB_RANGE EngineRotation.CONVERSION "" 2 0 0 "RotationType_Standard" 1 1 "RotationType_Counter" DEFAULT_VALUE "" /end COMPU_VTAB_RANGE
/begin COMPU_VTAB_RANGE EngineStateCmd.CONVERSION "" 3 0 0 "EngineCmd_Off" 1 1 "EngineCmd_Run" 2 2 "EngineCmd_Auto" DEFAULT_VALUE "" /end COMPU_VTAB_RANGE
/begin COMPU_VTAB EngineStateCmd.Conversion.Table "" TAB_VERB 2 0 "Off" 1 "Run" DEFAULT_VALUE "" /end COMPU_VTAB
/begin COMPU_VTAB_RANGE EngineStateCmdXcp.CONVERSION "" 7 0 0 "ENGINESTATE_OFF" 1 1 "ENGINESTATE_PREHEAT" 2 2 "ENGINESTATE_START" 3 3 "ENGINESTATE_STABILIZE" 4 4 "ENGINESTATE_BIT" 5 5 "ENGINESTATE_RUN" 6 6 "ENGINESTATE_SHUTDOWN" DEFAULT_VALUE "" /end COMPU_VTAB_RANGE
/begin COMPU_VTAB Errors.Conversion.Table "" TAB_VERB 2 0 "OK" 1 "Fault" DEFAULT_VALUE "" /end COMPU_VTAB
/begin COMPU_VTAB FuelMapType.Conversion.Table "" TAB_VERB 3 0 "Auto" 1 "Throttle Position" 2 "Manifold Pressure" DEFAULT_VALUE "" /end COMPU_VTAB
/begin COMPU_VTAB GovMode.Conversion.Table "" TAB_VERB 3 0 "Idle" 1 "Run" 2 "RevLimit" DEFAULT_VALUE "" /end COMPU_VTAB
/begin COMPU_VTAB OpMode.Conversion.Table "" TAB_VERB 10 0 "Standby" 1 "AutoPrime" 2 "Overspeed" 3 "Shutdown" 4 "Crankfail" 5 "Preheat" 6 "Run Up" 7 "Run Open Loop" 8 "Run Closed Loop" 9 "Cranking" DEFAULT_VALUE "" /end COMPU_VTAB
/begin COMPU_VTAB ShutdownXCP.Conversion.Table "" TAB_VERB 2 0 "Off" 1 "On" DEFAULT_VALUE "" /end COMPU_VTAB
/begin COMPU_VTAB_RANGE SpiState "" 4 0 0 "SpiState_Uninitialized" 1 1 "SpiState_Ready" 2 2 "SpiState_TxRx_Byte_0" 3 3 "SpiState_TxRx_Byte_1" DEFAULT_VALUE "" /end COMPU_VTAB_RANGE
/begin COMPU_VTAB SpiState.OLD_1 "" TAB_VERB 6 0 "SpiState_Uninitialized" 1 "SpiState_Ready" 2 "SpiState_TxRx_Byte_0" 3 "SpiState_TxRx_Byte_1" 4 "SpiState_TxRx_Buf_Byte_0" 5 "SpiState_TxRx_Buf_Byte_1" DEFAULT_VALUE "" /end COMPU_VTAB
/begin COMPU_VTAB_RANGE SpiState.OLD_2 "" 6 0 0 "SpiState_Uninitialized" 1 1 "SpiState_Ready" 2 2 "SpiState_TxRx_Byte_0" 3 3 "SpiState_TxRx_Byte_1" 4 4 "SpiState_TxRx_Buf_Byte_0" 5 5 "SpiState_TxRx_Buf_Byte_1" DEFAULT_VALUE "" /end COMPU_VTAB_RANGE
/begin COMPU_VTAB Table_0 "" TAB_VERB 2 0 "RotationType_Standard" 1 "RotationType_Counter" DEFAULT_VALUE "" /end COMPU_VTAB
/begin COMPU_VTAB Table_1 "" TAB_VERB 5 0 "Clear" 1 "Reset" 2 "Interval_TooLong" 3 "Interval_TooShort" 4 "Interval_MissingTeeth" DEFAULT_VALUE "" /end COMPU_VTAB
/begin COMPU_VTAB_RANGE TriggerFaultSource.CONVERSION "" 5 0 0 "Clear" 1 1 "Reset" 2 2 "Interval_TooLong" 3 3 "Interval_TooShort" 4 4 "Interval_MissingTeeth" DEFAULT_VALUE "" /end COMPU_VTAB_RANGE
/begin COMPU_VTAB Wdog_state.Conversion.Table "" TAB_VERB 14 0 "Init" 1 "RunOp1" 2 "RunOp2" 3 "RunOp3" 4 "RunOp4" 5 "RunOp5" 6 "Standby" 7 "Autoprime" 8 "New_Inj" 9 "Sustained_Inj" 10 "Spark" 11 "FTM1" 12 "FTM0" 13 "Trig2" DEFAULT_VALUE "" /end COMPU_VTAB
/begin COMPU_VTAB binaryState_t "" TAB_VERB 2 0 "OFF" 1 "ON" /end COMPU_VTAB
/begin COMPU_VTAB cm350PIDstate_t "" TAB_VERB 5 0 "CM350_PID_INACTIVE" 1 "CM350_PID_STABILIZE" 2 "CM350_PID_ACTIVE" 3 "CM350_PID_UNDERSPEED_WATCH" 4 "CM350_PID_UNDERSPEED" /end COMPU_VTAB
/begin COMPU_VTAB cm350PowerUpState_t "" TAB_VERB 6 0 "CM350_PWRUP_STATE_INACTIVE" 1 "CM350_PWRUP_STATE_ESTOP_HIGH" 2 "CM350_PWRUP_STATE_VSM_WAIT" 3 "CM350_PWRUP_STATE_INVERTER_ENABLE_LOCKOUT" 4 "CM350_PWRUP_STATE_VSM_READY" 5 "CM350_PWRUP_STATE_TIMEOUT" /end COMPU_VTAB
/begin COMPU_VTAB cm350SaturationState_t "" TAB_VERB 2 0 "CM350_LINEAR_CONTROL" 1 "CM350_SATURATION_CONTROL" /end COMPU_VTAB
/begin COMPU_VTAB cm350SaturationState_t_Copy1 "enumeration table" TAB_VERB 3 0 "CM350_LINEAR_CONTROL" 1 "CM350_SATURATION_CONTROL" 2 "CM350_CURRENT_OFF" /end COMPU_VTAB
/begin COMPU_VTAB cm350ShutdownState_t "" TAB_VERB 6 0 "CM350_SHUTDOWN_INACTIVE" 1 "CM350_SHUTDOWN_UNDER_4K_RPM" 2 "CM350_SHUTDOWN_MOTOR_STOP" 3 "CM350_SHUTDOWN_DISCHARGE_ACTIVE" 4 "CM350_SHUTDOWN_DISCHARGE_COMPLETE" 5 "CM350_SHUTDOWN_DISCHARGE_TIMEOUT" /end COMPU_VTAB
/begin COMPU_VTAB cm350State_t "" TAB_VERB 5 0 "CM350_STATE_ACTIVE" 1 "CM350_STATE_DISABLED" 2 "CM350_STATE_POWERUP" 3 "CM350_STATE_DISCHARGE" 4 "CM350_STATE_FAULT" /end COMPU_VTAB
/begin COMPU_VTAB cmdOpMode_t "" TAB_VERB 3 0 "SYSOP_OFF" 1 "SYSOP_RUN" 2 "SYSOP_E_STOP" /end COMPU_VTAB
/begin COMPU_VTAB dischargeState_t "" TAB_VERB 8 0 "INVDISCHARGE_DISABLE" 1 "INVDISCHARGE_ENABLE" 2 "INVDISCHARGE_SPEED_CHECK" 3 "INVDISCHARGE_ACTIVE" 4 "INVDISCHARGE_COMPLETE" 5 "INVDISCHARGE_ERROR" 6 "INVDISCHARGE_OVERRIDE" 7 "INVDISCHARGE_TIMEOUT" /end COMPU_VTAB
/begin COMPU_VTAB engProtectionSystemECU.Conversion.Table "" TAB_VERB 4 0 "No" 1 "Yes" 2 "Error" 3 "Not available" /end COMPU_VTAB
/begin COMPU_VTAB invCrankingDirection.Conversion.Table "" TAB_VERB 2 0 "Reverse" 1 "Forward" /end COMPU_VTAB
/begin COMPU_VTAB invDirectionCommand.Conversion.Table "" TAB_VERB 2 0 "Clockwise = Reverse" 1 "Anticlockwise = Forward" /end COMPU_VTAB
/begin COMPU_VTAB invState_t "" TAB_VERB 13 0 "INVSTATE_POWER_UP" 1 "INVSTATE_STOP" 2 "INVSTATE_OPEN_LOOP" 3 "INVSTATE_CLOSED_LOOP" 4 "INVSTATE_INTERNAL" 5 "INVSTATE_INTERNAL1" 6 "INVSTATE_INTERNAL2" 7 "INVSTATE_INTERNAL3" 8 "INVSTATE_IDLE_RUN" 9 "INVSTATE_INDLE_STOP" 10 "INVSTATE_INTERNAL4" 11 "INVSTATE_INTERNAL5" 12 "INVSTATE_INTERNAL6" /end COMPU_VTAB
/begin COMPU_VTAB opModes_t "" TAB_VERB 6 0 "OP_FAULT" 1 "OP_POWER_UP" 2 "OP_STANDBY" 3 "OP_PRE_CRANKING" 4 "OP_CRANKING" 5 "OP_RUN" /end COMPU_VTAB
/begin COMPU_VTAB opModes_t_Copy1 "enumeration table" TAB_VERB 7 0 "OP_FAULT" 1 "OP_POWER_UP" 2 "OP_STANDBY" 3 "OP_PRE_CRANKING" 4 "OP_CRANKING" 5 "OP_WARM_UP" 6 "OP_RUN" /end COMPU_VTAB
/begin COMPU_VTAB opModes_t_Copy2 "" TAB_VERB 8 0 "OP_FAULT" 1 "OP_STANDBY" 2 "OP_PRE_CRANKING" 3 "OP_CRANKING" 4 "OP_WARM_UP" 5 "OP_RUN" 6 "OP_ESTOP" 7 "OP_POWER_UP" /end COMPU_VTAB
/begin COMPU_VTAB opModes_t_Copy3 "enumeration table" TAB_VERB 9 0 "OP_FAULT" 1 "OP_STANDBY" 2 "OP_PRE_CRANKING" 3 "OP_CRANKING" 4 "OP_WARM_UP" 5 "OP_RUN" 6 "OP_ESTOP" 7 "OP_POWER_UP" 8 "OP_IDLE" /end COMPU_VTAB
/begin COMPU_VTAB starterSource_t "" TAB_VERB 2 0 "STARTER_SOURCE_ENGINE" 1 "STARTER_SOURCE_CASCADIA" /end COMPU_VTAB
/begin COMPU_VTAB vsmState_t "" TAB_VERB 10 0 "VSM_START" 1 "VSM_PRECHARGE_INIT" 2 "VSM_PRECHARGE_ACTIVE" 3 "VSM_PRECHARGE_COMPLETE" 4 "VSM_WAIT" 5 "VSM_READY" 6 "VSM_MOTOR_RUNNING" 7 "VSM_BLINK_FAULTCODE" 8 "VSM_SHUTDOWN_KEYSWITCH" 9 "VSM_RESET_INVERTER" /end COMPU_VTAB
/begin RECORD_LAYOUT SSV__A_INT64_S AXIS_PTS_X 1 A_INT64 INDEX_INCR DIRECT /end RECORD_LAYOUT
/begin RECORD_LAYOUT SSV__A_UINT64_S AXIS_PTS_X 1 A_UINT64 INDEX_INCR DIRECT /end RECORD_LAYOUT
/begin RECORD_LAYOUT SSV__FLOAT32_IEEE_S AXIS_PTS_X 1 FLOAT32_IEEE INDEX_INCR DIRECT /end RECORD_LAYOUT
/begin RECORD_LAYOUT SSV__FLOAT64_IEEE_S AXIS_PTS_X 1 FLOAT64_IEEE INDEX_INCR DIRECT /end RECORD_LAYOUT
/begin RECORD_LAYOUT SSV__SBYTE_S AXIS_PTS_X 1 SBYTE INDEX_INCR DIRECT /end RECORD_LAYOUT
/begin RECORD_LAYOUT SSV__SLONG_S AXIS_PTS_X 1 SLONG INDEX_INCR DIRECT /end RECORD_LAYOUT
/begin RECORD_LAYOUT SSV__SWORD_S AXIS_PTS_X 1 SWORD INDEX_INCR DIRECT /end RECORD_LAYOUT
/begin RECORD_LAYOUT SSV__UBYTE_S AXIS_PTS_X 1 UBYTE INDEX_INCR DIRECT /end RECORD_LAYOUT
/begin RECORD_LAYOUT SSV__ULONG_S AXIS_PTS_X 1 ULONG INDEX_INCR DIRECT /end RECORD_LAYOUT
/begin RECORD_LAYOUT SSV__UWORD_S AXIS_PTS_X 1 UWORD INDEX_INCR DIRECT /end RECORD_LAYOUT
/begin RECORD_LAYOUT TorqueMap.Layout FNC_VALUES 1 UWORD ROW_DIR DIRECT /end RECORD_LAYOUT
/begin RECORD_LAYOUT TorqueScale.Layout AXIS_PTS_X 1 SWORD INDEX_INCR DIRECT /end RECORD_LAYOUT
/begin RECORD_LAYOUT __A_INT64_S FNC_VALUES 1 A_INT64 COLUMN_DIR DIRECT /end RECORD_LAYOUT
/begin RECORD_LAYOUT __A_INT64_Z FNC_VALUES 1 A_INT64 ROW_DIR DIRECT /end RECORD_LAYOUT
/begin RECORD_LAYOUT __A_UINT64_S FNC_VALUES 1 A_UINT64 COLUMN_DIR DIRECT /end RECORD_LAYOUT
/begin RECORD_LAYOUT __A_UINT64_Z FNC_VALUES 1 A_UINT64 ROW_DIR DIRECT /end RECORD_LAYOUT
/begin RECORD_LAYOUT __FLOAT32_IEEE_S FNC_VALUES 1 FLOAT32_IEEE COLUMN_DIR DIRECT /end RECORD_LAYOUT
/begin RECORD_LAYOUT __FLOAT32_IEEE_Z FNC_VALUES 1 FLOAT32_IEEE ROW_DIR DIRECT /end RECORD_LAYOUT
/begin RECORD_LAYOUT __FLOAT64_IEEE_S FNC_VALUES 1 FLOAT64_IEEE COLUMN_DIR DIRECT /end RECORD_LAYOUT
/begin RECORD_LAYOUT __FLOAT64_IEEE_Z FNC_VALUES 1 FLOAT64_IEEE ROW_DIR DIRECT /end RECORD_LAYOUT
/begin RECORD_LAYOUT __SBYTE_S FNC_VALUES 1 SBYTE COLUMN_DIR DIRECT /end RECORD_LAYOUT
/begin RECORD_LAYOUT __SBYTE_Z FNC_VALUES 1 SBYTE ROW_DIR DIRECT /end RECORD_LAYOUT
/begin RECORD_LAYOUT __SByte_Value FNC_VALUES 1 SBYTE ROW_DIR DIRECT /end RECORD_LAYOUT
/begin RECORD_LAYOUT __SLONG_S FNC_VALUES 1 SLONG COLUMN_DIR DIRECT /end RECORD_LAYOUT
/begin RECORD_LAYOUT __SLONG_Z FNC_VALUES 1 SLONG ROW_DIR DIRECT /end RECORD_LAYOUT
/begin RECORD_LAYOUT __SLong_Axis AXIS_PTS_X 1 SLONG INDEX_INCR DIRECT /end RECORD_LAYOUT
/begin RECORD_LAYOUT __SLong_Value FNC_VALUES 1 SLONG ROW_DIR DIRECT /end RECORD_LAYOUT
/begin RECORD_LAYOUT __SWORD_S FNC_VALUES 1 SWORD COLUMN_DIR DIRECT /end RECORD_LAYOUT
/begin RECORD_LAYOUT __SWORD_Z FNC_VALUES 1 SWORD ROW_DIR DIRECT /end RECORD_LAYOUT
/begin RECORD_LAYOUT __SWord_Axis AXIS_PTS_X 1 SWORD INDEX_INCR DIRECT /end RECORD_LAYOUT
/begin RECORD_LAYOUT __SWord_Value FNC_VALUES 1 SWORD ROW_DIR DIRECT /end RECORD_LAYOUT
/begin RECORD_LAYOUT __UBYTE_S FNC_VALUES 1 UBYTE COLUMN_DIR DIRECT /end RECORD_LAYOUT
/begin RECORD_LAYOUT __UBYTE_Z FNC_VALUES 1 UBYTE ROW_DIR DIRECT /end RECORD_LAYOUT
/begin RECORD_LAYOUT __UByte_Value FNC_VALUES 1 UBYTE ROW_DIR DIRECT /end RECORD_LAYOUT
/begin RECORD_LAYOUT __ULONG_S FNC_VALUES 1 ULONG COLUMN_DIR DIRECT /end RECORD_LAYOUT
/begin RECORD_LAYOUT __ULONG_Z FNC_VALUES 1 ULONG ROW_DIR DIRECT /end RECORD_LAYOUT
/begin RECORD_LAYOUT __ULong_Value FNC_VALUES 1 ULONG ROW_DIR DIRECT /end RECORD_LAYOUT
/begin RECORD_LAYOUT __UWORD_S FNC_VALUES 1 UWORD COLUMN_DIR DIRECT /end RECORD_LAYOUT
/begin RECORD_LAYOUT __UWORD_Z FNC_VALUES 1 UWORD ROW_DIR DIRECT /end RECORD_LAYOUT
/begin RECORD_LAYOUT __UWord_Axis AXIS_PTS_X 1 UWORD INDEX_INCR DIRECT /end RECORD_LAYOUT
/begin RECORD_LAYOUT __UWord_Value FNC_VALUES 1 UWORD ROW_DIR DIRECT /end RECORD_LAYOUT
/begin UNIT Celsius "" "degC" EXTENDED_SI SI_EXPONENTS 0 0 0 0 1 0 0 /end UNIT
/end MODULE
/end PROJECT
