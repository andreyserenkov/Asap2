/* generated by ASAP2 Studio 2.6.8.11413 */ ASAP2_VERSION 1 71
/begin PROJECT ProjectName ""
/begin MODULE ModuleName "GDI-2"
/begin MOD_PAR ""
 /begin MEMORY_SEGMENT CAL_FLASH "" DATA FLASH INTERN 0x1C000 0x2600 -1 -1 -1 -1 -1
  /begin IF_DATA XCP
   /begin SEGMENT 0x00 0x01 0x00 0x00 0x00
    /begin PAGE 0x00 ECU_ACCESS_DONT_CARE XCP_READ_ACCESS_DONT_CARE XCP_WRITE_ACCESS_NOT_ALLOWED /end PAGE
   /end SEGMENT
  /end IF_DATA
 /end MEMORY_SEGMENT
 /begin MEMORY_SEGMENT PoolRAM "" SERAM RAM INTERN 0x20000600 0x800 -1 -1 -1 -1 -1
  /begin IF_DATA XCP
   /begin SEGMENT 0x01 0x00 0x00 0x00 0x00
    /begin CHECKSUM XCP_ADD_12 MAX_BLOCK_SIZE 0xFFFFFFFF EXTERNAL_FUNCTION "chksum.dll" /end CHECKSUM
   /end SEGMENT
  /end IF_DATA
 /end MEMORY_SEGMENT
 /begin CALIBRATION_METHOD "AUTOSAR_SINGLE_POINTERED" 0x1 /begin CALIBRATION_HANDLE 0x1FFFF000 0x1B8 0x4 /end CALIBRATION_HANDLE /end CALIBRATION_METHOD
/end MOD_PAR
/begin MOD_COMMON "" BYTE_ORDER MSB_LAST ALIGNMENT_BYTE 1 ALIGNMENT_WORD 2 ALIGNMENT_LONG 4 ALIGNMENT_FLOAT16_IEEE 1 ALIGNMENT_FLOAT32_IEEE 4 ALIGNMENT_FLOAT64_IEEE 8 ALIGNMENT_INT64 8 /end MOD_COMMON
/begin IF_DATA XCP
 /begin PROTOCOL_LAYER 0x0104 0x3C 0x64 0x00 0x00 0x00 0x00 0x00 0x08 0x08 BYTE_ORDER_MSB_LAST ADDRESS_GRANULARITY_BYTE OPTIONAL_CMD PROGRAM_RESET OPTIONAL_CMD PROGRAM OPTIONAL_CMD PROGRAM_CLEAR OPTIONAL_CMD PROGRAM_START OPTIONAL_CMD ALLOC_ODT_ENTRY OPTIONAL_CMD ALLOC_ODT OPTIONAL_CMD ALLOC_DAQ OPTIONAL_CMD FREE_DAQ OPTIONAL_CMD GET_DAQ_RESOLUTION_INFO OPTIONAL_CMD GET_DAQ_PROCESSOR_INFO OPTIONAL_CMD GET_DAQ_CLOCK OPTIONAL_CMD START_STOP_SYNCH OPTIONAL_CMD START_STOP_DAQ_LIST OPTIONAL_CMD GET_DAQ_LIST_MODE OPTIONAL_CMD SET_DAQ_LIST_MODE OPTIONAL_CMD WRITE_DAQ OPTIONAL_CMD SET_DAQ_PTR OPTIONAL_CMD CLEAR_DAQ_LIST OPTIONAL_CMD DOWNLOAD OPTIONAL_CMD BUILD_CHECKSUM OPTIONAL_CMD UPLOAD OPTIONAL_CMD SET_MTA /end PROTOCOL_LAYER
 /begin DAQ DYNAMIC 0x00 0x01 0x00 OPTIMISATION_TYPE_DEFAULT ADDRESS_EXTENSION_FREE IDENTIFICATION_FIELD_TYPE_ABSOLUTE GRANULARITY_ODT_ENTRY_SIZE_DAQ_BYTE 0x07 NO_OVERLOAD_INDICATION PRESCALER_SUPPORTED /begin TIMESTAMP_SUPPORTED 0x01 SIZE_WORD UNIT_1MS /end TIMESTAMP_SUPPORTED
  /begin DAQ_LIST 0x00 DAQ_LIST_TYPE DAQ MAX_ODT 0xFF MAX_ODT_ENTRIES 0xFF FIRST_PID 0x00 /end DAQ_LIST
  /begin EVENT "20ms" "20ms" 0x00 DAQ 0xFF 0x14 0x06 0x00 /end EVENT
 /end DAQ
 /begin PAG 0x02 /end PAG
 /begin PGM PGM_MODE_ABSOLUTE 0x18 0x00 /begin SECTOR "FLASH" 0x00 0x01C000 0x0200 0x00 0x00 0x00 /end SECTOR /begin SECTOR "FLASH" 0x01 0x01C200 0x0200 0x00 0x00 0x00 /end SECTOR /begin SECTOR "FLASH" 0x02 0x01C400 0x0200 0x00 0x00 0x00 /end SECTOR /begin SECTOR "FLASH" 0x03 0x01C600 0x0200 0x00 0x00 0x00 /end SECTOR /begin SECTOR "FLASH" 0x04 0x01C800 0x0200 0x00 0x00 0x00 /end SECTOR /begin SECTOR "FLASH" 0x05 0x01CA00 0x0200 0x00 0x00 0x00 /end SECTOR /begin SECTOR "FLASH" 0x06 0x01CC00 0x0200 0x00 0x00 0x00 /end SECTOR /begin SECTOR "FLASH" 0x07 0x01CE00 0x0200 0x00 0x00 0x00 /end SECTOR /begin SECTOR "FLASH" 0x08 0x01D000 0x0200 0x00 0x00 0x00 /end SECTOR /begin SECTOR "FLASH" 0x09 0x01D200 0x0200 0x00 0x00 0x00 /end SECTOR /begin SECTOR "FLASH" 0x0A 0x01D400 0x0200 0x00 0x00 0x00 /end SECTOR /begin SECTOR "FLASH" 0x0B 0x01D600 0x0200 0x00 0x00 0x00 /end SECTOR /begin SECTOR "FLASH" 0x0C 0x01D800 0x0200 0x00 0x00 0x00 /end SECTOR /begin SECTOR "FLASH" 0x0D 0x01DA00 0x0200 0x00 0x00 0x00 /end SECTOR /begin SECTOR "FLASH" 0x0E 0x01DC00 0x0200 0x00 0x00 0x00 /end SECTOR /begin SECTOR "FLASH" 0x0F 0x01DE00 0x0200 0x00 0x00 0x00 /end SECTOR /begin SECTOR "FLASH" 0x10 0x01E000 0x0200 0x00 0x00 0x00 /end SECTOR /begin SECTOR "FLASH" 0x11 0x01E200 0x0200 0x00 0x00 0x00 /end SECTOR /begin SECTOR "FLASH" 0x12 0x01E400 0x0200 0x00 0x00 0x00 /end SECTOR /begin SECTOR "FLASH" 0x13 0x01E600 0x0200 0x00 0x00 0x00 /end SECTOR /begin SECTOR "FLASH" 0x14 0x01E800 0x0200 0x00 0x00 0x00 /end SECTOR /begin SECTOR "FLASH" 0x15 0x01EA00 0x0200 0x00 0x00 0x00 /end SECTOR /begin SECTOR "FLASH" 0x16 0x01EC00 0x0200 0x00 0x00 0x00 /end SECTOR /begin SECTOR "FLASH" 0x17 0x01EE00 0x0200 0x00 0x00 0x00 /end SECTOR /end PGM
 /begin XCP_ON_CAN 0x0100 CAN_ID_MASTER 0x92750001 CAN_ID_SLAVE 0x92750C00 BAUDRATE 0x0F4240 SAMPLE_POINT 0x4B SAMPLE_RATE SINGLE BTL_CYCLES 0x08 SJW 0x02 SYNC_EDGE SINGLE /end XCP_ON_CAN
/end IF_DATA
/begin MEASUREMENT AirTemp "" SWORD Temperature 0 0 -45 250 ECU_ADDRESS 0x2000041C PHYS_UNIT "deg C"
 /begin IF_DATA XCP
  /begin DAQ_EVENT FIXED_EVENT_LIST EVENT 0x00 /end DAQ_EVENT
 /end IF_DATA
/end MEASUREMENT
/begin CHARACTERISTIC AirTempLookup "" CURVE 0x1CDA0 __SWORD_S 0 Temperature -70 1000
 /begin AXIS_DESCR COM_AXIS NO_INPUT_QUANTITY Volt_ATD 50 -700 1000 AXIS_PTS_REF AirTempVoltageScale FORMAT "%.15" PHYS_UNIT "V" /end AXIS_DESCR
 SYMBOL_LINK "AirTempScale._0_" 0 /end CHARACTERISTIC
/begin AXIS_PTS AirTempVoltageScale "" 0x1CD3C NO_INPUT_QUANTITY SSV__SWORD_S 0 Volt_ATD 50 -700 1000 DEPOSIT ABSOLUTE FORMAT "%.15" PHYS_UNIT "V" SYMBOL_LINK "AirTempATD._0_" 0 /end AXIS_PTS
/begin MEASUREMENT AutoPrime "" UWORD FP_Thousandth 0 0 0 65535 ECU_ADDRESS 0x2000046E FORMAT "%1.3" PHYS_UNIT "sec" /end MEASUREMENT
/begin CHARACTERISTIC AutoPrimeCalActive "" VALUE 0x1D430 __SBYTE_S 0 LP_FuelPumpCtrl.CONVERSION -128 127 FORMAT "%6.3" /end CHARACTERISTIC
/begin CHARACTERISTIC AutoPrimeCurve "" CURVE 0x1CCE0 __UWORD_S 0 FP_Thousandth 0 500
 /begin AXIS_DESCR COM_AXIS EngTemp Temperature 14 -70 1000 AXIS_PTS_REF TempScale FORMAT "%.15" /end AXIS_DESCR
 FORMAT "%.15" PHYS_UNIT "ms autoprime" SYMBOL_LINK "AutoPrimeCurve._0_" 0 /end CHARACTERISTIC
/begin MEASUREMENT Barometer "" UWORD NO_COMPU_METHOD 0 0 0 1500 ECU_ADDRESS 0x2000040E FORMAT "%.15" PHYS_UNIT "mbar"
 /begin IF_DATA XCP
  /begin DAQ_EVENT FIXED_EVENT_LIST EVENT 0x00 /end DAQ_EVENT
 /end IF_DATA
/end MEASUREMENT
/begin CHARACTERISTIC BarometerGain "" VALUE 0x1CD28 __SWORD_S 0 Volt_ATD 0 65535 FORMAT "%.15" PHYS_UNIT "mbar/mV" /end CHARACTERISTIC
/begin CHARACTERISTIC BarometerOffset "" VALUE 0x1CD2A __SWORD_S 0 NO_COMPU_METHOD 0 65535 FORMAT "%.15" PHYS_UNIT "mbar" /end CHARACTERISTIC
/begin CHARACTERISTIC CalComments "" ASCII 0x1C000 __UBYTE_Z 0 NO_COMPU_METHOD 0 255 NUMBER 200 SYMBOL_LINK "CalComments._0_" 0 /end CHARACTERISTIC
/begin CHARACTERISTIC CamTrigger "" VALUE 0x1C0D3 __SBYTE_S 0 CamTrigger.CONVERSION -128 127 FORMAT "%6.3" /end CHARACTERISTIC
/begin MEASUREMENT CamTriggerTooth "" UWORD NO_COMPU_METHOD 0 0 0 65535 ECU_ADDRESS 0x200013EA FORMAT "%.15" /end MEASUREMENT
/begin CHARACTERISTIC CoolantPreheatTargetTemp "" VALUE 0x1D078 __SWORD_S 0 Temperature -80 150 PHYS_UNIT "deg C" /end CHARACTERISTIC
/begin CHARACTERISTIC CoolantTempFanPwmMax "" VALUE 0x1D550 __SWord_Value 0 FP_Tenth 0 100 PHYS_UNIT "%" /end CHARACTERISTIC
/begin CHARACTERISTIC CoolantTempFanPwmMin "" VALUE 0x1D54E __SWord_Value 0 FP_Tenth 0 100 PHYS_UNIT "%" /end CHARACTERISTIC
/begin CHARACTERISTIC CoolantTempFanTargetMax "" VALUE 0x1D54C __SWord_Value 0 FP_Tenth -80 150 PHYS_UNIT "deg C" /end CHARACTERISTIC
/begin CHARACTERISTIC CoolantTempFanTargetMin "" VALUE 0x1D07C __SWORD_S 0 FP_Tenth -80 150 PHYS_UNIT "deg C" /end CHARACTERISTIC
/begin CHARACTERISTIC CoolantTempPumpTarget "" VALUE 0x1D07E __SWORD_S 0 NO_COMPU_METHOD -32768 32767 FORMAT "%.15" /end CHARACTERISTIC
/begin MEASUREMENT CoolingFanDuty "" UWORD FP_Tenth 0 0 0 65535 ECU_ADDRESS 0x200004D6 PHYS_UNIT "%" /end MEASUREMENT
/begin MEASUREMENT CrankActive "" SBYTE CrankActive.CONVERSION 0 0 -128 127 ECU_ADDRESS 0x20001008 FORMAT "%6.3" /end MEASUREMENT
/begin CHARACTERISTIC CrankDisconnect "" VALUE 0x1C1F0 __UWORD_S 0 SAERPM.Conversion 0 8000 PHYS_UNIT "RPM" /end CHARACTERISTIC
/begin MEASUREMENT CrankState "" SBYTE CrankState.CONVERSION 0 0 0 65535 ECU_ADDRESS 0x20001007 FORMAT "%.15" /end MEASUREMENT
/begin MEASUREMENT DeltaT "" UWORD NO_COMPU_METHOD 0 0 0 65535 ECU_ADDRESS 0x200012F8 MATRIX_DIM 68 SYMBOL_LINK "DeltaT._0_" 0 /end MEASUREMENT
/begin CHARACTERISTIC DiffTimeConstant "" VALUE 0x1CD12 __UWORD_S 0 NO_COMPU_METHOD 0 65535 FORMAT "%.15" /end CHARACTERISTIC
/begin MEASUREMENT DigitalIn1 "" SBYTE DigitalIn1.CONVERSION 0 0 -128 127 ECU_ADDRESS 0x200004BC FORMAT "%6.3" /end MEASUREMENT
/begin MEASUREMENT DigitalIn2 "" SBYTE DigitalIn1.CONVERSION 0 0 -128 127 ECU_ADDRESS 0x200004BD FORMAT "%6.3" /end MEASUREMENT
/begin MEASUREMENT DigitalIn3 "" SBYTE DigitalIn1.CONVERSION 0 0 -128 127 ECU_ADDRESS 0x200004BE FORMAT "%6.3" /end MEASUREMENT
/begin MEASUREMENT DigitalIn4 "" SBYTE DigitalIn1.CONVERSION 0 0 -128 127 ECU_ADDRESS 0x200004BF FORMAT "%6.3" /end MEASUREMENT
/begin MEASUREMENT DigitalIn5 "" SBYTE DigitalIn1.CONVERSION 0 0 -128 127 ECU_ADDRESS 0x200004C0 FORMAT "%6.3" /end MEASUREMENT
/begin MEASUREMENT DigitalIn6 "" SBYTE DigitalIn1.CONVERSION 0 0 -128 127 ECU_ADDRESS 0x200004C1 FORMAT "%6.3" /end MEASUREMENT
/begin MEASUREMENT DigitalIn7 "" SBYTE DigitalIn1.CONVERSION 0 0 -128 127 ECU_ADDRESS 0x200004C2 FORMAT "%6.3" /end MEASUREMENT
/begin MEASUREMENT DwellTmrOffset "" ULONG NO_COMPU_METHOD 0 0 0 4294967295 ECU_ADDRESS 0x20000F44 FORMAT "%.15" /end MEASUREMENT
/begin MEASUREMENT DwellTooth "" ULONG NO_COMPU_METHOD 0 0 0 4294967295 ECU_ADDRESS 0x20001438 FORMAT "%.15" /end MEASUREMENT
/begin MEASUREMENT EngTemp "" SWORD Temperature 0 0 0 900 ECU_ADDRESS 0x20000424 PHYS_UNIT "deg C"
 /begin IF_DATA XCP
  /begin DAQ_EVENT FIXED_EVENT_LIST EVENT 0x00 /end DAQ_EVENT
 /end IF_DATA
/end MEASUREMENT
/begin AXIS_PTS EngTempCalATD "" 0x1CE08 NO_INPUT_QUANTITY TorqueScale.Layout 0 NO_COMPU_METHOD 50 -32768 32767 DEPOSIT ABSOLUTE FORMAT "%.15" SYMBOL_LINK "EngTempCalATD._0_" 0 /end AXIS_PTS
/begin CHARACTERISTIC EngTempCalScale "" CURVE 0x1CE6C __SWORD_Z 0 NO_COMPU_METHOD -32768 32767
 /begin AXIS_DESCR COM_AXIS NO_INPUT_QUANTITY NO_COMPU_METHOD 50 -32768 32767 AXIS_PTS_REF EngTempCalATD FORMAT "%.15" /end AXIS_DESCR
 FORMAT "%.15" SYMBOL_LINK "EngTempCalScale._0_" 0 /end CHARACTERISTIC
/begin MEASUREMENT EngineStateCmd "" SBYTE EngineStateCmd.CONVERSION 0 0 0 255 ECU_ADDRESS 0x2000042A FORMAT "%6.3" /end MEASUREMENT
/begin MEASUREMENT EngineStateCmdCan "" SBYTE EngineStateCmd.CONVERSION 0 0 -128 127 ECU_ADDRESS 0x200004E1 FORMAT "%6.3" /end MEASUREMENT
/begin CHARACTERISTIC EngineStateCmdXcp "" VALUE 0x200004E0 __SBYTE_S 0 EngineStateCmd.CONVERSION -128 127 FORMAT "%6.3" /end CHARACTERISTIC
/begin CHARACTERISTIC EngineTempCompCurve "" CURVE 0x1CCA8 __UWORD_S 0 Enrichment.Conversion 0 500
 /begin AXIS_DESCR COM_AXIS EngTemp Temperature 14 -70 1000 AXIS_PTS_REF TempScale FORMAT "%.15" /end AXIS_DESCR
 PHYS_UNIT "% Enrichment" SYMBOL_LINK "EngineTempCompCurve._0_" 0 /end CHARACTERISTIC
/begin CHARACTERISTIC FW_Version "" ASCII 0x1B7F0 __UByte_Value 0 NO_COMPU_METHOD 0 255 NUMBER 4 /end CHARACTERISTIC
/begin MEASUREMENT FcvActiveTmrOffset "" UBYTE NO_COMPU_METHOD 0 0 0 4294967295 ECU_ADDRESS 0x200010EC FORMAT "%.15" /end MEASUREMENT
/begin MEASUREMENT FcvActiveTmrOffsetNext._0_ "" UWORD NO_COMPU_METHOD 0 0 0 65535 ECU_ADDRESS 0x200010A8 FORMAT "%.15" /end MEASUREMENT
/begin MEASUREMENT FcvActiveTooth "" UBYTE NO_COMPU_METHOD 0 0 0 4294967295 ECU_ADDRESS 0x200010E0 FORMAT "%.15" /end MEASUREMENT
/begin MEASUREMENT FcvActiveToothNext._0_ "" UWORD NO_COMPU_METHOD 0 0 0 65535 ECU_ADDRESS 0x200010F8 FORMAT "%.15" /end MEASUREMENT
/begin MEASUREMENT FcvOffTmrOffset "" UBYTE NO_COMPU_METHOD 0 0 0 4294967295 ECU_ADDRESS 0x20001100 FORMAT "%.15" /end MEASUREMENT
/begin MEASUREMENT FcvOffTmrOffsetNext._0_ "" UWORD NO_COMPU_METHOD 0 0 0 65535 ECU_ADDRESS 0x200010A0 FORMAT "%.15" /end MEASUREMENT
/begin MEASUREMENT FcvOffTooth "" UBYTE NO_COMPU_METHOD 0 0 0 4294967295 ECU_ADDRESS 0x200010D4 FORMAT "%.15" /end MEASUREMENT
/begin MEASUREMENT FcvOffToothNext._0_ "" UWORD NO_COMPU_METHOD 0 0 0 65535 ECU_ADDRESS 0x200010B4 FORMAT "%.15" /end MEASUREMENT
/begin CHARACTERISTIC FlywheelMissingTeeth "" VALUE 0x1C0CC __ULONG_S 0 NO_COMPU_METHOD 0 4294967295 FORMAT "%.15" /end CHARACTERISTIC
/begin CHARACTERISTIC FlywheelTeeth "" VALUE 0x1C0C8 __ULONG_S 0 NO_COMPU_METHOD 0 4294967295 FORMAT "%.15" /end CHARACTERISTIC
/begin CHARACTERISTIC FprvFeedForward_FuelQty_Map "" MAP 0x1D098 __UWORD_Z 0 FP_Tenth 0 65535
 /begin AXIS_DESCR COM_AXIS Fuel_Final FP_Hundredth 10 0 650 AXIS_PTS_REF FuelQtyScale PHYS_UNIT "mg/pulse" /end AXIS_DESCR
 /begin AXIS_DESCR COM_AXIS FuelPressureHP FP_Tenth 14 0 65535 AXIS_PTS_REF FuelPressureScale PHYS_UNIT "bar" /end AXIS_DESCR
 PHYS_UNIT "%" SYMBOL_LINK "FprvFeedForward_FuelQty_Map._0_._0_" 0 /end CHARACTERISTIC
/begin CHARACTERISTIC FprvFeedForward_Spd_Map "" MAP 0x1D1B0 __SWORD_Z 0 FP_Tenth -32768 32767
 /begin AXIS_DESCR COM_AXIS RPM SAERPM.Conversion 10 0 8000 AXIS_PTS_REF RpmScale PHYS_UNIT "RPM" /end AXIS_DESCR
 /begin AXIS_DESCR COM_AXIS FuelPressureHP FP_Tenth 14 0 65535 AXIS_PTS_REF FuelPressureScale PHYS_UNIT "bar" /end AXIS_DESCR
 PHYS_UNIT "%" SYMBOL_LINK "FprvFeedForward_Spd_Map._0_._0_" 0 /end CHARACTERISTIC
/begin MEASUREMENT FprvFeedFwd "" UWORD FP_Tenth 0 0 0 65535 ECU_ADDRESS 0x200004F0 PHYS_UNIT "%" /end MEASUREMENT
/begin MEASUREMENT FprvInteg "Contribution of Integ in fuel pressure PI control" SLONG FP_HundredThousandth 0 0 -2147483648 2147483647 ECU_ADDRESS 0x200004EC FORMAT "%6.1" PHYS_UNIT "%" /end MEASUREMENT
/begin CHARACTERISTIC FprvIntegGain "Integrator gain for fuel pressure PI " VALUE 0x1D094 TorqueMap.Layout 0 NO_COMPU_METHOD 0 65535 FORMAT "%.15" /end CHARACTERISTIC
/begin MEASUREMENT FprvProp "Contribution of Prop in fuel pressure PI control" SLONG FP_TenThousandth 0 0 -200 200 ECU_ADDRESS 0x200004E8 PHYS_UNIT "%" /end MEASUREMENT
/begin CHARACTERISTIC FprvPropGain "Proportional gain for fuel pressure PI " VALUE 0x1D092 TorqueMap.Layout 0 NO_COMPU_METHOD 0 65535 FORMAT "%.15" /end CHARACTERISTIC
/begin MEASUREMENT Fuel1Timing_Port "" SWORD SparkTiming.Conversion 0 0 -360 360 ECU_ADDRESS 0x200004CE PHYS_UNIT "deg BTDC" SYMBOL_LINK "Fuel1Timing" 0 /end MEASUREMENT
/begin CHARACTERISTIC Fuel1Timing_Port_Xcp "" VALUE 0x200004DC __SWORD_S 0 SparkTiming.Conversion -360 360 PHYS_UNIT "deg BTDC" SYMBOL_LINK "Fuel1TimingXcp" 0 /end CHARACTERISTIC
/begin MEASUREMENT Fuel2Timing_DI "" SWORD SparkTiming.Conversion 0 0 -360 360 ECU_ADDRESS 0x200004D0 PHYS_UNIT "deg BTDC" SYMBOL_LINK "Fuel2Timing" 0 /end MEASUREMENT
/begin CHARACTERISTIC Fuel2Timing_DI_Xcp "" VALUE 0x200004DE __SWORD_S 0 SparkTiming.Conversion -360 360 PHYS_UNIT "deg BTDC" SYMBOL_LINK "Fuel2TimingXcp" 0 /end CHARACTERISTIC
/begin MEASUREMENT FuelCtrlValveDuty "" UWORD FP_Tenth 0 0 0 65535 ECU_ADDRESS 0x200004D2 PHYS_UNIT "%" /end MEASUREMENT
/begin CHARACTERISTIC FuelDistributionMap "Look-up for percent of total fuel quantity to Port Injector" MAP 0x1C654 TorqueMap.Layout 0 FP_Tenth 0 100
 /begin AXIS_DESCR COM_AXIS RPM SAERPM.Conversion 10 0 8000 AXIS_PTS_REF RpmScale PHYS_UNIT "RPM" /end AXIS_DESCR
 /begin AXIS_DESCR COM_AXIS ThrottlePosDes FP_Tenth 14 0 100 AXIS_PTS_REF ThrottleScale PHYS_UNIT "% Throttle" /end AXIS_DESCR
 PHYS_UNIT "% PFI" SYMBOL_LINK "FuelDistributionMap._0_._0_" 0 /end CHARACTERISTIC
/begin MEASUREMENT FuelFraction1_Port "Percent of total fuel quantity to Port Injector" UWORD FP_Tenth 0 0 0 100 ECU_ADDRESS 0x200004D8 PHYS_UNIT "% PFI" SYMBOL_LINK "FuelFraction1" 0 /end MEASUREMENT
/begin CHARACTERISTIC FuelFraction1_Port_Xcp "Manual map override for qty of fuel to PFI" VALUE 0x200004DA TorqueMap.Layout 0 FP_Tenth 0 100 PHYS_UNIT "% PFI" SYMBOL_LINK "FuelFraction1Xcp" 0 /end CHARACTERISTIC
/begin CHARACTERISTIC FuelInj1TimingMap_Port "" MAP 0x1C424 __SWORD_Z 0 SparkTiming.Conversion -360 360
 /begin AXIS_DESCR COM_AXIS RPM SAERPM.Conversion 10 0 8000 AXIS_PTS_REF RpmScale PHYS_UNIT "RPM" /end AXIS_DESCR
 /begin AXIS_DESCR COM_AXIS ThrottlePosDes FP_Tenth 14 0 100 AXIS_PTS_REF ThrottleScale PHYS_UNIT "% Throttle" /end AXIS_DESCR
 PHYS_UNIT "deg BTDC" SYMBOL_LINK "FuelInj1TimingMap._0_._0_" 0 /end CHARACTERISTIC
/begin CHARACTERISTIC FuelInj2TimingMap_DI "" MAP 0x1C53C __SWORD_Z 0 SparkTiming.Conversion -360 360
 /begin AXIS_DESCR COM_AXIS RPM SAERPM.Conversion 10 0 8000 AXIS_PTS_REF RpmScale PHYS_UNIT "RPM" /end AXIS_DESCR
 /begin AXIS_DESCR COM_AXIS ThrottlePosDes FP_Tenth 14 0 100 AXIS_PTS_REF ThrottleScale PHYS_UNIT "% Throttle" /end AXIS_DESCR
 PHYS_UNIT "deg BTDC" SYMBOL_LINK "FuelInj2TimingMap._0_._0_" 0 /end CHARACTERISTIC
/begin MEASUREMENT FuelLevel "" UWORD FP_Thousandth 0 0 0 65535 ECU_ADDRESS 0x20000418 FORMAT "%1.3" PHYS_UNIT "V" /end MEASUREMENT
/begin MEASUREMENT FuelMapType "" SBYTE FuelMapType.CONVERSION 0 0 0 255 ECU_ADDRESS 0x20000430 FORMAT "%6.3" /end MEASUREMENT
/begin CHARACTERISTIC FuelMapTypeXCP "" VALUE 0x20000409 __UBYTE_S 0 FuelMapType.Conversion 0 255 /end CHARACTERISTIC
/begin CHARACTERISTIC FuelMap_1 "TPS-based fueling" MAP 0x1C1F4 __UWORD_Z 0 FP_Hundredth 0 300
 /begin AXIS_DESCR COM_AXIS RPM SAERPM.Conversion 10 0 8000 AXIS_PTS_REF RpmScale PHYS_UNIT "RPM" /end AXIS_DESCR
 /begin AXIS_DESCR COM_AXIS ThrottlePosDes FP_Tenth 14 0 100 AXIS_PTS_REF ThrottleScale PHYS_UNIT "% Throttle" /end AXIS_DESCR
 PHYS_UNIT "mg/shot" SYMBOL_LINK "FuelMap1._0_._0_" 0 /end CHARACTERISTIC
/begin CHARACTERISTIC FuelMap_2 "MAP-based fueling" MAP 0x1C30C __UWORD_Z 0 FP_Hundredth 0 100
 /begin AXIS_DESCR COM_AXIS RPM SAERPM.Conversion 10 0 8000 AXIS_PTS_REF RpmScale PHYS_UNIT "RPM" /end AXIS_DESCR
 /begin AXIS_DESCR COM_AXIS NO_INPUT_QUANTITY NO_COMPU_METHOD 14 0 1200 AXIS_PTS_REF MapScale FORMAT "%.15" PHYS_UNIT "mbar" /end AXIS_DESCR
 PHYS_UNIT "mg/shot" SYMBOL_LINK "FuelMap2._0_._0_" 0 /end CHARACTERISTIC
/begin CHARACTERISTIC FuelOffsetXCP "" VALUE 0x20000400 __SWORD_S 0 FuelOffsetXCP.Conversion -200 200 PHYS_UNIT "%" /end CHARACTERISTIC
/begin CHARACTERISTIC FuelPressureControlMode "" VALUE 0x1D30C __SBYTE_S 0 FuelPressureControlMode.CONVERSION -128 127 FORMAT "%6.3" /end CHARACTERISTIC
/begin MEASUREMENT FuelPressureHP "" UWORD FP_Tenth 0 0 0 65535 ECU_ADDRESS 0x20000422 FORMAT "%3.1" PHYS_UNIT "bar" /end MEASUREMENT
/begin MEASUREMENT FuelPressureHpDesired "" UWORD FP_Tenth 0 0 0 600 ECU_ADDRESS 0x200004E4 FORMAT "%3.1" PHYS_UNIT "bar" /end MEASUREMENT
/begin CHARACTERISTIC FuelPressureHpDesiredXcp "" VALUE 0x200004F6 TorqueMap.Layout 0 FP_Tenth 0 2000 PHYS_UNIT "bar" /end CHARACTERISTIC
/begin MEASUREMENT FuelPressureLP "" UWORD FP_Thousandth 0 0 0 65535 ECU_ADDRESS 0x20000414 FORMAT "%2.2" PHYS_UNIT "bar" /end MEASUREMENT
/begin CHARACTERISTIC FuelPressureMap "" MAP 0x1D310 TorqueMap.Layout 0 FP_Tenth 0 6000
 /begin AXIS_DESCR COM_AXIS RPM SAERPM.Conversion 10 0 8000 AXIS_PTS_REF RpmScale PHYS_UNIT "RPM" /end AXIS_DESCR
 /begin AXIS_DESCR COM_AXIS Torque FP_Tenth 14 -40 100 AXIS_PTS_REF ThrottleScale PHYS_UNIT "%" /end AXIS_DESCR
 PHYS_UNIT "bar" SYMBOL_LINK "FuelPressureMap._0_._0_" 0 /end CHARACTERISTIC
/begin AXIS_PTS FuelPressureScale "" 0x1D2C8 FuelPressureHP SSV__UWORD_S 0 FP_Tenth 14 0 65535 DEPOSIT ABSOLUTE PHYS_UNIT "bar" SYMBOL_LINK "FuelPressureScale._0_" 0 /end AXIS_PTS
/begin CHARACTERISTIC FuelPumpCompDuration "Duration of fuel pump compression stroke" VALUE 0x1D090 TorqueMap.Layout 0 FP_Tenth 0 360 PHYS_UNIT "deg" /end CHARACTERISTIC
/begin CHARACTERISTIC FuelPumpLobeCount "Cam lobes per engine cycle" VALUE 0x1D08E TorqueMap.Layout 0 NO_COMPU_METHOD 1 4 FORMAT "%.15" /end CHARACTERISTIC
/begin MEASUREMENT FuelPumpLpDuty "" UWORD FP_Tenth 0 0 0 65535 ECU_ADDRESS 0x200004D4 PHYS_UNIT "%" /end MEASUREMENT
/begin CHARACTERISTIC FuelPumpTdcOffset "" VALUE 0x1D072 TorqueMap.Layout 0 FP_Tenth 0 65535 FORMAT "%.15" PHYS_UNIT "deg" /end CHARACTERISTIC
/begin AXIS_PTS FuelQtyScale "" 0x1D2E4 Fuel_Final SSV__SLONG_S 0 FP_Hundredth 10 0 650 DEPOSIT ABSOLUTE PHYS_UNIT "mg/pulse" SYMBOL_LINK "FuelQtyScale._0_" 0 /end AXIS_PTS
/begin CHARACTERISTIC FuelStrategy "" VALUE 0x1D42D __SBYTE_S 0 FuelStrategy.CONVERSION -128 127 FORMAT "%6.3" /end CHARACTERISTIC
/begin MEASUREMENT FuelTable "" SWORD FP_Hundredth 0 0 0 64 ECU_ADDRESS 0x20000468 FORMAT "%.15" PHYS_UNIT "uL/shot"
 /begin IF_DATA XCP
  /begin DAQ_EVENT FIXED_EVENT_LIST EVENT 0x00 /end DAQ_EVENT
 /end IF_DATA
/end MEASUREMENT
/begin MEASUREMENT FuelTemp "" SWORD Temperature 0 0 -70 400 ECU_ADDRESS 0x2000041A FORMAT "%.15" PHYS_UNIT "deg C"
 /begin IF_DATA XCP
  /begin DAQ_EVENT FIXED_EVENT_LIST EVENT 0x00 /end DAQ_EVENT
 /end IF_DATA
/end MEASUREMENT
/begin CHARACTERISTIC FuelTempLookup "" CURVE 0x1CF34 __SWORD_S 0 Temperature -70 1000
 /begin AXIS_DESCR COM_AXIS NO_INPUT_QUANTITY Volt_ATD 50 -700 1000 AXIS_PTS_REF FuelTempVoltageScale PHYS_UNIT "V" /end AXIS_DESCR
 SYMBOL_LINK "FuelTempScale._0_" 0 /end CHARACTERISTIC
/begin AXIS_PTS FuelTempVoltageScale "" 0x1CED0 NO_INPUT_QUANTITY SSV__SWORD_S 0 Volt_ATD 50 -700 1000 DEPOSIT ABSOLUTE MONOTONY MONOTONOUS PHYS_UNIT "V" SYMBOL_LINK "FuelTempATD._0_" 0 /end AXIS_PTS
/begin MEASUREMENT Fuel_AD_Comp "" SWORD Enrichment.Conversion 0 0 0 64 ECU_ADDRESS 0x2000046A FORMAT "%.15" PHYS_UNIT "%"
 /begin IF_DATA XCP
  /begin DAQ_EVENT FIXED_EVENT_LIST EVENT 0x00 /end DAQ_EVENT
 /end IF_DATA
/end MEASUREMENT
/begin MEASUREMENT Fuel_EngTemp_Comp "" SWORD Enrichment.Conversion 0 0 -99 500 ECU_ADDRESS 0x20000466 PHYS_UNIT "%"
 /begin IF_DATA XCP
  /begin DAQ_EVENT FIXED_EVENT_LIST EVENT 0x00 /end DAQ_EVENT
 /end IF_DATA
/end MEASUREMENT
/begin MEASUREMENT Fuel_Final "" SWORD FP_Hundredth 0 0 0 64 ECU_ADDRESS 0x2000043A FORMAT "%.15" PHYS_UNIT "mg/pulse"
 /begin IF_DATA XCP
  /begin DAQ_EVENT FIXED_EVENT_LIST EVENT 0x00 /end DAQ_EVENT
 /end IF_DATA
/end MEASUREMENT
/begin MEASUREMENT Fuel_Final_Main_DI "" SWORD FP_Hundredth 0 0 -32768 32767 ECU_ADDRESS 0x200004F8 PHYS_UNIT "mg/pulse" /end MEASUREMENT
/begin MEASUREMENT Fuel_OnTime_Comp "" SWORD Enrichment.Conversion 0 0 0 64 ECU_ADDRESS 0x2000046C FORMAT "%.15" PHYS_UNIT "%"
 /begin IF_DATA XCP
  /begin DAQ_EVENT FIXED_EVENT_LIST EVENT 0x00 /end DAQ_EVENT
 /end IF_DATA
/end MEASUREMENT
/begin CHARACTERISTIC GlowPlugCrankingDuty "" VALUE 0x1D086 TorqueMap.Layout 0 NO_COMPU_METHOD 0 100 FORMAT "%.15" PHYS_UNIT "%" /end CHARACTERISTIC
/begin CHARACTERISTIC GlowPlugIatThreshold "" VALUE 0x1D080 __SWORD_S 0 Temperature -32768 32767 FORMAT "%.15" PHYS_UNIT "deg C" /end CHARACTERISTIC
/begin CHARACTERISTIC GlowPlugPreHeatDuty "" VALUE 0x1D084 TorqueMap.Layout 0 NO_COMPU_METHOD 0 100 FORMAT "%.15" PHYS_UNIT "%" /end CHARACTERISTIC
/begin CHARACTERISTIC GlowPlugTime "" VALUE 0x1D082 TorqueMap.Layout 0 FP_Hundredth 0 65535 PHYS_UNIT "s" /end CHARACTERISTIC
/begin CHARACTERISTIC GridHeaterCrankingDuty "" VALUE 0x1D08A TorqueMap.Layout 0 NO_COMPU_METHOD 0 100 FORMAT "%.15" PHYS_UNIT "%" /end CHARACTERISTIC
/begin CHARACTERISTIC GridHeaterPreHeatDuty "" VALUE 0x1D088 TorqueMap.Layout 0 NO_COMPU_METHOD 0 65535 FORMAT "%.15" PHYS_UNIT "%" /end CHARACTERISTIC
/begin CHARACTERISTIC GridHeaterTime "" VALUE 0x1D076 TorqueMap.Layout 0 FP_Hundredth 0 65535 PHYS_UNIT "sec" /end CHARACTERISTIC
/begin CHARACTERISTIC HPFuelPressureGain "" VALUE 0x1CD30 __SWORD_S 0 NO_COMPU_METHOD -32768 32767 FORMAT "%.15" /end CHARACTERISTIC
/begin CHARACTERISTIC HPFuelPressureOffset "" VALUE 0x1CD32 __SWORD_S 0 NO_COMPU_METHOD -32768 32767 FORMAT "%.15" /end CHARACTERISTIC
/begin CHARACTERISTIC IBoost "" VALUE 0x1D062 TorqueMap.Layout 0 FP_Thousandth 0 65535 PHYS_UNIT "A" /end CHARACTERISTIC
/begin CHARACTERISTIC IHold_FPRV "" VALUE 0x1D42E TorqueMap.Layout 0 FP_Thousandth 0 65535 PHYS_UNIT "A" /end CHARACTERISTIC
/begin CHARACTERISTIC IHold_Injector "" VALUE 0x1D066 TorqueMap.Layout 0 FP_Thousandth 0 65535 PHYS_UNIT "A" /end CHARACTERISTIC
/begin CHARACTERISTIC IPeak "" VALUE 0x1D064 TorqueMap.Layout 0 FP_Thousandth 0 65535 PHYS_UNIT "A" /end CHARACTERISTIC
/begin CHARACTERISTIC IdleD "" VALUE 0x1CD04 __UWORD_S 0 FP_Tenth 0 65535 FORMAT "%.15" /end CHARACTERISTIC
/begin CHARACTERISTIC IdleI "" VALUE 0x1CD02 __UWORD_S 0 FP_Tenth 0 65535 FORMAT "%.15" /end CHARACTERISTIC
/begin CHARACTERISTIC IdleP "" VALUE 0x1CD00 __UWORD_S 0 FP_Tenth 0 65535 FORMAT "%.15" /end CHARACTERISTIC
/begin CHARACTERISTIC IdleRoughness "" VALUE 0x1CD0C __UWORD_S 0 NO_COMPU_METHOD 0 500 FORMAT "%.15" /end CHARACTERISTIC
/begin AXIS_PTS IgnEnergyScale "" 0x1CC8C SparkEnergy SSV__UWORD_S 0 FP_Tenth 14 0 100 DEPOSIT ABSOLUTE FORMAT "%.15" MONOTONY MON_INCREASE PHYS_UNIT "mJ" SYMBOL_LINK "IgnEnergyScale._0_" 0 /end AXIS_PTS
/begin MEASUREMENT Inj1_Main_Duration "" UWORD Inj_Duration_Conversion 0 0 0 65535 ECU_ADDRESS 0x200004F2 /end MEASUREMENT
/begin CHARACTERISTIC Inj1_Main_DurationXcp "" VALUE 0x200004FA TorqueMap.Layout 0 Inj_Duration_Conversion 0 65535 /end CHARACTERISTIC
/begin CHARACTERISTIC Inj1_Main_QtyXcp "" VALUE 0x200004FE TorqueMap.Layout 0 FP_Hundredth 0 65535 PHYS_UNIT "mg/pulse" /end CHARACTERISTIC
/begin MEASUREMENT Inj1_Main_TmrOffsetNext "" UWORD NO_COMPU_METHOD 0 0 0 65535 ECU_ADDRESS 0x200010E8 FORMAT "%.15" /end MEASUREMENT
/begin MEASUREMENT Inj1_Main_Tooth "" UWORD NO_COMPU_METHOD 0 0 0 65535 ECU_ADDRESS 0x200010BE /end MEASUREMENT
/begin MEASUREMENT Inj1_Main_ToothNext "" UWORD NO_COMPU_METHOD 0 0 0 65535 ECU_ADDRESS 0x200010CA FORMAT "%.15" /end MEASUREMENT
/begin MEASUREMENT Inj1_Pilot_Duration "" UWORD Inj_Duration_Conversion 0 0 0 65535 ECU_ADDRESS 0x2000043C /end MEASUREMENT
/begin CHARACTERISTIC Inj1_Pilot_DurationXcp "" VALUE 0x200004FC TorqueMap.Layout 0 Inj_Duration_Conversion 0 65535 /end CHARACTERISTIC
/begin CHARACTERISTIC Inj1_Pilot_QtyXcp "" VALUE 0x20000500 TorqueMap.Layout 0 FP_Hundredth 0 65535 PHYS_UNIT "mg/pulse" /end CHARACTERISTIC
/begin MEASUREMENT Inj2_Main_Duration "" UWORD Inj_Duration_Conversion 0 0 0 65535 ECU_ADDRESS 0x200004F4 /end MEASUREMENT
/begin MEASUREMENT Inj2_Main_Tooth "" UWORD NO_COMPU_METHOD 0 0 0 65535 ECU_ADDRESS 0x200010D0 /end MEASUREMENT
/begin CHARACTERISTIC InjectorCalMap2_DI "" MAP 0x1D434 TorqueMap.Layout 0 FP_Thousandth 0 65
 /begin AXIS_DESCR COM_AXIS Fuel_Final FP_Hundredth 10 0 650 AXIS_PTS_REF FuelQtyScale PHYS_UNIT "mg/pulse" /end AXIS_DESCR
 /begin AXIS_DESCR COM_AXIS FuelPressureHP FP_Tenth 14 0 65535 AXIS_PTS_REF FuelPressureScale PHYS_UNIT "bar" /end AXIS_DESCR
 PHYS_UNIT "ms" SYMBOL_LINK "InjectorCalMap2._0_._0_" 0 /end CHARACTERISTIC
/begin CHARACTERISTIC InjectorCalMap_Port_CI "" MAP 0x1C0D8 TorqueMap.Layout 0 FP_Thousandth 0 65
 /begin AXIS_DESCR COM_AXIS Fuel_Final FP_Hundredth 10 0 650 AXIS_PTS_REF FuelQtyScale PHYS_UNIT "mg/pulse" /end AXIS_DESCR
 /begin AXIS_DESCR COM_AXIS FuelPressureHP FP_Tenth 14 0 65535 AXIS_PTS_REF FuelPressureScale PHYS_UNIT "bar" /end AXIS_DESCR
 FORMAT "%.15" PHYS_UNIT "ms" SYMBOL_LINK "InjectorCalMap._0_._0_" 0 /end CHARACTERISTIC
/begin MEASUREMENT Kd "" UWORD NO_COMPU_METHOD 0 0 0 4294967295 ECU_ADDRESS 0x20000450 FORMAT "%.15"
 /begin IF_DATA XCP
  /begin DAQ_EVENT FIXED_EVENT_LIST EVENT 0x00 /end DAQ_EVENT
 /end IF_DATA
/end MEASUREMENT
/begin MEASUREMENT Ki "" UWORD NO_COMPU_METHOD 0 0 0 4294967295 ECU_ADDRESS 0x2000044E FORMAT "%.15"
 /begin IF_DATA XCP
  /begin DAQ_EVENT FIXED_EVENT_LIST EVENT 0x00 /end DAQ_EVENT
 /end IF_DATA
/end MEASUREMENT
/begin MEASUREMENT KnockSensor "" UWORD FP_Thousandth 0 0 0 65535 ECU_ADDRESS 0x2000041E PHYS_UNIT "V" /end MEASUREMENT
/begin MEASUREMENT Kp "" UWORD NO_COMPU_METHOD 0 0 0 4294967295 ECU_ADDRESS 0x2000044C FORMAT "%.15"
 /begin IF_DATA XCP
  /begin DAQ_EVENT FIXED_EVENT_LIST EVENT 0x00 /end DAQ_EVENT
 /end IF_DATA
/end MEASUREMENT
/begin CHARACTERISTIC LPFuelPressureGain "" VALUE 0x1CD34 __SWORD_S 0 NO_COMPU_METHOD -32768 32767 FORMAT "%.15" /end CHARACTERISTIC
/begin CHARACTERISTIC LPFuelPressureOffset "" VALUE 0x1CD36 __SWORD_S 0 NO_COMPU_METHOD -32768 32767 FORMAT "%.15" /end CHARACTERISTIC
/begin CHARACTERISTIC LP_FuelPumpCtrl "" VALUE 0x1D42C __SBYTE_S 0 LP_FuelPumpCtrl.CONVERSION -128 127 FORMAT "%6.3" /end CHARACTERISTIC
/begin MEASUREMENT Map "" UWORD NO_COMPU_METHOD 0 0 0 65535 ECU_ADDRESS 0x20000426 FORMAT "%5.0" PHYS_UNIT "mbar" /end MEASUREMENT
/begin MEASUREMENT MapCrank "" UWORD MapCrank.Conversion 0 0 0 65535 ECU_ADDRESS 0x20000474 FORMAT "%.15" LAYOUT ROW_DIR MATRIX_DIM 23 PHYS_UNIT "mbar" SYMBOL_LINK "MapCrank._0_" 0
 /begin IF_DATA XCP
  /begin DAQ_EVENT FIXED_EVENT_LIST EVENT 0x00 /end DAQ_EVENT
 /end IF_DATA
/end MEASUREMENT
/begin CHARACTERISTIC MapGain "" VALUE 0x1CD2C __SWORD_S 0 Volt_ATD 0 1000 FORMAT "%.15" PHYS_UNIT "mbar/mV" /end CHARACTERISTIC
/begin CHARACTERISTIC MapOffset "" VALUE 0x1CD2E __SWORD_S 0 NO_COMPU_METHOD 0 65535 FORMAT "%.15" PHYS_UNIT "mbar" /end CHARACTERISTIC
/begin AXIS_PTS MapScale "" 0x1CC2C NO_INPUT_QUANTITY SSV__UWORD_S 0 NO_COMPU_METHOD 14 0 1200 DEPOSIT ABSOLUTE FORMAT "%.15" MONOTONY MON_INCREASE PHYS_UNIT "mbar" SYMBOL_LINK "MapScale._0_" 0 /end AXIS_PTS
/begin CHARACTERISTIC MinDwell "" VALUE 0x1C0D4 __ULONG_S 0 FP_Thousandth 100 5000 PHYS_UNIT "ms" /end CHARACTERISTIC
/begin MEASUREMENT OilPressure "" UWORD FP_Tenth 0 0 0 65535 ECU_ADDRESS 0x20000412 FORMAT "%4.0" PHYS_UNIT "kPa" /end MEASUREMENT
/begin CHARACTERISTIC OilPressureGain "" VALUE 0x1CD38 __SWORD_S 0 NO_COMPU_METHOD -32768 32767 FORMAT "%.15" /end CHARACTERISTIC
/begin CHARACTERISTIC OilPressureOffset "" VALUE 0x1CD3A __SWORD_S 0 NO_COMPU_METHOD -32768 32767 FORMAT "%.15" /end CHARACTERISTIC
/begin MEASUREMENT OilTemp "" SWORD FP_Tenth 0 0 -40 300 ECU_ADDRESS 0x20000410 FORMAT "%3.1" PHYS_UNIT "deg C" /end MEASUREMENT
/begin AXIS_PTS OilTempCalATD._0_ "" 0x1CF98 NO_INPUT_QUANTITY TorqueScale.Layout 0 NO_COMPU_METHOD 50 -32768 32767 DEPOSIT ABSOLUTE FORMAT "%.15" /end AXIS_PTS
/begin CHARACTERISTIC OilTempCalScale "" CURVE 0x1CFFC __SWORD_Z 0 NO_COMPU_METHOD -32768 32767
 /begin AXIS_DESCR COM_AXIS NO_INPUT_QUANTITY NO_COMPU_METHOD 50 -32768 32767 AXIS_PTS_REF OilTempCalATD._0_ FORMAT "%.15" /end AXIS_DESCR
 FORMAT "%.15" SYMBOL_LINK "OilTempCalScale._0_" 0 /end CHARACTERISTIC
/begin CHARACTERISTIC OnTimeCompCurve "" CURVE 0x1CCC4 __UWORD_S 0 Enrichment.Conversion 0 500
 /begin AXIS_DESCR COM_AXIS EngTemp Temperature 14 -70 1000 AXIS_PTS_REF TempScale FORMAT "%.15" /end AXIS_DESCR
 PHYS_UNIT "% Enrichment" SYMBOL_LINK "OnTimeCompCurve._0_" 0 /end CHARACTERISTIC
/begin CHARACTERISTIC OnTimeDecay "" VALUE 0x1CCFE __UWORD_S 0 NO_COMPU_METHOD 0 60000 FORMAT "%.3" /end CHARACTERISTIC
/begin MEASUREMENT OpMode "" SBYTE OpMode.CONVERSION 0 0 0 65535 ECU_ADDRESS 0x20000438 FORMAT "%6.3"
 /begin IF_DATA XCP
  /begin DAQ_EVENT FIXED_EVENT_LIST EVENT 0x00 /end DAQ_EVENT
 /end IF_DATA
/end MEASUREMENT
/begin MEASUREMENT Output_GlowPlug "" SBYTE Output_GlowPlug.CONVERSION 0 0 -128 127 ECU_ADDRESS 0x200004C6 FORMAT "%6.3" /end MEASUREMENT
/begin CHARACTERISTIC Output_GlowPlug_Xcp "" VALUE 0x200004CB __SBYTE_S 0 Output_GlowPlug.CONVERSION -128 127 FORMAT "%6.3" /end CHARACTERISTIC
/begin MEASUREMENT Output_HsOut1 "" SBYTE Output_GlowPlug.CONVERSION 0 0 -128 127 ECU_ADDRESS 0x200004C4 FORMAT "%6.3" /end MEASUREMENT
/begin CHARACTERISTIC Output_HsOut1_Xcp "" VALUE 0x200004C9 __SBYTE_S 0 Output_GlowPlug.CONVERSION -128 127 FORMAT "%6.3" /end CHARACTERISTIC
/begin MEASUREMENT Output_HsOut2 "" SBYTE Output_GlowPlug.CONVERSION 0 0 -128 127 ECU_ADDRESS 0x200004C5 FORMAT "%6.3" /end MEASUREMENT
/begin CHARACTERISTIC Output_HsOut2_Xcp "" VALUE 0x200004CA __SBYTE_S 0 Output_GlowPlug.CONVERSION -128 127 FORMAT "%6.3" /end CHARACTERISTIC
/begin MEASUREMENT Output_Mil "" SBYTE Output_GlowPlug.CONVERSION 0 0 -128 127 ECU_ADDRESS 0x200004C3 FORMAT "%6.3" /end MEASUREMENT
/begin CHARACTERISTIC Output_Mil_Xcp "" VALUE 0x200004C8 __SBYTE_S 0 Output_GlowPlug.CONVERSION -128 127 FORMAT "%6.3" /end CHARACTERISTIC
/begin MEASUREMENT Output_Starter "" SBYTE Output_GlowPlug.CONVERSION 0 0 -128 127 ECU_ADDRESS 0x200004C7 FORMAT "%6.3" /end MEASUREMENT
/begin CHARACTERISTIC Output_Starter_Xcp "" VALUE 0x200004CC __SBYTE_S 0 Output_GlowPlug.CONVERSION -128 127 FORMAT "%6.3" /end CHARACTERISTIC
/begin CHARACTERISTIC PCR_OvershootCut_In_Pressure "" VALUE 0x1D428 __SWORD_S 0 FP_Tenth 0 6000 PHYS_UNIT "bar" /end CHARACTERISTIC
/begin CHARACTERISTIC PCR_OvershootCut_Out_Pressure "" VALUE 0x1D42A __SWORD_S 0 FP_Tenth 0 6000 PHYS_UNIT "bar" /end CHARACTERISTIC
/begin MEASUREMENT PcrDuty "" UWORD FP_Tenth 0 0 0 100 ECU_ADDRESS 0x200004E2 PHYS_UNIT "%" /end MEASUREMENT
/begin CHARACTERISTIC PcrValveMaxDuty "" VALUE 0x1D432 TorqueMap.Layout 0 FP_Tenth 0 65535 PHYS_UNIT "%" /end CHARACTERISTIC
/begin CHARACTERISTIC PreHeatIatThreshold "" VALUE 0x1D074 __SWORD_S 0 Temperature -32768 32767 PHYS_UNIT "deg C" /end CHARACTERISTIC
/begin MEASUREMENT PwmGlowPlug "" UWORD NO_COMPU_METHOD 0 0 0 65535 ECU_ADDRESS 0x20000F34 FORMAT "%.15" PHYS_UNIT "%" /end MEASUREMENT
/begin MEASUREMENT PwmGridHeater "" UWORD NO_COMPU_METHOD 0 0 0 65535 ECU_ADDRESS 0x20000F36 FORMAT "%.15" PHYS_UNIT "%" /end MEASUREMENT
/begin MEASUREMENT RPM "" SLONG SAERPM.Conversion 0 0 0 8000 ECU_ADDRESS 0x20000434 PHYS_UNIT "RPM"
 /begin IF_DATA XCP
  /begin DAQ_EVENT FIXED_EVENT_LIST EVENT 0x00 /end DAQ_EVENT
 /end IF_DATA
/end MEASUREMENT
/begin MEASUREMENT ResetCounter "" ULONG FP_Hundredth 0 0 0 4294967295 ECU_ADDRESS 0x20000510 PHYS_UNIT "s" /end MEASUREMENT
/begin CHARACTERISTIC RevPerCycle "revolutions per cycle 2/4 stroke" VALUE 0x1C0D2 __UBYTE_S 0 NO_COMPU_METHOD 0 4294967295 FORMAT "%.15" /end CHARACTERISTIC
/begin MEASUREMENT Roughness "" UWORD NO_COMPU_METHOD 0 0 0 4294967295 ECU_ADDRESS 0x20000452 FORMAT "%.15"
 /begin IF_DATA XCP
  /begin DAQ_EVENT FIXED_EVENT_LIST EVENT 0x00 /end DAQ_EVENT
 /end IF_DATA
/end MEASUREMENT
/begin CHARACTERISTIC RoughnessTC "" VALUE 0x1CD20 __ULONG_S 0 NO_COMPU_METHOD 0 4294967295 FORMAT "%.15" /end CHARACTERISTIC
/begin MEASUREMENT RpmDes "" UWORD SAERPM.Conversion 0 0 0 65535 ECU_ADDRESS 0x2000042C PHYS_UNIT "RPM" /end MEASUREMENT
/begin CHARACTERISTIC RpmDesTimeConstant "" VALUE 0x1CD10 __UWORD_S 0 NO_COMPU_METHOD 0 65535 FORMAT "%.15" /end CHARACTERISTIC
/begin CHARACTERISTIC RpmDesXCP "" VALUE 0x20000406 TorqueMap.Layout 0 SAERPM.Conversion 0 65535 PHYS_UNIT "RPM" /end CHARACTERISTIC
/begin CHARACTERISTIC RpmLimitHysteresis "" VALUE 0x1CD1C __ULONG_S 0 SAERPM.Conversion 0 4294967295 FORMAT "%.15" PHYS_UNIT "RPM" /end CHARACTERISTIC
/begin CHARACTERISTIC RpmLimitOverSpeed "" VALUE 0x1CD14 __ULONG_S 0 SAERPM.Conversion 0 4294967295 PHYS_UNIT "RPM" /end CHARACTERISTIC
/begin CHARACTERISTIC RpmLimitShutdown "" VALUE 0x1CD18 __ULONG_S 0 SAERPM.Conversion 0 4294967295 FORMAT "%.15" PHYS_UNIT "RPM" /end CHARACTERISTIC
/begin AXIS_PTS RpmScale "" 0x1CBCC RPM SSV__ULONG_S 0 SAERPM.Conversion 10 0 8000 DEPOSIT ABSOLUTE MONOTONY MON_INCREASE PHYS_UNIT "RPM" SYMBOL_LINK "RpmScale._0_" 0 /end AXIS_PTS
/begin CHARACTERISTIC RunD "" VALUE 0x1CD0A __UWORD_S 0 FP_Tenth 0 65535 FORMAT "%.15" /end CHARACTERISTIC
/begin MEASUREMENT RunHours "" ULONG FP_Hundredth 0 0 0 4294967295 ECU_ADDRESS 0x20000470 PHYS_UNIT "hr" /end MEASUREMENT
/begin CHARACTERISTIC RunI "" VALUE 0x1CD08 __UWORD_S 0 FP_Tenth 0 65535 FORMAT "%.15" /end CHARACTERISTIC
/begin CHARACTERISTIC RunP "" VALUE 0x1CD06 __UWORD_S 0 FP_Tenth 0 65535 FORMAT "%.15" /end CHARACTERISTIC
/begin CHARACTERISTIC RunRoughness "" VALUE 0x1CD0E __UWORD_S 0 NO_COMPU_METHOD 0 5000 FORMAT "%.15" /end CHARACTERISTIC
/begin CHARACTERISTIC ServoClosed "" VALUE 0x1CD24 __SWORD_S 0 NO_COMPU_METHOD -3000 3000 EXTENDED_LIMITS -4000 4000 FORMAT "%.15" /end CHARACTERISTIC
/begin MEASUREMENT ServoPulseWidth "" UWORD FP_Thousandth 0 0 1000 3000 ECU_ADDRESS 0x20000444 FORMAT "%1.3" PHYS_UNIT "ms"
 /begin IF_DATA XCP
  /begin DAQ_EVENT FIXED_EVENT_LIST EVENT 0x00 /end DAQ_EVENT
 /end IF_DATA
/end MEASUREMENT
/begin CHARACTERISTIC ServoSpan "" VALUE 0x1CD26 __SWORD_S 0 NO_COMPU_METHOD 0 3000 EXTENDED_LIMITS -4000 4000 FORMAT "%.15" /end CHARACTERISTIC
/begin CHARACTERISTIC ShutdownXCP "" VALUE 0x20000408 __UBYTE_S 0 ShutdownXCP.Conversion 0 65535 /end CHARACTERISTIC
/begin CHARACTERISTIC SparkCutGov "Speed control error at which spark is cut during overspeed." VALUE 0x1D060 __SWORD_S 0 SparkCutGov.Conversion 0 2000 PHYS_UNIT "RPM" /end CHARACTERISTIC
/begin MEASUREMENT SparkDwell "" UWORD FP_Thousandth 0 0 0 15 ECU_ADDRESS 0x2000044A FORMAT "%.15" PHYS_UNIT "ms"
 /begin IF_DATA XCP
  /begin DAQ_EVENT FIXED_EVENT_LIST EVENT 0x00 /end DAQ_EVENT
 /end IF_DATA
/end MEASUREMENT
/begin CHARACTERISTIC SparkDwellMap "" MAP 0x1C99C __UWORD_Z 0 FP_Thousandth 0 20
 /begin AXIS_DESCR COM_AXIS SystemVoltage FP_Hundredth 10 0 36 AXIS_PTS_REF VoltageScale PHYS_UNIT "V" /end AXIS_DESCR
 /begin AXIS_DESCR COM_AXIS SparkEnergy FP_Tenth 14 0 100 AXIS_PTS_REF IgnEnergyScale FORMAT "%.15" PHYS_UNIT "mJ" /end AXIS_DESCR
 PHYS_UNIT "ms" SYMBOL_LINK "SparkDwellMap._0_._0_" 0 /end CHARACTERISTIC
/begin MEASUREMENT SparkEnergy "" UWORD FP_Tenth 0 0 0 100 ECU_ADDRESS 0x20000448 FORMAT "%.15" PHYS_UNIT "mJ"
 /begin IF_DATA XCP
  /begin DAQ_EVENT FIXED_EVENT_LIST EVENT 0x00 /end DAQ_EVENT
 /end IF_DATA
/end MEASUREMENT
/begin CHARACTERISTIC SparkEnergyMap "" MAP 0x1C884 __UWORD_Z 0 FP_Tenth 0 90
 /begin AXIS_DESCR COM_AXIS RPM SAERPM.Conversion 10 0 8000 AXIS_PTS_REF RpmScale PHYS_UNIT "RPM" /end AXIS_DESCR
 /begin AXIS_DESCR COM_AXIS ThrottlePosDes FP_Tenth 14 0 100 AXIS_PTS_REF ThrottleScale PHYS_UNIT "% Throttle" /end AXIS_DESCR
 PHYS_UNIT "mJ" SYMBOL_LINK "SparkEnergyMap._0_._0_" 0 /end CHARACTERISTIC
/begin CHARACTERISTIC SparkOffsetXCP "" VALUE 0x20000402 __SWORD_S 0 FP_Tenth -80 80 FORMAT "%.15" PHYS_UNIT "deg Advance" /end CHARACTERISTIC
/begin MEASUREMENT SparkTiming "" SWORD SparkTiming.Conversion 0 0 -80 80 ECU_ADDRESS 0x20000440 FORMAT "%.15" PHYS_UNIT "deg BTDC"
 /begin IF_DATA XCP
  /begin DAQ_EVENT FIXED_EVENT_LIST EVENT 0x00 /end DAQ_EVENT
 /end IF_DATA
/end MEASUREMENT
/begin CHARACTERISTIC SparkTimingMap "" MAP 0x1C76C __SWORD_Z 0 SparkTiming.Conversion -80 80
 /begin AXIS_DESCR COM_AXIS RPM SAERPM.Conversion 10 0 8000 AXIS_PTS_REF RpmScale PHYS_UNIT "RPM" /end AXIS_DESCR
 /begin AXIS_DESCR COM_AXIS ThrottlePosDes FP_Tenth 14 0 100 AXIS_PTS_REF ThrottleScale PHYS_UNIT "% Throttle" /end AXIS_DESCR
 PHYS_UNIT "deg BTDC" SYMBOL_LINK "SparkTimingMap._0_._0_" 0 /end CHARACTERISTIC
/begin CHARACTERISTIC StartMode "" VALUE 0x1D07A __SBYTE_S 0 StartMode.CONVERSION -128 127 FORMAT "%6.3" /end CHARACTERISTIC
/begin MEASUREMENT StartState "" SBYTE Table_15 0 0 -128 127 ECU_ADDRESS 0x200013F4 /end MEASUREMENT
/begin MEASUREMENT StarterTimer "" UWORD FP_Hundredth 0 0 0 65535 ECU_ADDRESS 0x2000100A PHYS_UNIT "sec" /end MEASUREMENT
/begin CHARACTERISTIC StartingTorque "" VALUE 0x1CCFC __UWORD_S 0 FP_Tenth -40 100 FORMAT "%.15" PHYS_UNIT "% Torque" /end CHARACTERISTIC
/begin MEASUREMENT SystemVoltage "" UWORD FP_Hundredth 0 0 0 36 ECU_ADDRESS 0x20000416 FORMAT "%.15" PHYS_UNIT "V"
 /begin IF_DATA XCP
  /begin DAQ_EVENT FIXED_EVENT_LIST EVENT 0x00 /end DAQ_EVENT
 /end IF_DATA
/end MEASUREMENT
/begin CHARACTERISTIC TBypass "" VALUE 0x1D06C TorqueMap.Layout 0 NO_COMPU_METHOD 0 65535 FORMAT "%.15" PHYS_UNIT "microsec" /end CHARACTERISTIC
/begin CHARACTERISTIC THoldOff "" VALUE 0x1D06E TorqueMap.Layout 0 NO_COMPU_METHOD 0 65535 FORMAT "%.15" PHYS_UNIT "microsec" /end CHARACTERISTIC
/begin CHARACTERISTIC THoldTot "" VALUE 0x1D070 TorqueMap.Layout 0 NO_COMPU_METHOD 0 65535 FORMAT "%.15" PHYS_UNIT "microsec" /end CHARACTERISTIC
/begin CHARACTERISTIC TPeakOff "" VALUE 0x1D068 TorqueMap.Layout 0 NO_COMPU_METHOD 0 65535 FORMAT "%.15" PHYS_UNIT "microsec" /end CHARACTERISTIC
/begin CHARACTERISTIC TPeakTot "" VALUE 0x1D06A TorqueMap.Layout 0 NO_COMPU_METHOD 0 65535 FORMAT "%.15" PHYS_UNIT "microsec" /end CHARACTERISTIC
/begin AXIS_PTS TempScale "" 0x1CC48 EngTemp SSV__SWORD_S 0 Temperature 14 -70 1000 DEPOSIT ABSOLUTE FORMAT "%.15" MONOTONY MON_INCREASE SYMBOL_LINK "TempScale._0_" 0 /end AXIS_PTS
/begin CHARACTERISTIC ThrotDesXCP "" VALUE 0x20000404 __UWORD_S 0 FP_Tenth 0 100 PHYS_UNIT "% Throttle" /end CHARACTERISTIC
/begin MEASUREMENT ThrottlePosDes "" UWORD FP_Tenth 0 0 0 100 ECU_ADDRESS 0x20000442 PHYS_UNIT "% Throttle"
 /begin IF_DATA XCP
  /begin DAQ_EVENT FIXED_EVENT_LIST EVENT 0x00 /end DAQ_EVENT
 /end IF_DATA
/end MEASUREMENT
/begin AXIS_PTS ThrottleScale "" 0x1CBF4 ThrottlePosDes SSV__UWORD_S 0 FP_Tenth 14 0 100 DEPOSIT ABSOLUTE MONOTONY MON_INCREASE PHYS_UNIT "% Throttle" SYMBOL_LINK "ThrottleScale._0_" 0 /end AXIS_PTS
/begin MEASUREMENT ToothOffset "" UWORD NO_COMPU_METHOD 0 0 0 65535 ECU_ADDRESS 0x200013EE FORMAT "%.15" /end MEASUREMENT
/begin MEASUREMENT TorqDiff "" SLONG FP_Tenth 0 0 -40 100 ECU_ADDRESS 0x2000045C FORMAT "%.15" PHYS_UNIT "% Torque"
 /begin IF_DATA XCP
  /begin DAQ_EVENT FIXED_EVENT_LIST EVENT 0x00 /end DAQ_EVENT
 /end IF_DATA
/end MEASUREMENT
/begin MEASUREMENT TorqInteg "" SLONG TorqInteg.Conversion 0 0 -40 100 ECU_ADDRESS 0x20000458 FORMAT "%3.1" PHYS_UNIT "% Torque"
 /begin IF_DATA XCP
  /begin DAQ_EVENT FIXED_EVENT_LIST EVENT 0x00 /end DAQ_EVENT
 /end IF_DATA
/end MEASUREMENT
/begin MEASUREMENT TorqProp "" SLONG TorqProp.Conversion 0 0 -40 100 ECU_ADDRESS 0x20000454 FORMAT "%.15" PHYS_UNIT "% Torque"
 /begin IF_DATA XCP
  /begin DAQ_EVENT FIXED_EVENT_LIST EVENT 0x00 /end DAQ_EVENT
 /end IF_DATA
/end MEASUREMENT
/begin MEASUREMENT Torque "" SWORD FP_Tenth 0 0 -40 100 ECU_ADDRESS 0x20000446 FORMAT "%.15" PHYS_UNIT "% Torque"
 /begin IF_DATA XCP
  /begin DAQ_EVENT FIXED_EVENT_LIST EVENT 0x00 /end DAQ_EVENT
 /end IF_DATA
/end MEASUREMENT
/begin MEASUREMENT TorqueFeedForward "" SWORD FP_Tenth 0 0 -40 100 ECU_ADDRESS 0x2000042E PHYS_UNIT "% Torque"
 /begin IF_DATA XCP
  /begin DAQ_EVENT FIXED_EVENT_LIST EVENT 0x00 /end DAQ_EVENT
 /end IF_DATA
/end MEASUREMENT
/begin CHARACTERISTIC TorqueMap "" MAP 0x1CAB4 TorqueMap.Layout 0 FP_Tenth -40 100
 /begin AXIS_DESCR COM_AXIS RPM SAERPM.Conversion 10 0 8000 AXIS_PTS_REF RpmScale PHYS_UNIT "RPM" /end AXIS_DESCR
 /begin AXIS_DESCR COM_AXIS Torque FP_Tenth 14 -40 100 AXIS_PTS_REF TorqueScale PHYS_UNIT "%" /end AXIS_DESCR
 PHYS_UNIT "% Torque" SYMBOL_LINK "TorqueMap._0_._0_" 0 /end CHARACTERISTIC
/begin AXIS_PTS TorqueScale "" 0x1CC10 Torque TorqueScale.Layout 0 FP_Tenth 14 -40 100 DEPOSIT ABSOLUTE PHYS_UNIT "%" SYMBOL_LINK "TorqueScale._0_" 0 /end AXIS_PTS
/begin MEASUREMENT Tps "" UWORD FP_Tenth 0 0 0 65535 ECU_ADDRESS 0x20000428 PHYS_UNIT "%" /end MEASUREMENT
/begin CHARACTERISTIC TpsMax "" VALUE 0x1CE04 __SWORD_S 0 Volt_ATD 0 5000 FORMAT "%.15" PHYS_UNIT "V" /end CHARACTERISTIC
/begin CHARACTERISTIC TpsMin "" VALUE 0x1CE06 __SWORD_S 0 Volt_ATD 0 5000 FORMAT "%.15" PHYS_UNIT "V" /end CHARACTERISTIC
/begin CHARACTERISTIC TriggerPos "deg TDC after missing teeth, trigger 1" VALUE 0x1C0D0 __UWORD_S 0 FP_Tenth 0 4294967295 PHYS_UNIT "deg" /end CHARACTERISTIC
/begin CHARACTERISTIC VBoost "" VALUE 0x1D08C TorqueMap.Layout 0 FP_Tenth 0 72 PHYS_UNIT "V" /end CHARACTERISTIC
/begin AXIS_PTS VoltageScale "" 0x1CC64 SystemVoltage SSV__ULONG_S 0 FP_Hundredth 10 0 36 DEPOSIT ABSOLUTE PHYS_UNIT "V" SYMBOL_LINK "VoltageScale._0_" 0 /end AXIS_PTS
/begin MEASUREMENT crankFaultSource "" SBYTE Table_13_Copy1 0 0 -128 127 ECU_ADDRESS 0x2000100C /end MEASUREMENT
/begin MEASUREMENT fuelPresHP "" UWORD FP_Tenth 0 0 0 65535 ECU_ADDRESS 0x20001070 PHYS_UNIT "bar" /end MEASUREMENT
/begin MEASUREMENT glowPlugTimer "" UWORD FP_Hundredth 0 0 0 65535 ECU_ADDRESS 0x20001052 PHYS_UNIT "s" /end MEASUREMENT
/begin MEASUREMENT gridHeaterTimer "" UWORD FP_Hundredth 0 0 0 65535 ECU_ADDRESS 0x20001050 PHYS_UNIT "sec" /end MEASUREMENT
/begin COMPU_METHOD CHT1_High.Conversion "" TAB_VERB "%6.3" "" COMPU_TAB_REF CHT1_High.Conversion.Table /end COMPU_METHOD
/begin COMPU_METHOD CamTrigger.CONVERSION "enumeration table" TAB_VERB "%.0" "" COMPU_TAB_REF CamTrigger.CONVERSION /end COMPU_METHOD
/begin COMPU_METHOD ClosedLoopEgtOperation.Conversion "" TAB_VERB "%6.3" "" COMPU_TAB_REF ClosedLoopEgtOperation.Conversion.Table /end COMPU_METHOD
/begin COMPU_METHOD Crank.Conversion "" TAB_VERB "%6.3" "" COMPU_TAB_REF Crank.Conversion.Table /end COMPU_METHOD
/begin COMPU_METHOD CrankActive.CONVERSION "enumeration table" TAB_VERB "%.0" "" COMPU_TAB_REF CrankActive.CONVERSION /end COMPU_METHOD
/begin COMPU_METHOD CrankState.CONVERSION "enumeration table" TAB_VERB "%.0" "" COMPU_TAB_REF CrankState.CONVERSION /end COMPU_METHOD
/begin COMPU_METHOD CrankState.CONVERSION.OLD_Copy1 "enumeration table" TAB_VERB "%.0" "" COMPU_TAB_REF CrankState.CONVERSION.OLD_1 /end COMPU_METHOD
/begin COMPU_METHOD CrankState.CONVERSION.OLD_Copy2 "enumeration table" TAB_VERB "%.0" "" COMPU_TAB_REF CrankState.CONVERSION.OLD_2 /end COMPU_METHOD
/begin COMPU_METHOD CrankState.Conversion "" TAB_VERB "%6.3" "" COMPU_TAB_REF CrankState.Conversion.Table /end COMPU_METHOD
/begin COMPU_METHOD DerateOverride.Conversion "" TAB_VERB "%6.3" "" COMPU_TAB_REF DerateOverride.Conversion.Table /end COMPU_METHOD
/begin COMPU_METHOD DigitalIn1.CONVERSION "enumeration table" TAB_VERB "%.0" "" COMPU_TAB_REF DigitalIn1.CONVERSION /end COMPU_METHOD
/begin COMPU_METHOD DigitalIn1.CONVERSION.OLD_Copy1 "enumeration table" TAB_VERB "%.0" "" COMPU_TAB_REF DigitalIn1.CONVERSION.OLD_1 /end COMPU_METHOD
/begin COMPU_METHOD EGT.Conversion "" LINEAR "%6.3" "" COEFFS_LINEAR 0.25 0 /end COMPU_METHOD
/begin COMPU_METHOD EgtState "enumeration table" TAB_VERB "%.0" "" COMPU_TAB_REF EgtState /end COMPU_METHOD
/begin COMPU_METHOD EgtState.OLD_Copy1 "" TAB_VERB "%6.3" "" COMPU_TAB_REF EgtState.OLD_1 /end COMPU_METHOD
/begin COMPU_METHOD EngineStateCmd.CONVERSION "enumeration table" TAB_VERB "%.0" "" COMPU_TAB_REF EngineStateCmd.CONVERSION /end COMPU_METHOD
/begin COMPU_METHOD EngineStateCmd.CONVERSION.OLD_Copy1 "enumeration table" TAB_VERB "%.0" "" COMPU_TAB_REF EngineStateCmd.CONVERSION.OLD_1 /end COMPU_METHOD
/begin COMPU_METHOD EngineStateCmd.Conversion "" TAB_VERB "%6.3" "" COMPU_TAB_REF EngineStateCmd.Conversion.Table /end COMPU_METHOD
/begin COMPU_METHOD Enrichment.Conversion "" LINEAR "%6.3" "" COEFFS_LINEAR 0.1 -100 /end COMPU_METHOD
/begin COMPU_METHOD Errors.Conversion "" TAB_VERB "%6.3" "" COMPU_TAB_REF Errors.Conversion.Table /end COMPU_METHOD
/begin COMPU_METHOD FP_HundredThousandth "" LINEAR "%6.3" "" COEFFS_LINEAR 1E-05 0 /end COMPU_METHOD
/begin COMPU_METHOD FP_Hundredth "" LINEAR "%6.3" "" COEFFS_LINEAR 0.01 0 /end COMPU_METHOD
/begin COMPU_METHOD FP_TenThousandth "" LINEAR "%6.3" "" COEFFS_LINEAR 0.0001 0 /end COMPU_METHOD
/begin COMPU_METHOD FP_Tenth "" LINEAR "%6.3" "" COEFFS_LINEAR 0.1 0 /end COMPU_METHOD
/begin COMPU_METHOD FP_Thousandth "" LINEAR "%6.3" "" COEFFS_LINEAR 0.001 0 /end COMPU_METHOD
/begin COMPU_METHOD FW_Version.Conversion "" TAB_NOINTP "%6.3" "" COMPU_TAB_REF __ /end COMPU_METHOD
/begin COMPU_METHOD FuelMapType.CONVERSION "enumeration table" TAB_VERB "%.0" "" COMPU_TAB_REF FuelMapType.CONVERSION /end COMPU_METHOD
/begin COMPU_METHOD FuelMapType.Conversion "" TAB_VERB "%6.3" "" COMPU_TAB_REF FuelMapType.Conversion.Table /end COMPU_METHOD
/begin COMPU_METHOD FuelOffsetXCP.Conversion "" LINEAR "%6.3" "" COEFFS_LINEAR 0.1 -100 /end COMPU_METHOD
/begin COMPU_METHOD FuelPressureControlMode.CONVERSION "enumeration table" TAB_VERB "%.0" "" COMPU_TAB_REF FuelPressureControlMode.CONVERSION /end COMPU_METHOD
/begin COMPU_METHOD FuelStrategy.CONVERSION "enumeration table" TAB_VERB "%.0" "" COMPU_TAB_REF FuelStrategy.CONVERSION /end COMPU_METHOD
/begin COMPU_METHOD GovMode.Conversion "" TAB_VERB "%6.3" "" COMPU_TAB_REF GovMode.Conversion.Table /end COMPU_METHOD
/begin COMPU_METHOD Inj_Duration_Conversion "" LINEAR "%6.3" "ms" COEFFS_LINEAR 0.0008 0 /end COMPU_METHOD
/begin COMPU_METHOD LP_FuelPumpCtrl.CONVERSION "enumeration table" TAB_VERB "%.0" "" COMPU_TAB_REF LP_FuelPumpCtrl.CONVERSION /end COMPU_METHOD
/begin COMPU_METHOD LP_FuelPumpCtrl.CONVERSION.OLD_Copy1 "enumeration table" TAB_VERB "%.0" "" COMPU_TAB_REF LP_FuelPumpCtrl.CONVERSION.OLD_1 /end COMPU_METHOD
/begin COMPU_METHOD MapCrank.Conversion "" LINEAR "%6.3" "" COEFFS_LINEAR 0.271 105 /end COMPU_METHOD
/begin COMPU_METHOD OpMode.CONVERSION "enumeration table" TAB_VERB "%.0" "" COMPU_TAB_REF OpMode.CONVERSION /end COMPU_METHOD
/begin COMPU_METHOD OpMode.CONVERSION.OLD_Copy1 "enumeration table" TAB_VERB "%.0" "" COMPU_TAB_REF OpMode.CONVERSION.OLD_1 /end COMPU_METHOD
/begin COMPU_METHOD OpMode.CONVERSION.OLD_Copy2 "enumeration table" TAB_VERB "%.0" "" COMPU_TAB_REF OpMode.CONVERSION.OLD_2 /end COMPU_METHOD
/begin COMPU_METHOD OpMode.Conversion "" TAB_VERB "%6.3" "" COMPU_TAB_REF OpMode.Conversion.Table /end COMPU_METHOD
/begin COMPU_METHOD Output_GlowPlug.CONVERSION "enumeration table" TAB_VERB "%.0" "" COMPU_TAB_REF Output_GlowPlug.CONVERSION /end COMPU_METHOD
/begin COMPU_METHOD SAERPM.Conversion "" LINEAR "%6.3" "" COEFFS_LINEAR 0.125 0 /end COMPU_METHOD
/begin COMPU_METHOD ShutdownXCP.Conversion "" TAB_VERB "%6.3" "" COMPU_TAB_REF ShutdownXCP.Conversion.Table /end COMPU_METHOD
/begin COMPU_METHOD SparkCutGov.Conversion "" LINEAR "%6.3" "" COEFFS_LINEAR -1 0 /end COMPU_METHOD
/begin COMPU_METHOD SparkTiming.Conversion "" LINEAR "%6.3" "deg" COEFFS_LINEAR -0.1 0 /end COMPU_METHOD
/begin COMPU_METHOD SpiState "enumeration table" TAB_VERB "%.0" "" COMPU_TAB_REF SpiState /end COMPU_METHOD
/begin COMPU_METHOD SpiState.OLD_Copy1 "" TAB_VERB "%6.3" "" COMPU_TAB_REF SpiState.OLD_1 /end COMPU_METHOD
/begin COMPU_METHOD SpiState.OLD_Copy2 "enumeration table" TAB_VERB "%.0" "" COMPU_TAB_REF SpiState.OLD_2 /end COMPU_METHOD
/begin COMPU_METHOD StartMode.CONVERSION "enumeration table" TAB_VERB "%.0" "" COMPU_TAB_REF StartMode.CONVERSION /end COMPU_METHOD
/begin COMPU_METHOD Table_0 "" TAB_VERB "%6.3" "" COMPU_TAB_REF Table_0 /end COMPU_METHOD
/begin COMPU_METHOD Table_1 "" TAB_VERB "%6.3" "" COMPU_TAB_REF Table_1 /end COMPU_METHOD
/begin COMPU_METHOD Table_10 "" TAB_VERB "%6.3" "" COMPU_TAB_REF Table_10 /end COMPU_METHOD
/begin COMPU_METHOD Table_10._Copy1 "" TAB_VERB "%6.3" "" COMPU_TAB_REF Table_10._Copy1 /end COMPU_METHOD
/begin COMPU_METHOD Table_11 "" TAB_VERB "%6.3" "" COMPU_TAB_REF Table_11 /end COMPU_METHOD
/begin COMPU_METHOD Table_12 "" TAB_VERB "%6.3" "" COMPU_TAB_REF Table_12 /end COMPU_METHOD
/begin COMPU_METHOD Table_12._Copy1 "" TAB_VERB "%6.3" "" COMPU_TAB_REF Table_12._Copy1 /end COMPU_METHOD
/begin COMPU_METHOD Table_13 "" TAB_VERB "%6.3" "" COMPU_TAB_REF Table_13 /end COMPU_METHOD
/begin COMPU_METHOD Table_13._Copy1 "" TAB_VERB "%6.3" "" COMPU_TAB_REF Table_13._Copy1 /end COMPU_METHOD
/begin COMPU_METHOD Table_13_Copy1 "" TAB_VERB "%.0" "" COMPU_TAB_REF Table_13_Copy1 /end COMPU_METHOD
/begin COMPU_METHOD Table_15 "" TAB_VERB "%.0" "" COMPU_TAB_REF Table_15 /end COMPU_METHOD
/begin COMPU_METHOD Table_30 "" TAB_VERB "%6.3" "" COMPU_TAB_REF Table_30 /end COMPU_METHOD
/begin COMPU_METHOD Table_5 "" TAB_VERB "%6.3" "" COMPU_TAB_REF Table_5 /end COMPU_METHOD
/begin COMPU_METHOD Table_6 "" TAB_VERB "%6.3" "" COMPU_TAB_REF Table_6 /end COMPU_METHOD
/begin COMPU_METHOD Temperature "" LINEAR "%3.1" "degC" COEFFS_LINEAR 0.1 0 /end COMPU_METHOD
/begin COMPU_METHOD TorqInteg.Conversion "" LINEAR "%6.3" "" COEFFS_LINEAR 1E-05 0 /end COMPU_METHOD
/begin COMPU_METHOD TorqProp.Conversion "" LINEAR "%6.3" "" COEFFS_LINEAR 0.0001 0 /end COMPU_METHOD
/begin COMPU_METHOD Volt_ATD "Converts ATD in ECU to voltage" LINEAR "%6.3" "V/5V_12bit_ATD" COEFFS_LINEAR 1.221 0 /end COMPU_METHOD
/begin COMPU_METHOD Wdog_state.Conversion "" TAB_VERB "%6.3" "" COMPU_TAB_REF Wdog_state.Conversion.Table /end COMPU_METHOD
/begin COMPU_METHOD crankFaultSource_t "" TAB_VERB "%.0" "" COMPU_TAB_REF crankFaultSource_t /end COMPU_METHOD
/begin COMPU_VTAB CHT1_High.Conversion.Table "" TAB_VERB 2 0 "OK" 1 "Faulty" DEFAULT_VALUE "" /end COMPU_VTAB
/begin COMPU_VTAB_RANGE CamTrigger.CONVERSION "" 2 0 0 "CAM_POWER_STROKE" 1 1 "CAM_INTAKE_STROKE" DEFAULT_VALUE "" /end COMPU_VTAB_RANGE
/begin COMPU_VTAB ClosedLoopEgtOperation.Conversion.Table "" TAB_VERB 2 0 "Open Loop" 1 "Closed Loop" DEFAULT_VALUE "" /end COMPU_VTAB
/begin COMPU_VTAB Crank.Conversion.Table "" TAB_VERB 2 0 "1 - Primary" 1 "2 - Secondary" DEFAULT_VALUE "" /end COMPU_VTAB
/begin COMPU_VTAB_RANGE CrankActive.CONVERSION "" 2 0 0 "CRANK_OFF" 1 1 "CRANK_ACTIVE" DEFAULT_VALUE "" /end COMPU_VTAB_RANGE
/begin COMPU_VTAB_RANGE CrankState.CONVERSION "" 10 0 0 "TOOTH_INIT" 1 1 "FIRST_EDGE" 2 2 "TESTING_FOR_GAP_1" 3 3 "VALIDATING_GAP_1" 4 4 "FIRST_REVOLUTION" 5 5 "TESTING_FOR_GAP_2" 6 6 "VALIDATING_GAP_2" 7 7 "SECOND_REVOLUTION" 8 8 "SYNCHRONIZED" 9 9 "SYNCHRONIZED_4C" DEFAULT_VALUE "" /end COMPU_VTAB_RANGE
/begin COMPU_VTAB_RANGE CrankState.CONVERSION.OLD_1 "" 7 0 0 "TOOTH_INIT" 1 1 "FIRST_EDGE" 2 2 "TESTING_FOR_GAP" 3 3 "VALIDATING_GAP" 4 4 "FIRST_REVOLUTION" 5 5 "SYNCHRONIZED" 6 6 "SYNCHRONIZED_4C" DEFAULT_VALUE "" /end COMPU_VTAB_RANGE
/begin COMPU_VTAB_RANGE CrankState.CONVERSION.OLD_2 "" 8 0 0 "TOOTH_INIT" 1 1 "FIRST_EDGE" 2 2 "TESTING_FOR_GAP" 3 3 "VALIDATING_GAP" 4 4 "FIRST_REVOLUTION" 5 5 "SECOND_REVOLUTION" 6 6 "SYNCHRONIZED" 7 7 "SYNCHRONIZED_4C" DEFAULT_VALUE "" /end COMPU_VTAB_RANGE
/begin COMPU_VTAB CrankState.Conversion.Table "" TAB_VERB 7 0 "Tooth Init" 1 "First Edge" 2 "Testing for gap" 3 "Validating gap" 4 "First Revolution" 5 "Synchronizing" 6 "Synchronizing 4C" DEFAULT_VALUE "" /end COMPU_VTAB
/begin COMPU_VTAB DerateOverride.Conversion.Table "" TAB_VERB 2 0 "Off" 1 "Active" DEFAULT_VALUE "" /end COMPU_VTAB
/begin COMPU_VTAB_RANGE DigitalIn1.CONVERSION "" 2 0 0 "DI_LOW" 1 1 "DI_HIGH" DEFAULT_VALUE "" /end COMPU_VTAB_RANGE
/begin COMPU_VTAB_RANGE DigitalIn1.CONVERSION.OLD_1 "" 2 0 0 "DI_OFF" 1 1 "DI_ON" DEFAULT_VALUE "" /end COMPU_VTAB_RANGE
/begin COMPU_VTAB_RANGE EgtState "" 5 0 0 "EgtState_Uninitialized" 1 1 "EgtState_Ready" 2 2 "EgtState_ReadingEgtOne" 3 3 "EgtState_ReadEgtTwo" 4 4 "EgtState_ReadingEgtTwo" DEFAULT_VALUE "" /end COMPU_VTAB_RANGE
/begin COMPU_VTAB EgtState.OLD_1 "" TAB_VERB 5 0 "EgtState_Uninitialized" 1 "EgtState_Ready" 2 "EgtState_ReadingEgtOne" 3 "EgtState_ReadEgtTwo" 4 "EgtState_ReadingEgtTwo" DEFAULT_VALUE "" /end COMPU_VTAB
/begin COMPU_VTAB_RANGE EngineStateCmd.CONVERSION "" 3 0 0 "ENGINESTATE_OFF" 1 1 "ENGINESTATE_RUN" 2 2 "ENGINESTATE_AUTO" DEFAULT_VALUE "" /end COMPU_VTAB_RANGE
/begin COMPU_VTAB_RANGE EngineStateCmd.CONVERSION.OLD_1 "" 2 0 0 "ENGINESTATE_OFF" 1 1 "ENGINESTATE_RUN" DEFAULT_VALUE "" /end COMPU_VTAB_RANGE
/begin COMPU_VTAB EngineStateCmd.Conversion.Table "" TAB_VERB 2 0 "Off" 1 "Run" DEFAULT_VALUE "" /end COMPU_VTAB
/begin COMPU_VTAB Errors.Conversion.Table "" TAB_VERB 2 0 "" 1 "Fault" DEFAULT_VALUE "" /end COMPU_VTAB
/begin COMPU_VTAB_RANGE FuelMapType.CONVERSION "" 3 0 0 "FUELMAP_AUTO" 1 1 "FUELMAP_THROTTLE_LOOKUP" 2 2 "FUELMAP_MAP_LOOKUP" DEFAULT_VALUE "" /end COMPU_VTAB_RANGE
/begin COMPU_VTAB FuelMapType.Conversion.Table "" TAB_VERB 3 0 "Auto" 1 "Throttle Position" 2 "Manifold Pressure" DEFAULT_VALUE "" /end COMPU_VTAB
/begin COMPU_VTAB_RANGE FuelPressureControlMode.CONVERSION "" 3 0 0 "FPRV_ONLY" 1 1 "FPRV_PID_PCR_OVERSHOOT" 2 2 "PCR_PID_FPRV_FF_ONLY" DEFAULT_VALUE "" /end COMPU_VTAB_RANGE
/begin COMPU_VTAB_RANGE FuelStrategy.CONVERSION "" 2 0 0 "FUEL_CTRL_RIHGS" 1 1 "FUEL_CTRL_RTG5" DEFAULT_VALUE "" /end COMPU_VTAB_RANGE
/begin COMPU_VTAB GovMode.Conversion.Table "" TAB_VERB 3 0 "Idle" 1 "Run" 2 "RevLimit" DEFAULT_VALUE "" /end COMPU_VTAB
/begin COMPU_VTAB_RANGE LP_FuelPumpCtrl.CONVERSION "" 2 0 0 "OFF" 1 1 "ON" DEFAULT_VALUE "" /end COMPU_VTAB_RANGE
/begin COMPU_VTAB_RANGE LP_FuelPumpCtrl.CONVERSION.OLD_1 "" 2 0 0 "BINARY_OFF" 1 1 "BINARY_ON" DEFAULT_VALUE "" /end COMPU_VTAB_RANGE
/begin COMPU_VTAB_RANGE OpMode.CONVERSION "" 9 0 0 "OP_FAULT" 1 1 "OP_STANDBY" 2 2 "OP_READY_TO_RUN" 3 3 "OP_PREHEAT" 4 4 "OP_CRANKING" 5 5 "OP_STABILIZE" 6 6 "OP_BIT" 7 7 "OP_RUN" 8 8 "OP_BATTLE_MODE" DEFAULT_VALUE "" /end COMPU_VTAB_RANGE
/begin COMPU_VTAB_RANGE OpMode.CONVERSION.OLD_1 "" 11 0 0 "OP_STANDBY" 1 1 "OP_AUTOPRIME" 2 2 "OP_OVERSPEED" 3 3 "OP_SHUTDOWN" 4 4 "OP_CRANKFAIL" 5 5 "OP_PREHEAT" 6 6 "OP_RUNUP" 7 7 "OP_RUN_OPEN" 8 8 "OP_RUN_CLOSED" 9 9 "OP_CRANKING" 10 10 "OP_POWERUP" DEFAULT_VALUE "" /end COMPU_VTAB_RANGE
/begin COMPU_VTAB_RANGE OpMode.CONVERSION.OLD_2 "" 9 0 0 "OP_STANDBY" 1 1 "OP_READY_TO_RUN" 2 2 "OP_PREHEAT" 3 3 "OP_CRANKING" 4 4 "OP_FAULT" 5 5 "OP_STABILIZE" 6 6 "OP_BIT" 7 7 "OP_RUN" 8 8 "OP_BATTLE_MODE" DEFAULT_VALUE "" /end COMPU_VTAB_RANGE
/begin COMPU_VTAB OpMode.Conversion.Table "" TAB_VERB 10 0 "Standby" 1 "AutoPrime" 2 "Overspeed" 3 "Shutdown" 4 "Crankfail" 5 "Preheat" 6 "Run Up" 7 "Run Open Loop" 8 "Run Closed Loop" 9 "Cranking" DEFAULT_VALUE "" /end COMPU_VTAB
/begin COMPU_VTAB_RANGE Output_GlowPlug.CONVERSION "" 3 0 0 "DO_OFF" 1 1 "DO_ON" 2 2 "DO_AUTO" DEFAULT_VALUE "" /end COMPU_VTAB_RANGE
/begin COMPU_VTAB ShutdownXCP.Conversion.Table "" TAB_VERB 2 0 "Off" 1 "On" DEFAULT_VALUE "" /end COMPU_VTAB
/begin COMPU_VTAB_RANGE SpiState "" 4 0 0 "SpiState_Uninitialized" 1 1 "SpiState_Ready" 2 2 "SpiState_TxRx_Byte_0" 3 3 "SpiState_TxRx_Byte_1" DEFAULT_VALUE "" /end COMPU_VTAB_RANGE
/begin COMPU_VTAB SpiState.OLD_1 "" TAB_VERB 6 0 "SpiState_Uninitialized" 1 "SpiState_Ready" 2 "SpiState_TxRx_Byte_0" 3 "SpiState_TxRx_Byte_1" 4 "SpiState_TxRx_Buf_Byte_0" 5 "SpiState_TxRx_Buf_Byte_1" DEFAULT_VALUE "" /end COMPU_VTAB
/begin COMPU_VTAB_RANGE SpiState.OLD_2 "" 6 0 0 "SpiState_Uninitialized" 1 1 "SpiState_Ready" 2 2 "SpiState_TxRx_Byte_0" 3 3 "SpiState_TxRx_Byte_1" 4 4 "SpiState_TxRx_Buf_Byte_0" 5 5 "SpiState_TxRx_Buf_Byte_1" DEFAULT_VALUE "" /end COMPU_VTAB_RANGE
/begin COMPU_VTAB_RANGE StartMode.CONVERSION "" 2 0 0 "START_MODE_MANUAL" 1 1 "START_MODE_AUTO" DEFAULT_VALUE "" /end COMPU_VTAB_RANGE
/begin COMPU_VTAB Table_0 "" TAB_VERB 2 0 "CAM_POWER_STROKE" 1 "CAM_INTAKE_STROKE" DEFAULT_VALUE "" /end COMPU_VTAB
/begin COMPU_VTAB Table_1 "" TAB_VERB 2 0 "START_MODE_MANUAL" 1 "START_MODE_AUTO" DEFAULT_VALUE "" /end COMPU_VTAB
/begin COMPU_VTAB Table_10 "" TAB_VERB 3 0 "DO_OFF" 1 "DO_ON" 2 "DO_AUTO" DEFAULT_VALUE "" /end COMPU_VTAB
/begin COMPU_VTAB Table_10._Copy1 "" TAB_VERB 2 0 "BINARY_OFF" 1 "BINARY_ON" DEFAULT_VALUE "" /end COMPU_VTAB
/begin COMPU_VTAB Table_11 "" TAB_VERB 2 0 "FUEL_CTRL_RIHGS" 1 "FUEL_CTRL_RTG5" DEFAULT_VALUE "" /end COMPU_VTAB
/begin COMPU_VTAB Table_12 "" TAB_VERB 2 0 "DI_LOW" 1 "DI_HIGH" DEFAULT_VALUE "" /end COMPU_VTAB
/begin COMPU_VTAB Table_12._Copy1 "" TAB_VERB 2 0 "OFF" 1 "ON" DEFAULT_VALUE "" /end COMPU_VTAB
/begin COMPU_VTAB Table_13 "" TAB_VERB 2 0 "DI_OFF" 1 "DI_ON" DEFAULT_VALUE "" /end COMPU_VTAB
/begin COMPU_VTAB Table_13._Copy1 "" TAB_VERB 2 0 "OFF" 1 "ON" DEFAULT_VALUE "" /end COMPU_VTAB
/begin COMPU_VTAB Table_13_Copy1 "" TAB_VERB 8 0 "CRANKFAULT_INIT" 1 "CRANKFAULT_MISSINGTOOTH_ERROR" 2 "CRANKFAULT_TOOTH_TOOSMALL" 3 "CRANKFAULT_TOOTH_TOOLARGE" 4 "CRANKFAULT_CAM_RESET" 5 "CRANKFAULT_TOF_LIMIT" 6 "CRANKFAULT_CAM_OF_CNT_LIMIT" 7 "CRANKFAULT_RESET_CRANK" /end COMPU_VTAB
/begin COMPU_VTAB Table_15 "" TAB_VERB 2 0 "START_WAIT_FOR_SYNC" 1 "START_SYNC" /end COMPU_VTAB
/begin COMPU_VTAB Table_30 "" TAB_VERB 3 0 "ENGINESTATE_OFF" 1 "ENGINESTATE_RUN" 2 "ENGINESTATE_AUTO" DEFAULT_VALUE "" /end COMPU_VTAB
/begin COMPU_VTAB Table_5 "" TAB_VERB 3 0 "FPRV_ONLY" 1 "FPRV_PID_PCR_OVERSHOOT" 2 "PCR_PID_FPRV_FF_ONLY" DEFAULT_VALUE "" /end COMPU_VTAB
/begin COMPU_VTAB Table_6 "" TAB_VERB 2 0 "CRANK_OFF" 1 "CRANK_ACTIVE" DEFAULT_VALUE "" /end COMPU_VTAB
/begin COMPU_VTAB Wdog_state.Conversion.Table "" TAB_VERB 14 0 "Init" 1 "RunOp1" 2 "RunOp2" 3 "RunOp3" 4 "RunOp4" 5 "RunOp5" 6 "Standby" 7 "Autoprime" 8 "New_Inj" 9 "Sustained_Inj" 10 "Spark" 11 "FTM1" 12 "FTM0" 13 "Trig2" DEFAULT_VALUE "" /end COMPU_VTAB
/begin COMPU_VTAB crankFaultSource_t "" TAB_VERB 7 0 "CRANKFAULT_INIT" 1 "CRANKFAULT_MISSINGTOOTH_ERROR" 2 "CRANKFAULT_TOOTH_TOOSMALL" 3 "CRANKFAULT_TOOTH_TOOLARGE" 4 "CRANKFAULT_CAM_RESET" 5 "CRANKFAULT_TOF_LIMIT" 6 "CRANKFAULT_CAM_OF_CNT_LIMIT" /end COMPU_VTAB
/begin RECORD_LAYOUT SSV__A_INT64_S AXIS_PTS_X 1 A_INT64 INDEX_INCR DIRECT /end RECORD_LAYOUT
/begin RECORD_LAYOUT SSV__A_UINT64_S AXIS_PTS_X 1 A_UINT64 INDEX_INCR DIRECT /end RECORD_LAYOUT
/begin RECORD_LAYOUT SSV__FLOAT32_IEEE_S AXIS_PTS_X 1 FLOAT32_IEEE INDEX_INCR DIRECT /end RECORD_LAYOUT
/begin RECORD_LAYOUT SSV__FLOAT64_IEEE_S AXIS_PTS_X 1 FLOAT64_IEEE INDEX_INCR DIRECT /end RECORD_LAYOUT
/begin RECORD_LAYOUT SSV__SBYTE_S AXIS_PTS_X 1 SBYTE INDEX_INCR DIRECT /end RECORD_LAYOUT
/begin RECORD_LAYOUT SSV__SLONG_S AXIS_PTS_X 1 SLONG INDEX_INCR DIRECT /end RECORD_LAYOUT
/begin RECORD_LAYOUT SSV__SWORD_S AXIS_PTS_X 1 SWORD INDEX_INCR DIRECT /end RECORD_LAYOUT
/begin RECORD_LAYOUT SSV__UBYTE_S AXIS_PTS_X 1 UBYTE INDEX_INCR DIRECT /end RECORD_LAYOUT
/begin RECORD_LAYOUT SSV__ULONG_S AXIS_PTS_X 1 ULONG INDEX_INCR DIRECT /end RECORD_LAYOUT
/begin RECORD_LAYOUT SSV__UWORD_S AXIS_PTS_X 1 UWORD INDEX_INCR DIRECT /end RECORD_LAYOUT
/begin RECORD_LAYOUT TorqueMap.Layout FNC_VALUES 1 UWORD ROW_DIR DIRECT /end RECORD_LAYOUT
/begin RECORD_LAYOUT TorqueScale.Layout AXIS_PTS_X 1 SWORD INDEX_INCR DIRECT /end RECORD_LAYOUT
/begin RECORD_LAYOUT __A_INT64_S FNC_VALUES 1 A_INT64 COLUMN_DIR DIRECT /end RECORD_LAYOUT
/begin RECORD_LAYOUT __A_INT64_Z FNC_VALUES 1 A_INT64 ROW_DIR DIRECT /end RECORD_LAYOUT
/begin RECORD_LAYOUT __A_UINT64_S FNC_VALUES 1 A_UINT64 COLUMN_DIR DIRECT /end RECORD_LAYOUT
/begin RECORD_LAYOUT __A_UINT64_Z FNC_VALUES 1 A_UINT64 ROW_DIR DIRECT /end RECORD_LAYOUT
/begin RECORD_LAYOUT __FLOAT32_IEEE_S FNC_VALUES 1 FLOAT32_IEEE COLUMN_DIR DIRECT /end RECORD_LAYOUT
/begin RECORD_LAYOUT __FLOAT32_IEEE_Z FNC_VALUES 1 FLOAT32_IEEE ROW_DIR DIRECT /end RECORD_LAYOUT
/begin RECORD_LAYOUT __FLOAT64_IEEE_S FNC_VALUES 1 FLOAT64_IEEE COLUMN_DIR DIRECT /end RECORD_LAYOUT
/begin RECORD_LAYOUT __FLOAT64_IEEE_Z FNC_VALUES 1 FLOAT64_IEEE ROW_DIR DIRECT /end RECORD_LAYOUT
/begin RECORD_LAYOUT __SBYTE_S FNC_VALUES 1 SBYTE COLUMN_DIR DIRECT /end RECORD_LAYOUT
/begin RECORD_LAYOUT __SBYTE_Z FNC_VALUES 1 SBYTE ROW_DIR DIRECT /end RECORD_LAYOUT
/begin RECORD_LAYOUT __SLONG_S FNC_VALUES 1 SLONG COLUMN_DIR DIRECT /end RECORD_LAYOUT
/begin RECORD_LAYOUT __SLONG_Z FNC_VALUES 1 SLONG ROW_DIR DIRECT /end RECORD_LAYOUT
/begin RECORD_LAYOUT __SWORD_S FNC_VALUES 1 SWORD COLUMN_DIR DIRECT /end RECORD_LAYOUT
/begin RECORD_LAYOUT __SWORD_Z FNC_VALUES 1 SWORD ROW_DIR DIRECT /end RECORD_LAYOUT
/begin RECORD_LAYOUT __SWord_Value FNC_VALUES 1 SWORD ROW_DIR DIRECT /end RECORD_LAYOUT
/begin RECORD_LAYOUT __UBYTE_S FNC_VALUES 1 UBYTE COLUMN_DIR DIRECT /end RECORD_LAYOUT
/begin RECORD_LAYOUT __UBYTE_Z FNC_VALUES 1 UBYTE ROW_DIR DIRECT /end RECORD_LAYOUT
/begin RECORD_LAYOUT __UByte_Value FNC_VALUES 1 UBYTE ROW_DIR DIRECT /end RECORD_LAYOUT
/begin RECORD_LAYOUT __ULONG_S FNC_VALUES 1 ULONG COLUMN_DIR DIRECT /end RECORD_LAYOUT
/begin RECORD_LAYOUT __ULONG_Z FNC_VALUES 1 ULONG ROW_DIR DIRECT /end RECORD_LAYOUT
/begin RECORD_LAYOUT __UWORD_S FNC_VALUES 1 UWORD COLUMN_DIR DIRECT /end RECORD_LAYOUT
/begin RECORD_LAYOUT __UWORD_Z FNC_VALUES 1 UWORD ROW_DIR DIRECT /end RECORD_LAYOUT
/begin RECORD_LAYOUT __UWord_Value FNC_VALUES 1 UWORD ROW_DIR DIRECT /end RECORD_LAYOUT
/begin GROUP Analog_Param "" ROOT /end GROUP
/begin UNIT Celsius "" "degC" EXTENDED_SI SI_EXPONENTS 0 0 0 0 1 0 0 /end UNIT
/end MODULE
/end PROJECT
